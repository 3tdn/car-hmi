ASAP2_VERSION 1 61
/begin PROJECT AL_Mainfunction_PANTHER ""
/begin HEADER "ASAP2 File for PANTHER" /* Comment */ VERSION "2026-08-21 20:40:07" PROJECT_NO PRJ1 /end HEADER
/begin MODULE PANTHER "Prototyping unit for modelbased application"
/begin MOD_COMMON "" ALIGNMENT_BYTE 1 ALIGNMENT_WORD 2 ALIGNMENT_LONG 4 ALIGNMENT_FLOAT32_IEEE 4 ALIGNMENT_FLOAT64_IEEE 8 BYTE_ORDER MSB_LAST DEPOSIT ABSOLUTE /end MOD_COMMON
/begin CHARACTERISTIC DEBUGIN_ACTI_CAN_0x098_DEBUGIN_Enabled "" VALUE 0x24000179 UBYTE_COL_DIRECT 0 NO_COMPU_METHOD 0 1 /end CHARACTERISTIC
/begin CHARACTERISTIC DEBUGIN_ACTI_CAN_0x098_VehSpd_X "" VALUE 0x2400017a UBYTE_COL_DIRECT 0 NO_COMPU_METHOD 0 255 /end CHARACTERISTIC
/begin CHARACTERISTIC DEBUGIN_ALI_CAN_0x020_DEBUGIN_Enabled "" VALUE 0x2400018d UBYTE_COL_DIRECT 0 NO_COMPU_METHOD 0 1 /end CHARACTERISTIC
/begin CHARACTERISTIC DEBUGIN_ALI_CAN_0x020_ISw_Stat "" VALUE 0x24000196 UBYTE_COL_DIRECT 0 NO_COMPU_METHOD 0 255 /end CHARACTERISTIC
/begin CHARACTERISTIC DEBUGIN_ALI_CAN_0x020_RevGR_Engg "Reverse gear selected.  0 - DISENGG, 1 - ENGG, 2 - NDEF2, 3 - SNA" VALUE 0x2400018e UBYTE_COL_DIRECT 0 NO_COMPU_METHOD 0 3 /end CHARACTERISTIC
/begin CHARACTERISTIC DEBUGIN_ALI_CAN_0x094_DEBUGIN_Enabled "" VALUE 0x24000174 UBYTE_COL_DIRECT 0 NO_COMPU_METHOD 0 1 /end CHARACTERISTIC
/begin CHARACTERISTIC DEBUGIN_ALI_CAN_0x094_VehAccel_X_V2 "" VALUE 0x24000175 UBYTE_COL_DIRECT 0 NO_COMPU_METHOD 0 1 /end CHARACTERISTIC
/begin CHARACTERISTIC DEBUGIN_ALI_CAN_0x094_VehAccel_Y_V2 "" VALUE 0x24000176 UBYTE_COL_DIRECT 0 NO_COMPU_METHOD 0 1 /end CHARACTERISTIC
/begin CHARACTERISTIC DEBUGIN_ALI_CAN_0x096_DEBUGIN_Enabled "" VALUE 0x24000177 UBYTE_COL_DIRECT 0 NO_COMPU_METHOD 0 1 /end CHARACTERISTIC
/begin CHARACTERISTIC DEBUGIN_ALI_CAN_0x096_VehYawRate_Raw "" VALUE 0x24000178 UBYTE_COL_DIRECT 0 NO_COMPU_METHOD 0 1 /end CHARACTERISTIC
/begin CHARACTERISTIC DEBUGIN_ALI_CAN_0x0A5_CMS_Brk_Rq_V2 "" VALUE 0x24000192 UBYTE_COL_DIRECT 0 NO_COMPU_METHOD 0 3 /end CHARACTERISTIC
/begin CHARACTERISTIC DEBUGIN_ALI_CAN_0x0A5_DEBUGIN_Enabled "" VALUE 0x24000191 UBYTE_COL_DIRECT 0 NO_COMPU_METHOD 0 1 /end CHARACTERISTIC
/begin CHARACTERISTIC DEBUGIN_ALI_CAN_0x11F_DEBUGIN_Enabled "" VALUE 0x24000193 UBYTE_COL_DIRECT 0 NO_COMPU_METHOD 0 1 /end CHARACTERISTIC
/begin CHARACTERISTIC DEBUGIN_ALI_CAN_0x11F_EF_Actv "" VALUE 0x24000194 UBYTE_COL_DIRECT 0 NO_COMPU_METHOD 0 1 /end CHARACTERISTIC
/begin CHARACTERISTIC DEBUGIN_ALI_CAN_0x13F_ALDW_LDP_Warn_Rq "" VALUE 0x240160ca UBYTE_COL_DIRECT 0 NO_COMPU_METHOD 0 3 /end CHARACTERISTIC
/begin CHARACTERISTIC DEBUGIN_ALI_CAN_0x13F_DEBUGIN_Enabled "" VALUE 0x240160c9 UBYTE_COL_DIRECT 0 NO_COMPU_METHOD 0 1 /end CHARACTERISTIC
/begin CHARACTERISTIC DEBUGIN_ALI_CAN_0x20_DEBUGIN_Enabled "" VALUE 0x24000195 UBYTE_COL_DIRECT 0 NO_COMPU_METHOD 0 1 /end CHARACTERISTIC
/begin CHARACTERISTIC DEBUGIN_ALI_CAN_0x26B_DEBUGIN_Enabled "" VALUE 0x24000172 UBYTE_COL_DIRECT 0 NO_COMPU_METHOD 0 1 /end CHARACTERISTIC
/begin CHARACTERISTIC DEBUGIN_ALI_CAN_0x26B_EPS_FtWhlAngl "" VALUE 0x24000173 UBYTE_COL_DIRECT 0 NO_COMPU_METHOD 0 1 /end CHARACTERISTIC
/begin CHARACTERISTIC DEBUGIN_ALI_CAN_0x271_DEBUGIN_Enabled "" VALUE 0x2400018b UBYTE_COL_DIRECT 0 NO_COMPU_METHOD 0 1 /end CHARACTERISTIC
/begin CHARACTERISTIC DEBUGIN_ALI_CAN_0x271_DPC_Master_Rq_Pr2 "" VALUE 0x2400018c UBYTE_COL_DIRECT 0 NO_COMPU_METHOD 0 1 /end CHARACTERISTIC
/begin CHARACTERISTIC DEBUGIN_ALI_CAN_0x2F7_DEBUGIN_Enabled "" VALUE 0x24000166 UBYTE_COL_DIRECT 0 NO_COMPU_METHOD 0 1 /end CHARACTERISTIC
/begin CHARACTERISTIC DEBUGIN_ALI_CAN_0x397_DEBUGIN_Enabled "" VALUE 0x2400017d UBYTE_COL_DIRECT 0 NO_COMPU_METHOD 0 1 /end CHARACTERISTIC
/begin CHARACTERISTIC DEBUGIN_ALI_CAN_0x397_DrRLtch_FL_Stat "" VALUE 0x2400017e UBYTE_COL_DIRECT 0 NO_COMPU_METHOD 0 255 /end CHARACTERISTIC
/begin CHARACTERISTIC DEBUGIN_ALI_CAN_0x39B_DEBUGIN_Enabled "" VALUE 0x2400017f UBYTE_COL_DIRECT 0 NO_COMPU_METHOD 0 1 /end CHARACTERISTIC
/begin CHARACTERISTIC DEBUGIN_ALI_CAN_0x39B_DrRLtch_FR_Stat "" VALUE 0x24000180 UBYTE_COL_DIRECT 0 NO_COMPU_METHOD 0 255 /end CHARACTERISTIC
/begin CHARACTERISTIC DEBUGIN_ALI_CAN_0x3A3_DEBUGIN_Enabled "" VALUE 0x24000181 UBYTE_COL_DIRECT 0 NO_COMPU_METHOD 0 1 /end CHARACTERISTIC
/begin CHARACTERISTIC DEBUGIN_ALI_CAN_0x3A3_DrRLtch_RL_Stat "" VALUE 0x24000182 UBYTE_COL_DIRECT 0 NO_COMPU_METHOD 0 255 /end CHARACTERISTIC
/begin CHARACTERISTIC DEBUGIN_ALI_CAN_0x3A5_DEBUGIN_Enabled "" VALUE 0x24000183 UBYTE_COL_DIRECT 0 NO_COMPU_METHOD 0 1 /end CHARACTERISTIC
/begin CHARACTERISTIC DEBUGIN_ALI_CAN_0x3A5_DrRLtch_RR_Stat "" VALUE 0x24000184 UBYTE_COL_DIRECT 0 NO_COMPU_METHOD 0 255 /end CHARACTERISTIC
/begin CHARACTERISTIC DEBUGIN_ALI_CAN_0x402_DEBUGIN_Enabled "" VALUE 0x2400018f UBYTE_COL_DIRECT 0 NO_COMPU_METHOD 0 1 /end CHARACTERISTIC
/begin CHARACTERISTIC DEBUGIN_ALI_CAN_0x402_LDP_BrkMsgDisp_Rq "" VALUE 0x24000190 UBYTE_COL_DIRECT 0 NO_COMPU_METHOD 0 3 /end CHARACTERISTIC
/begin CHARACTERISTIC DEBUGIN_ALI_CAN_0x453_AccelPdlPosn "" VALUE 0x24000186 UBYTE_COL_DIRECT 0 NO_COMPU_METHOD 0 1 /end CHARACTERISTIC
/begin CHARACTERISTIC DEBUGIN_ALI_CAN_0x453_DEBUGIN_Enabled "" VALUE 0x24000185 UBYTE_COL_DIRECT 0 NO_COMPU_METHOD 0 1 /end CHARACTERISTIC
/begin CHARACTERISTIC DEBUGIN_ALI_CAN_0x453_DTQ_MsgDisp_Rq_V2 "" VALUE 0x24000187 UBYTE_COL_DIRECT 0 NO_COMPU_METHOD 0 3 /end CHARACTERISTIC
/begin CHARACTERISTIC DEBUGIN_ALI_CAN_0x499_DEBUGIN_Enabled "" VALUE 0x24000188 UBYTE_COL_DIRECT 0 NO_COMPU_METHOD 0 1 /end CHARACTERISTIC
/begin CHARACTERISTIC DEBUGIN_ALI_CAN_0x499_ESP_Actv_Stat_EDR "" VALUE 0x24000189 UBYTE_COL_DIRECT 0 NO_COMPU_METHOD 0 1 /end CHARACTERISTIC
/begin CHARACTERISTIC DEBUGIN_ALI_FR_8_2_4_A_BrkTrq_D_V2 "" VALUE 0x2400017c UBYTE_COL_DIRECT 0 NO_COMPU_METHOD 0 1 /end CHARACTERISTIC
/begin CHARACTERISTIC DEBUGIN_ALI_FR_8_2_4_A_BrkTrq_D_V2_Enabled "" VALUE 0x2400017b UBYTE_COL_DIRECT 0 NO_COMPU_METHOD 0 1 /end CHARACTERISTIC
/begin CHARACTERISTIC DEBUGIN_ALO_COM_Status_PumaFLCan_enable "" VALUE 0x24000160 SWORD_COL_DIRECT 0 NO_COMPU_METHOD -32768 32767 /end CHARACTERISTIC
/begin CHARACTERISTIC DEBUGIN_ALO_COM_Status_PumaFRCan_enable "" VALUE 0x2400015a SWORD_COL_DIRECT 0 NO_COMPU_METHOD -32768 32767 /end CHARACTERISTIC
/begin CHARACTERISTIC DEBUGIN_ALO_COM_Status_PumaRL1Can_enable "" VALUE 0x24000154 SWORD_COL_DIRECT 0 NO_COMPU_METHOD -32768 32767 /end CHARACTERISTIC
/begin CHARACTERISTIC DEBUGIN_ALO_COM_Status_PumaRL2Can_enable "" VALUE 0x2400014e SWORD_COL_DIRECT 0 NO_COMPU_METHOD -32768 32767 /end CHARACTERISTIC
/begin CHARACTERISTIC DEBUGIN_ALO_COM_Status_PumaRR1Can_enable "" VALUE 0x24000148 SWORD_COL_DIRECT 0 NO_COMPU_METHOD -32768 32767 /end CHARACTERISTIC
/begin CHARACTERISTIC DEBUGIN_ALO_HB_State_FR_enable "" VALUE 0x24000142 SWORD_COL_DIRECT 0 NO_COMPU_METHOD -32768 32767 /end CHARACTERISTIC
/begin CHARACTERISTIC DEBUGIN_ALO_HB_State_RL1_enable "" VALUE 0x2400013c SWORD_COL_DIRECT 0 NO_COMPU_METHOD -32768 32767 /end CHARACTERISTIC
/begin CHARACTERISTIC DEBUGIN_ALO_HB_State_RL2_enable "" VALUE 0x24000136 SWORD_COL_DIRECT 0 NO_COMPU_METHOD -32768 32767 /end CHARACTERISTIC
/begin CHARACTERISTIC DEBUGIN_ALO_HB_State_RR1_enable "" VALUE 0x24000130 SWORD_COL_DIRECT 0 NO_COMPU_METHOD -32768 32767 /end CHARACTERISTIC
/begin CHARACTERISTIC DEBUGIN_CAN_0x2F7_EVC_List08_Country "" VALUE 0x24000167 UBYTE_COL_DIRECT 0 NO_COMPU_METHOD 0 255 /end CHARACTERISTIC
/begin CHARACTERISTIC DEBUGIN_can6_0x190_WMS_FL_SensorStatus_bool "" VALUE 0x24015fa8 FLOAT32_IEEE_COL_DIRECT 0 NO_COMPU_METHOD 0 255 /end CHARACTERISTIC
/begin CHARACTERISTIC DEBUGIN_can6_0x190_WMS_FL_SensorStatus_bool_Enable "" VALUE 0x24015fa4 UBYTE_COL_DIRECT 0 NO_COMPU_METHOD 0 1 /end CHARACTERISTIC
/begin CHARACTERISTIC DEBUGIN_can6_0x190_WMS_FL_SpoolAngle_deg "" VALUE 0x24015fb0 FLOAT32_IEEE_COL_DIRECT 0 NO_COMPU_METHOD 0 255 /end CHARACTERISTIC
/begin CHARACTERISTIC DEBUGIN_can6_0x190_WMS_FL_SpoolAngle_deg_Enable "" VALUE 0x24015fac UBYTE_COL_DIRECT 0 NO_COMPU_METHOD 0 1 /end CHARACTERISTIC
/begin CHARACTERISTIC DEBUGIN_can6_0x190_WMS_FL_WebbingMovement_mm "" VALUE 0x24015fb8 FLOAT32_IEEE_COL_DIRECT 0 NO_COMPU_METHOD 0 255 /end CHARACTERISTIC
/begin CHARACTERISTIC DEBUGIN_can6_0x190_WMS_FL_WebbingMovement_mm_Enable "" VALUE 0x24015fb4 UBYTE_COL_DIRECT 0 NO_COMPU_METHOD 0 1 /end CHARACTERISTIC
/begin CHARACTERISTIC DEBUGIN_can6_0x191_WMS_FR_SensorStatus "" VALUE 0x24015fc0 FLOAT32_IEEE_COL_DIRECT 0 NO_COMPU_METHOD 0 255 /end CHARACTERISTIC
/begin CHARACTERISTIC DEBUGIN_can6_0x191_WMS_FR_SensorStatus_Enable "" VALUE 0x24015fbc UBYTE_COL_DIRECT 0 NO_COMPU_METHOD 0 1 /end CHARACTERISTIC
/begin CHARACTERISTIC DEBUGIN_can6_0x191_WMS_FR_SpoolAngle "" VALUE 0x24015fc8 FLOAT32_IEEE_COL_DIRECT 0 NO_COMPU_METHOD 0 255 /end CHARACTERISTIC
/begin CHARACTERISTIC DEBUGIN_can6_0x191_WMS_FR_SpoolAngle_Enable "" VALUE 0x24015fc4 UBYTE_COL_DIRECT 0 NO_COMPU_METHOD 0 1 /end CHARACTERISTIC
/begin CHARACTERISTIC DEBUGIN_can6_0x191_WMS_FR_WebbingMovement "" VALUE 0x24015fd4 FLOAT32_IEEE_COL_DIRECT 0 NO_COMPU_METHOD 0 255 /end CHARACTERISTIC
/begin CHARACTERISTIC DEBUGIN_can6_0x191_WMS_FR_WebbingMovement_Enable "" VALUE 0x24015fd0 UBYTE_COL_DIRECT 0 NO_COMPU_METHOD 0 1 /end CHARACTERISTIC
/begin CHARACTERISTIC DEBUGIN_can6_0x192_WMS_R1_SensorStatus "" VALUE 0x24015fdc FLOAT32_IEEE_COL_DIRECT 0 NO_COMPU_METHOD 0 255 /end CHARACTERISTIC
/begin CHARACTERISTIC DEBUGIN_can6_0x192_WMS_R1_SensorStatus_Enable "" VALUE 0x24015fd8 UBYTE_COL_DIRECT 0 NO_COMPU_METHOD 0 1 /end CHARACTERISTIC
/begin CHARACTERISTIC DEBUGIN_can6_0x192_WMS_R1_SpoolAngle "" VALUE 0x24015fe4 FLOAT32_IEEE_COL_DIRECT 0 NO_COMPU_METHOD 0 255 /end CHARACTERISTIC
/begin CHARACTERISTIC DEBUGIN_can6_0x192_WMS_R1_SpoolAngle_Enable "" VALUE 0x24015fe0 UBYTE_COL_DIRECT 0 NO_COMPU_METHOD 0 1 /end CHARACTERISTIC
/begin CHARACTERISTIC DEBUGIN_can6_0x192_WMS_R1_WebbingMovement "" VALUE 0x24015fec FLOAT32_IEEE_COL_DIRECT 0 NO_COMPU_METHOD 0 255 /end CHARACTERISTIC
/begin CHARACTERISTIC DEBUGIN_can6_0x192_WMS_R1_WebbingMovement_Enable "" VALUE 0x24015fe8 UBYTE_COL_DIRECT 0 NO_COMPU_METHOD 0 1 /end CHARACTERISTIC
/begin CHARACTERISTIC DEBUGIN_can6_0x193_WMS_R2_SensorStatus "" VALUE 0x24015ff4 FLOAT32_IEEE_COL_DIRECT 0 NO_COMPU_METHOD 0 255 /end CHARACTERISTIC
/begin CHARACTERISTIC DEBUGIN_can6_0x193_WMS_R2_SensorStatus_Enable "" VALUE 0x24015ff0 UBYTE_COL_DIRECT 0 NO_COMPU_METHOD 0 1 /end CHARACTERISTIC
/begin CHARACTERISTIC DEBUGIN_can6_0x193_WMS_R2_SpoolAngle "" VALUE 0x24016000 FLOAT32_IEEE_COL_DIRECT 0 NO_COMPU_METHOD 0 255 /end CHARACTERISTIC
/begin CHARACTERISTIC DEBUGIN_can6_0x193_WMS_R2_SpoolAngle_Enable "" VALUE 0x24015ffc UBYTE_COL_DIRECT 0 NO_COMPU_METHOD 0 1 /end CHARACTERISTIC
/begin CHARACTERISTIC DEBUGIN_can6_0x193_WMS_R2_WebbingMovement "" VALUE 0x24016008 FLOAT32_IEEE_COL_DIRECT 0 NO_COMPU_METHOD 0 255 /end CHARACTERISTIC
/begin CHARACTERISTIC DEBUGIN_can6_0x193_WMS_R2_WebbingMovement_Enable "" VALUE 0x24016004 UBYTE_COL_DIRECT 0 NO_COMPU_METHOD 0 1 /end CHARACTERISTIC
/begin CHARACTERISTIC DEBUGIN_can6_0x194_WMS_RR1_SensorStatus "" VALUE 0x24016010 FLOAT32_IEEE_COL_DIRECT 0 NO_COMPU_METHOD 0 255 /end CHARACTERISTIC
/begin CHARACTERISTIC DEBUGIN_can6_0x194_WMS_RR1_SensorStatus_Enable "" VALUE 0x2401600c UBYTE_COL_DIRECT 0 NO_COMPU_METHOD 0 1 /end CHARACTERISTIC
/begin CHARACTERISTIC DEBUGIN_can6_0x194_WMS_RR1_SpoolAngle "" VALUE 0x24016018 FLOAT32_IEEE_COL_DIRECT 0 NO_COMPU_METHOD 0 255 /end CHARACTERISTIC
/begin CHARACTERISTIC DEBUGIN_can6_0x194_WMS_RR1_SpoolAngle_Enable "" VALUE 0x24016014 UBYTE_COL_DIRECT 0 NO_COMPU_METHOD 0 1 /end CHARACTERISTIC
/begin CHARACTERISTIC DEBUGIN_can6_0x194_WMS_RR1_WebbingMovement "" VALUE 0x24016020 FLOAT32_IEEE_COL_DIRECT 0 NO_COMPU_METHOD 0 255 /end CHARACTERISTIC
/begin CHARACTERISTIC DEBUGIN_can6_0x194_WMS_RR1_WebbingMovement_Enable "" VALUE 0x2401601c UBYTE_COL_DIRECT 0 NO_COMPU_METHOD 0 1 /end CHARACTERISTIC
/begin CHARACTERISTIC DEBUGIN_can6_0x198_ELK_FL_LockingStatus "" VALUE 0x24015fa0 FLOAT32_IEEE_COL_DIRECT 0 NO_COMPU_METHOD 0 255 /end CHARACTERISTIC
/begin CHARACTERISTIC DEBUGIN_can6_0x198_ELK_FL_LockingStatus_Enable "" VALUE 0x24015f9c UBYTE_COL_DIRECT 0 NO_COMPU_METHOD 0 1 /end CHARACTERISTIC
/begin CHARACTERISTIC DEBUGIN_can6_0x198_ELK_FR_LockingStatus "" VALUE 0x24015f98 FLOAT32_IEEE_COL_DIRECT 0 NO_COMPU_METHOD 0 255 /end CHARACTERISTIC
/begin CHARACTERISTIC DEBUGIN_can6_0x198_ELK_FR_LockingStatus_Enable "" VALUE 0x24015f94 UBYTE_COL_DIRECT 0 NO_COMPU_METHOD 0 1 /end CHARACTERISTIC
/begin CHARACTERISTIC DEBUGIN_can6_0x198_ELK_R1_LockingStatus "" VALUE 0x24015f90 FLOAT32_IEEE_COL_DIRECT 0 NO_COMPU_METHOD 0 255 /end CHARACTERISTIC
/begin CHARACTERISTIC DEBUGIN_can6_0x198_ELK_R1_LockingStatus_Enable "" VALUE 0x24015f8c UBYTE_COL_DIRECT 0 NO_COMPU_METHOD 0 1 /end CHARACTERISTIC
/begin CHARACTERISTIC DEBUGIN_can6_0x198_ELK_R2_LockingStatus "" VALUE 0x24015f84 FLOAT32_IEEE_COL_DIRECT 0 NO_COMPU_METHOD 0 255 /end CHARACTERISTIC
/begin CHARACTERISTIC DEBUGIN_can6_0x198_ELK_R2_LockingStatus_Enable "" VALUE 0x24015f80 UBYTE_COL_DIRECT 0 NO_COMPU_METHOD 0 1 /end CHARACTERISTIC
/begin CHARACTERISTIC DEBUGIN_can6_0x198_ELK_RR1_LockingStatus "" VALUE 0x24015f7c FLOAT32_IEEE_COL_DIRECT 0 NO_COMPU_METHOD 0 255 /end CHARACTERISTIC
/begin CHARACTERISTIC DEBUGIN_can6_0x198_ELK_RR1_LockingStatus_Enable "" VALUE 0x24015f78 UBYTE_COL_DIRECT 0 NO_COMPU_METHOD 0 1 /end CHARACTERISTIC
/begin CHARACTERISTIC DEBUGIN_can6_0x199_BSW_FL_BuckleStatus "" VALUE 0x24015f74 FLOAT32_IEEE_COL_DIRECT 0 NO_COMPU_METHOD 0 255 /end CHARACTERISTIC
/begin CHARACTERISTIC DEBUGIN_can6_0x199_BSW_FL_BuckleStatus_Enable "" VALUE 0x24015f70 UBYTE_COL_DIRECT 0 NO_COMPU_METHOD 0 1 /end CHARACTERISTIC
/begin CHARACTERISTIC DEBUGIN_can6_0x199_BSW_FR_BuckleStatus "" VALUE 0x24015f6c FLOAT32_IEEE_COL_DIRECT 0 NO_COMPU_METHOD 0 255 /end CHARACTERISTIC
/begin CHARACTERISTIC DEBUGIN_can6_0x199_BSW_FR_BuckleStatus_Enable "" VALUE 0x24015f68 UBYTE_COL_DIRECT 0 NO_COMPU_METHOD 0 1 /end CHARACTERISTIC
/begin CHARACTERISTIC DEBUGIN_can6_0x199_BSW_R1_BuckleStatus "" VALUE 0x24015f64 FLOAT32_IEEE_COL_DIRECT 0 NO_COMPU_METHOD 0 255 /end CHARACTERISTIC
/begin CHARACTERISTIC DEBUGIN_can6_0x199_BSW_R1_BuckleStatus_Enable "" VALUE 0x24015f60 UBYTE_COL_DIRECT 0 NO_COMPU_METHOD 0 1 /end CHARACTERISTIC
/begin CHARACTERISTIC DEBUGIN_can6_0x199_BSW_R2_BuckleStatus "" VALUE 0x24015f5c FLOAT32_IEEE_COL_DIRECT 0 NO_COMPU_METHOD 0 255 /end CHARACTERISTIC
/begin CHARACTERISTIC DEBUGIN_can6_0x199_BSW_R2_BuckleStatus_Enable "" VALUE 0x24015f58 UBYTE_COL_DIRECT 0 NO_COMPU_METHOD 0 1 /end CHARACTERISTIC
/begin CHARACTERISTIC DEBUGIN_can6_0x199_BSW_RR1_BuckleStatus "" VALUE 0x24015f54 FLOAT32_IEEE_COL_DIRECT 0 NO_COMPU_METHOD 0 255 /end CHARACTERISTIC
/begin CHARACTERISTIC DEBUGIN_can6_0x199_BSW_RR1_BuckleStatus_Enable "" VALUE 0x24015f50 UBYTE_COL_DIRECT 0 NO_COMPU_METHOD 0 1 /end CHARACTERISTIC
/begin CHARACTERISTIC DEBUGIN_can6_0xB1_ARS_FL_InjuryRiskAdaptive "" VALUE 0x240160ac FLOAT32_IEEE_COL_DIRECT 0 NO_COMPU_METHOD 0 255 /end CHARACTERISTIC
/begin CHARACTERISTIC DEBUGIN_can6_0xB1_ARS_FL_InjuryRiskAdaptive_Enable "" VALUE 0x240160aa UBYTE_COL_DIRECT 0 NO_COMPU_METHOD 0 1 /end CHARACTERISTIC
/begin CHARACTERISTIC DEBUGIN_can6_0xB1_ARS_FL_InjuryRiskNonAdaptive "" VALUE 0x240160a4 FLOAT32_IEEE_COL_DIRECT 0 NO_COMPU_METHOD 0 255 /end CHARACTERISTIC
/begin CHARACTERISTIC DEBUGIN_can6_0xB1_ARS_FL_InjuryRiskNonAdaptive_Enable "" VALUE 0x240160a2 UBYTE_COL_DIRECT 0 NO_COMPU_METHOD 0 1 /end CHARACTERISTIC
/begin CHARACTERISTIC DEBUGIN_can6_0xB1_ARS_FR_InjuryRiskAdaptive "" VALUE 0x2401609c FLOAT32_IEEE_COL_DIRECT 0 NO_COMPU_METHOD 0 255 /end CHARACTERISTIC
/begin CHARACTERISTIC DEBUGIN_can6_0xB1_ARS_FR_InjuryRiskAdaptive_Enable "" VALUE 0x2401609a UBYTE_COL_DIRECT 0 NO_COMPU_METHOD 0 1 /end CHARACTERISTIC
/begin CHARACTERISTIC DEBUGIN_can6_0xB1_ARS_FR_InjuryRiskNonAdaptive "" VALUE 0x24016094 FLOAT32_IEEE_COL_DIRECT 0 NO_COMPU_METHOD 0 255 /end CHARACTERISTIC
/begin CHARACTERISTIC DEBUGIN_can6_0xB1_ARS_FR_InjuryRiskNonAdaptive_Enable "" VALUE 0x24016092 UBYTE_COL_DIRECT 0 NO_COMPU_METHOD 0 1 /end CHARACTERISTIC
/begin CHARACTERISTIC DEBUGIN_can6_0xB2_ARS_FL_TimeToFireAirbag "" VALUE 0x24015f4c FLOAT32_IEEE_COL_DIRECT 0 NO_COMPU_METHOD 0 255 /end CHARACTERISTIC
/begin CHARACTERISTIC DEBUGIN_can6_0xB2_ARS_FL_TimeToFireAirbag_Enable "" VALUE 0x24015f4a UBYTE_COL_DIRECT 0 NO_COMPU_METHOD 0 1 /end CHARACTERISTIC
/begin CHARACTERISTIC DEBUGIN_can6_0xB2_ARS_FL_TimeToFireSeatbelt "" VALUE 0x240160c4 FLOAT32_IEEE_COL_DIRECT 0 NO_COMPU_METHOD 0 255 /end CHARACTERISTIC
/begin CHARACTERISTIC DEBUGIN_can6_0xB2_ARS_FL_TimeToFireSeatbelt_Enable "" VALUE 0x240160c2 UBYTE_COL_DIRECT 0 NO_COMPU_METHOD 0 1 /end CHARACTERISTIC
/begin CHARACTERISTIC DEBUGIN_can6_0xB2_ARS_FR_TimeToFireAirbag "" VALUE 0x240160bc FLOAT32_IEEE_COL_DIRECT 0 NO_COMPU_METHOD 0 255 /end CHARACTERISTIC
/begin CHARACTERISTIC DEBUGIN_can6_0xB2_ARS_FR_TimeToFireAirbag_Enable "" VALUE 0x240160ba UBYTE_COL_DIRECT 0 NO_COMPU_METHOD 0 1 /end CHARACTERISTIC
/begin CHARACTERISTIC DEBUGIN_can6_0xB2_ARS_FR_TimeToFireSeatbelt "" VALUE 0x240160b4 FLOAT32_IEEE_COL_DIRECT 0 NO_COMPU_METHOD 0 255 /end CHARACTERISTIC
/begin CHARACTERISTIC DEBUGIN_can6_0xB2_ARS_FR_TimeToFireSeatbelt_Enable "" VALUE 0x240160b2 UBYTE_COL_DIRECT 0 NO_COMPU_METHOD 0 1 /end CHARACTERISTIC
/begin CHARACTERISTIC DEBUGIN_can6_0xB5_SPS_FL_FootRestPosition "" VALUE 0x24016034 FLOAT32_IEEE_COL_DIRECT 0 NO_COMPU_METHOD 0 255 /end CHARACTERISTIC
/begin CHARACTERISTIC DEBUGIN_can6_0xB5_SPS_FL_FootRestPosition_Enable "" VALUE 0x24016032 UBYTE_COL_DIRECT 0 NO_COMPU_METHOD 0 1 /end CHARACTERISTIC
/begin CHARACTERISTIC DEBUGIN_can6_0xB5_SPS_FL_HeadRestPosition "" VALUE 0x2401602c FLOAT32_IEEE_COL_DIRECT 0 NO_COMPU_METHOD 0 255 /end CHARACTERISTIC
/begin CHARACTERISTIC DEBUGIN_can6_0xB5_SPS_FL_HeadRestPosition_Enable "" VALUE 0x2401602a UBYTE_COL_DIRECT 0 NO_COMPU_METHOD 0 1 /end CHARACTERISTIC
/begin CHARACTERISTIC DEBUGIN_can6_0xB5_SPS_FL_SeatBackRestPosition "" VALUE 0x2401603c FLOAT32_IEEE_COL_DIRECT 0 NO_COMPU_METHOD 0 255 /end CHARACTERISTIC
/begin CHARACTERISTIC DEBUGIN_can6_0xB5_SPS_FL_SeatBackRestPosition_Enable "" VALUE 0x2401603a UBYTE_COL_DIRECT 0 NO_COMPU_METHOD 0 1 /end CHARACTERISTIC
/begin CHARACTERISTIC DEBUGIN_can6_0xB5_SPS_FL_SeatDirectionX "" VALUE 0x2401604c FLOAT32_IEEE_COL_DIRECT 0 NO_COMPU_METHOD 0 255 /end CHARACTERISTIC
/begin CHARACTERISTIC DEBUGIN_can6_0xB5_SPS_FL_SeatDirectionX_Enable "" VALUE 0x2401604a UBYTE_COL_DIRECT 0 NO_COMPU_METHOD 0 1 /end CHARACTERISTIC
/begin CHARACTERISTIC DEBUGIN_can6_0xB5_SPS_FL_SeatDirectionZ "" VALUE 0x24016044 FLOAT32_IEEE_COL_DIRECT 0 NO_COMPU_METHOD 0 255 /end CHARACTERISTIC
/begin CHARACTERISTIC DEBUGIN_can6_0xB5_SPS_FL_SeatDirectionZ_Enable "" VALUE 0x24016042 UBYTE_COL_DIRECT 0 NO_COMPU_METHOD 0 1 /end CHARACTERISTIC
/begin CHARACTERISTIC DEBUGIN_can6_0xB6_SPS_FR_FootRestPosition "" VALUE 0x24016060 FLOAT32_IEEE_COL_DIRECT 0 NO_COMPU_METHOD 0 255 /end CHARACTERISTIC
/begin CHARACTERISTIC DEBUGIN_can6_0xB6_SPS_FR_FootRestPosition_Enable "" VALUE 0x2401605e UBYTE_COL_DIRECT 0 NO_COMPU_METHOD 0 1 /end CHARACTERISTIC
/begin CHARACTERISTIC DEBUGIN_can6_0xB6_SPS_FR_HeadRestPosition "" VALUE 0x24016058 FLOAT32_IEEE_COL_DIRECT 0 NO_COMPU_METHOD 0 255 /end CHARACTERISTIC
/begin CHARACTERISTIC DEBUGIN_can6_0xB6_SPS_FR_HeadRestPosition_Enable "" VALUE 0x24016056 UBYTE_COL_DIRECT 0 NO_COMPU_METHOD 0 1 /end CHARACTERISTIC
/begin CHARACTERISTIC DEBUGIN_can6_0xB6_SPS_FR_SeatBackRestPosition "" VALUE 0x24016068 FLOAT32_IEEE_COL_DIRECT 0 NO_COMPU_METHOD 0 255 /end CHARACTERISTIC
/begin CHARACTERISTIC DEBUGIN_can6_0xB6_SPS_FR_SeatBackRestPosition_Enable "" VALUE 0x24016066 UBYTE_COL_DIRECT 0 NO_COMPU_METHOD 0 1 /end CHARACTERISTIC
/begin CHARACTERISTIC DEBUGIN_can6_0xB6_SPS_FR_SeatDirectionX "" VALUE 0x24016078 FLOAT32_IEEE_COL_DIRECT 0 NO_COMPU_METHOD 0 255 /end CHARACTERISTIC
/begin CHARACTERISTIC DEBUGIN_can6_0xB6_SPS_FR_SeatDirectionX_Enable "" VALUE 0x24016076 UBYTE_COL_DIRECT 0 NO_COMPU_METHOD 0 1 /end CHARACTERISTIC
/begin CHARACTERISTIC DEBUGIN_can6_0xB6_SPS_FR_SeatDirectionZ "" VALUE 0x24016070 FLOAT32_IEEE_COL_DIRECT 0 NO_COMPU_METHOD 0 255 /end CHARACTERISTIC
/begin CHARACTERISTIC DEBUGIN_can6_0xB6_SPS_FR_SeatDirectionZ_Enable "" VALUE 0x2401606e UBYTE_COL_DIRECT 0 NO_COMPU_METHOD 0 1 /end CHARACTERISTIC
/begin CHARACTERISTIC DEBUGIN_ELK_Algo_Status_RL1_enable "" VALUE 0x240001aa SWORD_COL_DIRECT 0 NO_COMPU_METHOD -32768 32767 /end CHARACTERISTIC
/begin CHARACTERISTIC DEBUGIN_ELK_Algo_Status_RL2_enable "" VALUE 0x240001b0 SWORD_COL_DIRECT 0 NO_COMPU_METHOD -32768 32767 /end CHARACTERISTIC
/begin CHARACTERISTIC DEBUGIN_ELK_Algo_Status_RR1_enable "" VALUE 0x240001b6 SWORD_COL_DIRECT 0 NO_COMPU_METHOD -32768 32767 /end CHARACTERISTIC
/begin CHARACTERISTIC DEBUGIN_ELK_ECU_Status_RL1_enable "" VALUE 0x240001bc SWORD_COL_DIRECT 0 NO_COMPU_METHOD -32768 32767 /end CHARACTERISTIC
/begin CHARACTERISTIC DEBUGIN_ELK_ECU_Status_RL2_enable "" VALUE 0x240001c2 SWORD_COL_DIRECT 0 NO_COMPU_METHOD -32768 32767 /end CHARACTERISTIC
/begin CHARACTERISTIC DEBUGIN_ELK_ECU_Status_RR1_enable "" VALUE 0x240001c8 SWORD_COL_DIRECT 0 NO_COMPU_METHOD -32768 32767 /end CHARACTERISTIC
/begin CHARACTERISTIC DEBUGIN_ELK_Lock_Status_RL1_enable "" VALUE 0x24000198 SWORD_COL_DIRECT 0 NO_COMPU_METHOD -32768 32767 /end CHARACTERISTIC
/begin CHARACTERISTIC DEBUGIN_ELK_Lock_Status_RL2_enable "" VALUE 0x2400019e SWORD_COL_DIRECT 0 NO_COMPU_METHOD -32768 32767 /end CHARACTERISTIC
/begin CHARACTERISTIC DEBUGIN_ELK_Lock_Status_RR1_enable "" VALUE 0x240001a4 SWORD_COL_DIRECT 0 NO_COMPU_METHOD -32768 32767 /end CHARACTERISTIC
/begin CHARACTERISTIC DEBUGIN_ELK_WriteErrorCounter_RL1_Int16_enable "" VALUE 0x24015f10 SWORD_COL_DIRECT 0 NO_COMPU_METHOD -32768 32767 /end CHARACTERISTIC
/begin CHARACTERISTIC DEBUGIN_ELK_WriteErrorCounter_RL2_Int16_enable "" VALUE 0x24015f0a SWORD_COL_DIRECT 0 NO_COMPU_METHOD -32768 32767 /end CHARACTERISTIC
/begin CHARACTERISTIC DEBUGIN_ELK_WriteErrorCounter_RR1_Int16_enable "" VALUE 0x24015f04 SWORD_COL_DIRECT 0 NO_COMPU_METHOD -32768 32767 /end CHARACTERISTIC
/begin CHARACTERISTIC DEBUGIN_ELK_WriteMemotyRequest_RL1_bool_enable "" VALUE 0x24015ef2 SWORD_COL_DIRECT 0 NO_COMPU_METHOD -32768 32767 /end CHARACTERISTIC
/begin CHARACTERISTIC DEBUGIN_ELK_WriteMemotyRequest_RL2_bool_enable "" VALUE 0x24015ef8 SWORD_COL_DIRECT 0 NO_COMPU_METHOD -32768 32767 /end CHARACTERISTIC
/begin CHARACTERISTIC DEBUGIN_ELK_WriteMemotyRequest_RR1_bool_enable "" VALUE 0x24015efe SWORD_COL_DIRECT 0 NO_COMPU_METHOD -32768 32767 /end CHARACTERISTIC
/begin CHARACTERISTIC DEBUGIN_HMI_ABL_FL_RetractRequest_enable "" VALUE 0x240001f8 SWORD_COL_DIRECT 0 NO_COMPU_METHOD -32768 32767 /end CHARACTERISTIC
/begin CHARACTERISTIC DEBUGIN_HMI_ABL_FR_RetractRequest_enable "" VALUE 0x240001fe SWORD_COL_DIRECT 0 NO_COMPU_METHOD -32768 32767 /end CHARACTERISTIC
/begin CHARACTERISTIC DEBUGIN_HMI_ABL_RL1_RetractRequest_enable "" VALUE 0x24000204 SWORD_COL_DIRECT 0 NO_COMPU_METHOD -32768 32767 /end CHARACTERISTIC
/begin CHARACTERISTIC DEBUGIN_HMI_ABL_RL2_RetractRequest "" VALUE 0x2400020c SWORD_COL_DIRECT 0 NO_COMPU_METHOD -32768 32767 /end CHARACTERISTIC
/begin CHARACTERISTIC DEBUGIN_HMI_ABL_RL2_RetractRequest_enable "" VALUE 0x2400020a SWORD_COL_DIRECT 0 NO_COMPU_METHOD -32768 32767 /end CHARACTERISTIC
/begin CHARACTERISTIC DEBUGIN_HMI_ABL_RR1_RetractRequest "" VALUE 0x24000212 SWORD_COL_DIRECT 0 NO_COMPU_METHOD -32768 32767 /end CHARACTERISTIC
/begin CHARACTERISTIC DEBUGIN_HMI_ABL_RR1_RetractRequest_enable "" VALUE 0x24000210 SWORD_COL_DIRECT 0 NO_COMPU_METHOD -32768 32767 /end CHARACTERISTIC
/begin CHARACTERISTIC DEBUGIN_HMI_ABL_Rx_Status_enable "" VALUE 0x240001f2 SWORD_COL_DIRECT 0 NO_COMPU_METHOD -32768 32767 /end CHARACTERISTIC
/begin CHARACTERISTIC DEBUGIN_HMI_ACR_FL_RetractRequest "" VALUE 0x240001d6 SWORD_COL_DIRECT 0 NO_COMPU_METHOD -32768 32767 /end CHARACTERISTIC
/begin CHARACTERISTIC DEBUGIN_HMI_ACR_FL_RetractRequest_enable "" VALUE 0x240001d4 SWORD_COL_DIRECT 0 NO_COMPU_METHOD -32768 32767 /end CHARACTERISTIC
/begin CHARACTERISTIC DEBUGIN_HMI_ACR_FR_RetractRequest "" VALUE 0x240001dc SWORD_COL_DIRECT 0 NO_COMPU_METHOD -32768 32767 /end CHARACTERISTIC
/begin CHARACTERISTIC DEBUGIN_HMI_ACR_FR_RetractRequest_enable "" VALUE 0x240001da SWORD_COL_DIRECT 0 NO_COMPU_METHOD -32768 32767 /end CHARACTERISTIC
/begin CHARACTERISTIC DEBUGIN_HMI_ACR_RL1_RetractRequest "" VALUE 0x240001e2 SWORD_COL_DIRECT 0 NO_COMPU_METHOD -32768 32767 /end CHARACTERISTIC
/begin CHARACTERISTIC DEBUGIN_HMI_ACR_RL1_RetractRequest_enable "" VALUE 0x240001e0 SWORD_COL_DIRECT 0 NO_COMPU_METHOD -32768 32767 /end CHARACTERISTIC
/begin CHARACTERISTIC DEBUGIN_HMI_ACR_RL2_RetractRequest "" VALUE 0x240001e8 SWORD_COL_DIRECT 0 NO_COMPU_METHOD -32768 32767 /end CHARACTERISTIC
/begin CHARACTERISTIC DEBUGIN_HMI_ACR_RL2_RetractRequest_enable "" VALUE 0x240001e6 SWORD_COL_DIRECT 0 NO_COMPU_METHOD -32768 32767 /end CHARACTERISTIC
/begin CHARACTERISTIC DEBUGIN_HMI_ACR_RR1_RetractRequest "" VALUE 0x240001ee SWORD_COL_DIRECT 0 NO_COMPU_METHOD -32768 32767 /end CHARACTERISTIC
/begin CHARACTERISTIC DEBUGIN_HMI_ACR_RR1_RetractRequest_enable "" VALUE 0x240001ec SWORD_COL_DIRECT 0 NO_COMPU_METHOD -32768 32767 /end CHARACTERISTIC
/begin CHARACTERISTIC DEBUGIN_HMI_ACR_Rx_Status "" VALUE 0x240001d0 SWORD_COL_DIRECT 0 NO_COMPU_METHOD -32768 32767 /end CHARACTERISTIC
/begin CHARACTERISTIC DEBUGIN_HMI_ACR_Rx_Status_enable "" VALUE 0x240001ce SWORD_COL_DIRECT 0 NO_COMPU_METHOD -32768 32767 /end CHARACTERISTIC
/begin CHARACTERISTIC DEBUGIN_HMI_ELK_FL_LockingRequest "" VALUE 0x2400022a SWORD_COL_DIRECT 0 NO_COMPU_METHOD -32768 32767 /end CHARACTERISTIC
/begin CHARACTERISTIC DEBUGIN_HMI_ELK_FL_LockingRequest_enable "" VALUE 0x24000228 SWORD_COL_DIRECT 0 NO_COMPU_METHOD -32768 32767 /end CHARACTERISTIC
/begin CHARACTERISTIC DEBUGIN_HMI_ELK_FR_LockingRequest "" VALUE 0x2400021e SWORD_COL_DIRECT 0 NO_COMPU_METHOD -32768 32767 /end CHARACTERISTIC
/begin CHARACTERISTIC DEBUGIN_HMI_ELK_FR_LockingRequest_enable "" VALUE 0x2400021c SWORD_COL_DIRECT 0 NO_COMPU_METHOD -32768 32767 /end CHARACTERISTIC
/begin CHARACTERISTIC DEBUGIN_HMI_ELK_ResetErrorFlags "" VALUE 0x2400023c SWORD_COL_DIRECT 0 NO_COMPU_METHOD -32768 32767 /end CHARACTERISTIC
/begin CHARACTERISTIC DEBUGIN_HMI_ELK_ResetErrorFlags_enable "" VALUE 0x2400023a SWORD_COL_DIRECT 0 NO_COMPU_METHOD -32768 32767 /end CHARACTERISTIC
/begin CHARACTERISTIC DEBUGIN_HMI_ELK_RL1_LockingRequest "" VALUE 0x24000224 SWORD_COL_DIRECT 0 NO_COMPU_METHOD -32768 32767 /end CHARACTERISTIC
/begin CHARACTERISTIC DEBUGIN_HMI_ELK_RL1_LockingRequest_enable "" VALUE 0x24000222 SWORD_COL_DIRECT 0 NO_COMPU_METHOD -32768 32767 /end CHARACTERISTIC
/begin CHARACTERISTIC DEBUGIN_HMI_ELK_RL2_LockingRequest "" VALUE 0x24000230 SWORD_COL_DIRECT 0 NO_COMPU_METHOD -32768 32767 /end CHARACTERISTIC
/begin CHARACTERISTIC DEBUGIN_HMI_ELK_RL2_LockingRequest_enable "" VALUE 0x2400022e SWORD_COL_DIRECT 0 NO_COMPU_METHOD -32768 32767 /end CHARACTERISTIC
/begin CHARACTERISTIC DEBUGIN_HMI_ELK_RR1_LockingRequest "" VALUE 0x24000236 SWORD_COL_DIRECT 0 NO_COMPU_METHOD -32768 32767 /end CHARACTERISTIC
/begin CHARACTERISTIC DEBUGIN_HMI_ELK_RR1_LockingRequest_enable "" VALUE 0x24000234 SWORD_COL_DIRECT 0 NO_COMPU_METHOD -32768 32767 /end CHARACTERISTIC
/begin CHARACTERISTIC DEBUGIN_HMI_ELK_Rx_Status "" VALUE 0x24000218 SWORD_COL_DIRECT 0 NO_COMPU_METHOD -32768 32767 /end CHARACTERISTIC
/begin CHARACTERISTIC DEBUGIN_HMI_ELK_Rx_Status_enable "" VALUE 0x24000216 SWORD_COL_DIRECT 0 NO_COMPU_METHOD -32768 32767 /end CHARACTERISTIC
/begin CHARACTERISTIC DEBUGIN_HMI_ISB_FL_AddressByte0_byte "" VALUE 0x24000272 SWORD_COL_DIRECT 0 NO_COMPU_METHOD -32768 32767 /end CHARACTERISTIC
/begin CHARACTERISTIC DEBUGIN_HMI_ISB_FL_AddressByte0_byte_enable "" VALUE 0x24000270 SWORD_COL_DIRECT 0 NO_COMPU_METHOD -32768 32767 /end CHARACTERISTIC
/begin CHARACTERISTIC DEBUGIN_HMI_ISB_FL_AddressByte1_byte "" VALUE 0x24000278 SWORD_COL_DIRECT 0 NO_COMPU_METHOD -32768 32767 /end CHARACTERISTIC
/begin CHARACTERISTIC DEBUGIN_HMI_ISB_FL_AddressByte1_byte_enable "" VALUE 0x24000276 SWORD_COL_DIRECT 0 NO_COMPU_METHOD -32768 32767 /end CHARACTERISTIC
/begin CHARACTERISTIC DEBUGIN_HMI_ISB_FL_ColorBlue_byte "" VALUE 0x2400024e SWORD_COL_DIRECT 0 NO_COMPU_METHOD -32768 32767 /end CHARACTERISTIC
/begin CHARACTERISTIC DEBUGIN_HMI_ISB_FL_ColorBlue_byte_enable "" VALUE 0x2400024c SWORD_COL_DIRECT 0 NO_COMPU_METHOD -32768 32767 /end CHARACTERISTIC
/begin CHARACTERISTIC DEBUGIN_HMI_ISB_FL_ColorGreen_byte "" VALUE 0x24000248 SWORD_COL_DIRECT 0 NO_COMPU_METHOD -32768 32767 /end CHARACTERISTIC
/begin CHARACTERISTIC DEBUGIN_HMI_ISB_FL_ColorGreen_byte_enable "" VALUE 0x24000246 SWORD_COL_DIRECT 0 NO_COMPU_METHOD -32768 32767 /end CHARACTERISTIC
/begin CHARACTERISTIC DEBUGIN_HMI_ISB_FL_ColorRed_byte "" VALUE 0x24000254 SWORD_COL_DIRECT 0 NO_COMPU_METHOD -32768 32767 /end CHARACTERISTIC
/begin CHARACTERISTIC DEBUGIN_HMI_ISB_FL_ColorRed_byte_enable "" VALUE 0x24000252 SWORD_COL_DIRECT 0 NO_COMPU_METHOD -32768 32767 /end CHARACTERISTIC
/begin CHARACTERISTIC DEBUGIN_HMI_ISB_FL_GroupOrModule_bool "" VALUE 0x2400026c SWORD_COL_DIRECT 0 NO_COMPU_METHOD -32768 32767 /end CHARACTERISTIC
/begin CHARACTERISTIC DEBUGIN_HMI_ISB_FL_GroupOrModule_bool_enable "" VALUE 0x2400026a SWORD_COL_DIRECT 0 NO_COMPU_METHOD -32768 32767 /end CHARACTERISTIC
/begin CHARACTERISTIC DEBUGIN_HMI_ISB_FL_Intensity_perc "" VALUE 0x2400025a SWORD_COL_DIRECT 0 NO_COMPU_METHOD -32768 32767 /end CHARACTERISTIC
/begin CHARACTERISTIC DEBUGIN_HMI_ISB_FL_Intensity_perc_enable "" VALUE 0x24000258 SWORD_COL_DIRECT 0 NO_COMPU_METHOD -32768 32767 /end CHARACTERISTIC
/begin CHARACTERISTIC DEBUGIN_HMI_ISB_FL_Normalization_bool "" VALUE 0x24000260 SWORD_COL_DIRECT 0 NO_COMPU_METHOD -32768 32767 /end CHARACTERISTIC
/begin CHARACTERISTIC DEBUGIN_HMI_ISB_FL_Normalization_bool_enable "" VALUE 0x2400025e SWORD_COL_DIRECT 0 NO_COMPU_METHOD -32768 32767 /end CHARACTERISTIC
/begin CHARACTERISTIC DEBUGIN_HMI_ISB_FL_Rx_Status "" VALUE 0x24000242 SWORD_COL_DIRECT 0 NO_COMPU_METHOD -32768 32767 /end CHARACTERISTIC
/begin CHARACTERISTIC DEBUGIN_HMI_ISB_FL_Rx_Status_enable "" VALUE 0x24000240 SWORD_COL_DIRECT 0 NO_COMPU_METHOD -32768 32767 /end CHARACTERISTIC
/begin CHARACTERISTIC DEBUGIN_HMI_ISB_FL_Transitionspeed_nibble "" VALUE 0x24000266 SWORD_COL_DIRECT 0 NO_COMPU_METHOD -32768 32767 /end CHARACTERISTIC
/begin CHARACTERISTIC DEBUGIN_HMI_ISB_FL_Transitionspeed_nibble_enable "" VALUE 0x24000264 SWORD_COL_DIRECT 0 NO_COMPU_METHOD -32768 32767 /end CHARACTERISTIC
/begin CHARACTERISTIC DEBUGIN_HMI_ISB_FR_AddressByte0 "" VALUE 0x240002ae SWORD_COL_DIRECT 0 NO_COMPU_METHOD -32768 32767 /end CHARACTERISTIC
/begin CHARACTERISTIC DEBUGIN_HMI_ISB_FR_AddressByte0_enable "" VALUE 0x240002ac SWORD_COL_DIRECT 0 NO_COMPU_METHOD -32768 32767 /end CHARACTERISTIC
/begin CHARACTERISTIC DEBUGIN_HMI_ISB_FR_AddressByte1 "" VALUE 0x240002b4 SWORD_COL_DIRECT 0 NO_COMPU_METHOD -32768 32767 /end CHARACTERISTIC
/begin CHARACTERISTIC DEBUGIN_HMI_ISB_FR_AddressByte1_enable "" VALUE 0x240002b2 SWORD_COL_DIRECT 0 NO_COMPU_METHOD -32768 32767 /end CHARACTERISTIC
/begin CHARACTERISTIC DEBUGIN_HMI_ISB_FR_ColorBlue "" VALUE 0x2400028a SWORD_COL_DIRECT 0 NO_COMPU_METHOD -32768 32767 /end CHARACTERISTIC
/begin CHARACTERISTIC DEBUGIN_HMI_ISB_FR_ColorBlue_enable "" VALUE 0x24000288 SWORD_COL_DIRECT 0 NO_COMPU_METHOD -32768 32767 /end CHARACTERISTIC
/begin CHARACTERISTIC DEBUGIN_HMI_ISB_FR_ColorGreen "" VALUE 0x24000284 SWORD_COL_DIRECT 0 NO_COMPU_METHOD -32768 32767 /end CHARACTERISTIC
/begin CHARACTERISTIC DEBUGIN_HMI_ISB_FR_ColorGreen_enable "" VALUE 0x24000282 SWORD_COL_DIRECT 0 NO_COMPU_METHOD -32768 32767 /end CHARACTERISTIC
/begin CHARACTERISTIC DEBUGIN_HMI_ISB_FR_ColorRed "" VALUE 0x24000290 SWORD_COL_DIRECT 0 NO_COMPU_METHOD -32768 32767 /end CHARACTERISTIC
/begin CHARACTERISTIC DEBUGIN_HMI_ISB_FR_ColorRed_enable "" VALUE 0x2400028e SWORD_COL_DIRECT 0 NO_COMPU_METHOD -32768 32767 /end CHARACTERISTIC
/begin CHARACTERISTIC DEBUGIN_HMI_ISB_FR_GroupOrModule "" VALUE 0x240002a8 SWORD_COL_DIRECT 0 NO_COMPU_METHOD -32768 32767 /end CHARACTERISTIC
/begin CHARACTERISTIC DEBUGIN_HMI_ISB_FR_GroupOrModule_enable "" VALUE 0x240002a6 SWORD_COL_DIRECT 0 NO_COMPU_METHOD -32768 32767 /end CHARACTERISTIC
/begin CHARACTERISTIC DEBUGIN_HMI_ISB_FR_Intensity_perc "" VALUE 0x24000296 SWORD_COL_DIRECT 0 NO_COMPU_METHOD -32768 32767 /end CHARACTERISTIC
/begin CHARACTERISTIC DEBUGIN_HMI_ISB_FR_Intensity_perc_enable "" VALUE 0x24000294 SWORD_COL_DIRECT 0 NO_COMPU_METHOD -32768 32767 /end CHARACTERISTIC
/begin CHARACTERISTIC DEBUGIN_HMI_ISB_FR_Normalization "" VALUE 0x2400029c SWORD_COL_DIRECT 0 NO_COMPU_METHOD -32768 32767 /end CHARACTERISTIC
/begin CHARACTERISTIC DEBUGIN_HMI_ISB_FR_Normalization_enable "" VALUE 0x2400029a SWORD_COL_DIRECT 0 NO_COMPU_METHOD -32768 32767 /end CHARACTERISTIC
/begin CHARACTERISTIC DEBUGIN_HMI_ISB_FR_Rx_Status "" VALUE 0x2400027e SWORD_COL_DIRECT 0 NO_COMPU_METHOD -32768 32767 /end CHARACTERISTIC
/begin CHARACTERISTIC DEBUGIN_HMI_ISB_FR_Rx_Status_enable "" VALUE 0x2400027c SWORD_COL_DIRECT 0 NO_COMPU_METHOD -32768 32767 /end CHARACTERISTIC
/begin CHARACTERISTIC DEBUGIN_HMI_ISB_FR_Transitionspeed "" VALUE 0x240002a2 SWORD_COL_DIRECT 0 NO_COMPU_METHOD -32768 32767 /end CHARACTERISTIC
/begin CHARACTERISTIC DEBUGIN_HMI_ISB_FR_Transitionspeed_enable "" VALUE 0x240002a0 SWORD_COL_DIRECT 0 NO_COMPU_METHOD -32768 32767 /end CHARACTERISTIC
/begin CHARACTERISTIC DEBUGIN_HMI_ISB_RL1_AddressByte0 "" VALUE 0x240002ea SWORD_COL_DIRECT 0 NO_COMPU_METHOD -32768 32767 /end CHARACTERISTIC
/begin CHARACTERISTIC DEBUGIN_HMI_ISB_RL1_AddressByte0_enable "" VALUE 0x240002e8 SWORD_COL_DIRECT 0 NO_COMPU_METHOD -32768 32767 /end CHARACTERISTIC
/begin CHARACTERISTIC DEBUGIN_HMI_ISB_RL1_AddressByte1 "" VALUE 0x240002f0 SWORD_COL_DIRECT 0 NO_COMPU_METHOD -32768 32767 /end CHARACTERISTIC
/begin CHARACTERISTIC DEBUGIN_HMI_ISB_RL1_AddressByte1_enable "" VALUE 0x240002ee SWORD_COL_DIRECT 0 NO_COMPU_METHOD -32768 32767 /end CHARACTERISTIC
/begin CHARACTERISTIC DEBUGIN_HMI_ISB_RL1_ColorBlue "" VALUE 0x240002c6 SWORD_COL_DIRECT 0 NO_COMPU_METHOD -32768 32767 /end CHARACTERISTIC
/begin CHARACTERISTIC DEBUGIN_HMI_ISB_RL1_ColorBlue_enable "" VALUE 0x240002c4 SWORD_COL_DIRECT 0 NO_COMPU_METHOD -32768 32767 /end CHARACTERISTIC
/begin CHARACTERISTIC DEBUGIN_HMI_ISB_RL1_ColorGreen "" VALUE 0x240002c0 SWORD_COL_DIRECT 0 NO_COMPU_METHOD -32768 32767 /end CHARACTERISTIC
/begin CHARACTERISTIC DEBUGIN_HMI_ISB_RL1_ColorGreen_enable "" VALUE 0x240002be SWORD_COL_DIRECT 0 NO_COMPU_METHOD -32768 32767 /end CHARACTERISTIC
/begin CHARACTERISTIC DEBUGIN_HMI_ISB_RL1_ColorRed "" VALUE 0x240002cc SWORD_COL_DIRECT 0 NO_COMPU_METHOD -32768 32767 /end CHARACTERISTIC
/begin CHARACTERISTIC DEBUGIN_HMI_ISB_RL1_ColorRed_enable "" VALUE 0x240002ca SWORD_COL_DIRECT 0 NO_COMPU_METHOD -32768 32767 /end CHARACTERISTIC
/begin CHARACTERISTIC DEBUGIN_HMI_ISB_RL1_GroupOrModule_enable "" VALUE 0x240002e2 SWORD_COL_DIRECT 0 NO_COMPU_METHOD -32768 32767 /end CHARACTERISTIC
/begin CHARACTERISTIC DEBUGIN_HMI_ISB_RL1_Intensity "" VALUE 0x240002d2 SWORD_COL_DIRECT 0 NO_COMPU_METHOD -32768 32767 /end CHARACTERISTIC
/begin CHARACTERISTIC DEBUGIN_HMI_ISB_RL1_Intensity_enable "" VALUE 0x240002d0 SWORD_COL_DIRECT 0 NO_COMPU_METHOD -32768 32767 /end CHARACTERISTIC
/begin CHARACTERISTIC DEBUGIN_HMI_ISB_RL1_Normalization "" VALUE 0x240002d8 SWORD_COL_DIRECT 0 NO_COMPU_METHOD -32768 32767 /end CHARACTERISTIC
/begin CHARACTERISTIC DEBUGIN_HMI_ISB_RL1_Normalization_enable "" VALUE 0x240002d6 SWORD_COL_DIRECT 0 NO_COMPU_METHOD -32768 32767 /end CHARACTERISTIC
/begin CHARACTERISTIC DEBUGIN_HMI_ISB_RL1_Rx_Status "" VALUE 0x240002ba SWORD_COL_DIRECT 0 NO_COMPU_METHOD -32768 32767 /end CHARACTERISTIC
/begin CHARACTERISTIC DEBUGIN_HMI_ISB_RL1_Rx_Status_enable "" VALUE 0x240002b8 SWORD_COL_DIRECT 0 NO_COMPU_METHOD -32768 32767 /end CHARACTERISTIC
/begin CHARACTERISTIC DEBUGIN_HMI_ISB_RL1_Transitionspeed "" VALUE 0x240002de SWORD_COL_DIRECT 0 NO_COMPU_METHOD -32768 32767 /end CHARACTERISTIC
/begin CHARACTERISTIC DEBUGIN_HMI_ISB_RL1_Transitionspeed_enable "" VALUE 0x240002dc SWORD_COL_DIRECT 0 NO_COMPU_METHOD -32768 32767 /end CHARACTERISTIC
/begin CHARACTERISTIC DEBUGIN_HMI_ISB_RL2_AddressByte0_enable "" VALUE 0x24000324 SWORD_COL_DIRECT 0 NO_COMPU_METHOD -32768 32767 /end CHARACTERISTIC
/begin CHARACTERISTIC DEBUGIN_HMI_ISB_RL2_AddressByte1_enable "" VALUE 0x2400032a SWORD_COL_DIRECT 0 NO_COMPU_METHOD -32768 32767 /end CHARACTERISTIC
/begin CHARACTERISTIC DEBUGIN_HMI_ISB_RL2_ColorBlue_enable "" VALUE 0x24000300 SWORD_COL_DIRECT 0 NO_COMPU_METHOD -32768 32767 /end CHARACTERISTIC
/begin CHARACTERISTIC DEBUGIN_HMI_ISB_RL2_ColorGreen_enable "" VALUE 0x240002fa SWORD_COL_DIRECT 0 NO_COMPU_METHOD -32768 32767 /end CHARACTERISTIC
/begin CHARACTERISTIC DEBUGIN_HMI_ISB_RL2_ColorRed_enable "" VALUE 0x24000306 SWORD_COL_DIRECT 0 NO_COMPU_METHOD -32768 32767 /end CHARACTERISTIC
/begin CHARACTERISTIC DEBUGIN_HMI_ISB_RL2_GroupOrModule_enable "" VALUE 0x2400031e SWORD_COL_DIRECT 0 NO_COMPU_METHOD -32768 32767 /end CHARACTERISTIC
/begin CHARACTERISTIC DEBUGIN_HMI_ISB_RL2_Intensity_enable "" VALUE 0x2400030c SWORD_COL_DIRECT 0 NO_COMPU_METHOD -32768 32767 /end CHARACTERISTIC
/begin CHARACTERISTIC DEBUGIN_HMI_ISB_RL2_Normalization_enable "" VALUE 0x24000312 SWORD_COL_DIRECT 0 NO_COMPU_METHOD -32768 32767 /end CHARACTERISTIC
/begin CHARACTERISTIC DEBUGIN_HMI_ISB_RL2_Rx_Status_enable "" VALUE 0x240002f4 SWORD_COL_DIRECT 0 NO_COMPU_METHOD -32768 32767 /end CHARACTERISTIC
/begin CHARACTERISTIC DEBUGIN_HMI_ISB_RL2_Transitionspeed_enable "" VALUE 0x24000318 SWORD_COL_DIRECT 0 NO_COMPU_METHOD -32768 32767 /end CHARACTERISTIC
/begin CHARACTERISTIC DEBUGIN_HMI_ISB_RR1_AddressByte0_enable "" VALUE 0x24000360 SWORD_COL_DIRECT 0 NO_COMPU_METHOD -32768 32767 /end CHARACTERISTIC
/begin CHARACTERISTIC DEBUGIN_HMI_ISB_RR1_AddressByte1_enable "" VALUE 0x24000366 SWORD_COL_DIRECT 0 NO_COMPU_METHOD -32768 32767 /end CHARACTERISTIC
/begin CHARACTERISTIC DEBUGIN_HMI_ISB_RR1_ColorBlue_enable "" VALUE 0x2400033c SWORD_COL_DIRECT 0 NO_COMPU_METHOD -32768 32767 /end CHARACTERISTIC
/begin CHARACTERISTIC DEBUGIN_HMI_ISB_RR1_ColorGreen_enable "" VALUE 0x24000336 SWORD_COL_DIRECT 0 NO_COMPU_METHOD -32768 32767 /end CHARACTERISTIC
/begin CHARACTERISTIC DEBUGIN_HMI_ISB_RR1_ColorRed_enable "" VALUE 0x24000342 SWORD_COL_DIRECT 0 NO_COMPU_METHOD -32768 32767 /end CHARACTERISTIC
/begin CHARACTERISTIC DEBUGIN_HMI_ISB_RR1_GroupOrModule_enable "" VALUE 0x2400035a SWORD_COL_DIRECT 0 NO_COMPU_METHOD -32768 32767 /end CHARACTERISTIC
/begin CHARACTERISTIC DEBUGIN_HMI_ISB_RR1_Intensity_enable "" VALUE 0x24000348 SWORD_COL_DIRECT 0 NO_COMPU_METHOD -32768 32767 /end CHARACTERISTIC
/begin CHARACTERISTIC DEBUGIN_HMI_ISB_RR1_Normalization_enable "" VALUE 0x2400034e SWORD_COL_DIRECT 0 NO_COMPU_METHOD -32768 32767 /end CHARACTERISTIC
/begin CHARACTERISTIC DEBUGIN_HMI_ISB_RR1_Rx_Status_enable "" VALUE 0x24000330 SWORD_COL_DIRECT 0 NO_COMPU_METHOD -32768 32767 /end CHARACTERISTIC
/begin CHARACTERISTIC DEBUGIN_HMI_ISB_RR1_Transitionspeed_enable "" VALUE 0x24000354 SWORD_COL_DIRECT 0 NO_COMPU_METHOD -32768 32767 /end CHARACTERISTIC
/begin CHARACTERISTIC DEBUGIN_HMI_SEAL_ActivationRequest_enable "" VALUE 0x2400036c SWORD_COL_DIRECT 0 NO_COMPU_METHOD -32768 32767 /end CHARACTERISTIC
/begin CHARACTERISTIC DEBUGIN_OMS_FL_HandsOnWheel_enable "" VALUE 0x24000390 SWORD_COL_DIRECT 0 NO_COMPU_METHOD -32768 32767 /end CHARACTERISTIC
/begin CHARACTERISTIC DEBUGIN_OMS_FL_OccupantClassification_enable "" VALUE 0x24000396 SWORD_COL_DIRECT 0 NO_COMPU_METHOD -32768 32767 /end CHARACTERISTIC
/begin CHARACTERISTIC DEBUGIN_OMS_FL_OccupantHeightMean_cm_enable "" VALUE 0x24000432 SWORD_COL_DIRECT 0 NO_COMPU_METHOD -32768 32767 /end CHARACTERISTIC
/begin CHARACTERISTIC DEBUGIN_OMS_FL_OccupantHeightStd_cm_enable "" VALUE 0x2400042c SWORD_COL_DIRECT 0 NO_COMPU_METHOD -32768 32767 /end CHARACTERISTIC
/begin CHARACTERISTIC DEBUGIN_OMS_FL_OccupantPresence_enable "" VALUE 0x240003b4 SWORD_COL_DIRECT 0 NO_COMPU_METHOD -32768 32767 /end CHARACTERISTIC
/begin CHARACTERISTIC DEBUGIN_OMS_FL_OccupantWeightMean_kg_enable "" VALUE 0x240003f6 SWORD_COL_DIRECT 0 NO_COMPU_METHOD -32768 32767 /end CHARACTERISTIC
/begin CHARACTERISTIC DEBUGIN_OMS_FL_OccupantWeightStd_kg_enable "" VALUE 0x240003f0 SWORD_COL_DIRECT 0 NO_COMPU_METHOD -32768 32767 /end CHARACTERISTIC
/begin CHARACTERISTIC DEBUGIN_OMS_FL_OutOfPosition_enable "" VALUE 0x240003d2 SWORD_COL_DIRECT 0 NO_COMPU_METHOD -32768 32767 /end CHARACTERISTIC
/begin CHARACTERISTIC DEBUGIN_OMS_FL_Rx_Status_enable "" VALUE 0x24000372 SWORD_COL_DIRECT 0 NO_COMPU_METHOD -32768 32767 /end CHARACTERISTIC
/begin CHARACTERISTIC DEBUGIN_OMS_FR_OccupantClassification_enable "" VALUE 0x2400039c SWORD_COL_DIRECT 0 NO_COMPU_METHOD -32768 32767 /end CHARACTERISTIC
/begin CHARACTERISTIC DEBUGIN_OMS_FR_OccupantHeightMean_cm_enable "" VALUE 0x2400043e SWORD_COL_DIRECT 0 NO_COMPU_METHOD -32768 32767 /end CHARACTERISTIC
/begin CHARACTERISTIC DEBUGIN_OMS_FR_OccupantHeightStd_cm_enable "" VALUE 0x24000438 SWORD_COL_DIRECT 0 NO_COMPU_METHOD -32768 32767 /end CHARACTERISTIC
/begin CHARACTERISTIC DEBUGIN_OMS_FR_OccupantPresence_enable "" VALUE 0x240003ba SWORD_COL_DIRECT 0 NO_COMPU_METHOD -32768 32767 /end CHARACTERISTIC
/begin CHARACTERISTIC DEBUGIN_OMS_FR_OccupantWeightMean_kg_enable "" VALUE 0x24000402 SWORD_COL_DIRECT 0 NO_COMPU_METHOD -32768 32767 /end CHARACTERISTIC
/begin CHARACTERISTIC DEBUGIN_OMS_FR_OccupantWeightStd_kg_enable "" VALUE 0x240003fc SWORD_COL_DIRECT 0 NO_COMPU_METHOD -32768 32767 /end CHARACTERISTIC
/begin CHARACTERISTIC DEBUGIN_OMS_FR_OutOfPosition_enable "" VALUE 0x240003d8 SWORD_COL_DIRECT 0 NO_COMPU_METHOD -32768 32767 /end CHARACTERISTIC
/begin CHARACTERISTIC DEBUGIN_OMS_FR_Rx_Status_enable "" VALUE 0x24000378 SWORD_COL_DIRECT 0 NO_COMPU_METHOD -32768 32767 /end CHARACTERISTIC
/begin CHARACTERISTIC DEBUGIN_OMS_RL1_OccupantClassification_enable "" VALUE 0x240003a2 SWORD_COL_DIRECT 0 NO_COMPU_METHOD -32768 32767 /end CHARACTERISTIC
/begin CHARACTERISTIC DEBUGIN_OMS_RL1_OccupantHeightMean_cm_enable "" VALUE 0x2400044a SWORD_COL_DIRECT 0 NO_COMPU_METHOD -32768 32767 /end CHARACTERISTIC
/begin CHARACTERISTIC DEBUGIN_OMS_RL1_OccupantHeightStd_cm_enable "" VALUE 0x24000444 SWORD_COL_DIRECT 0 NO_COMPU_METHOD -32768 32767 /end CHARACTERISTIC
/begin CHARACTERISTIC DEBUGIN_OMS_RL1_OccupantPresence_enable "" VALUE 0x240003c0 SWORD_COL_DIRECT 0 NO_COMPU_METHOD -32768 32767 /end CHARACTERISTIC
/begin CHARACTERISTIC DEBUGIN_OMS_RL1_OccupantWeightMean_kg_enable "" VALUE 0x2400040e SWORD_COL_DIRECT 0 NO_COMPU_METHOD -32768 32767 /end CHARACTERISTIC
/begin CHARACTERISTIC DEBUGIN_OMS_RL1_OccupantWeightStd_kg_enable "" VALUE 0x24000408 SWORD_COL_DIRECT 0 NO_COMPU_METHOD -32768 32767 /end CHARACTERISTIC
/begin CHARACTERISTIC DEBUGIN_OMS_RL1_OutOfPosition_enable "" VALUE 0x240003de SWORD_COL_DIRECT 0 NO_COMPU_METHOD -32768 32767 /end CHARACTERISTIC
/begin CHARACTERISTIC DEBUGIN_OMS_RL1_Rx_Status_enable "" VALUE 0x2400037e SWORD_COL_DIRECT 0 NO_COMPU_METHOD -32768 32767 /end CHARACTERISTIC
/begin CHARACTERISTIC DEBUGIN_OMS_RL2_OccupantClassification_enable "" VALUE 0x240003a8 SWORD_COL_DIRECT 0 NO_COMPU_METHOD -32768 32767 /end CHARACTERISTIC
/begin CHARACTERISTIC DEBUGIN_OMS_RL2_OccupantHeightMean_cm_enable "" VALUE 0x24000456 SWORD_COL_DIRECT 0 NO_COMPU_METHOD -32768 32767 /end CHARACTERISTIC
/begin CHARACTERISTIC DEBUGIN_OMS_RL2_OccupantHeightStd_cm_enable "" VALUE 0x24000450 SWORD_COL_DIRECT 0 NO_COMPU_METHOD -32768 32767 /end CHARACTERISTIC
/begin CHARACTERISTIC DEBUGIN_OMS_RL2_OccupantPresence_enable "" VALUE 0x240003c6 SWORD_COL_DIRECT 0 NO_COMPU_METHOD -32768 32767 /end CHARACTERISTIC
/begin CHARACTERISTIC DEBUGIN_OMS_RL2_OccupantWeightMean_kg_enable "" VALUE 0x2400041a SWORD_COL_DIRECT 0 NO_COMPU_METHOD -32768 32767 /end CHARACTERISTIC
/begin CHARACTERISTIC DEBUGIN_OMS_RL2_OccupantWeightStd_kg_enable "" VALUE 0x24000414 SWORD_COL_DIRECT 0 NO_COMPU_METHOD -32768 32767 /end CHARACTERISTIC
/begin CHARACTERISTIC DEBUGIN_OMS_RL2_OutOfPosition_enable "" VALUE 0x240003e4 SWORD_COL_DIRECT 0 NO_COMPU_METHOD -32768 32767 /end CHARACTERISTIC
/begin CHARACTERISTIC DEBUGIN_OMS_RL2_Rx_Status_enable "" VALUE 0x24000384 SWORD_COL_DIRECT 0 NO_COMPU_METHOD -32768 32767 /end CHARACTERISTIC
/begin CHARACTERISTIC DEBUGIN_OMS_RR1_OccupantClassification_enable "" VALUE 0x240003ae SWORD_COL_DIRECT 0 NO_COMPU_METHOD -32768 32767 /end CHARACTERISTIC
/begin CHARACTERISTIC DEBUGIN_OMS_RR1_OccupantHeightMean_cm_enable "" VALUE 0x24000462 SWORD_COL_DIRECT 0 NO_COMPU_METHOD -32768 32767 /end CHARACTERISTIC
/begin CHARACTERISTIC DEBUGIN_OMS_RR1_OccupantHeightStd_cm_enable "" VALUE 0x2400045c SWORD_COL_DIRECT 0 NO_COMPU_METHOD -32768 32767 /end CHARACTERISTIC
/begin CHARACTERISTIC DEBUGIN_OMS_RR1_OccupantPresence_enable "" VALUE 0x240003cc SWORD_COL_DIRECT 0 NO_COMPU_METHOD -32768 32767 /end CHARACTERISTIC
/begin CHARACTERISTIC DEBUGIN_OMS_RR1_OccupantWeightMean_kg_enable "" VALUE 0x24000426 SWORD_COL_DIRECT 0 NO_COMPU_METHOD -32768 32767 /end CHARACTERISTIC
/begin CHARACTERISTIC DEBUGIN_OMS_RR1_OccupantWeightStd_kg_enable "" VALUE 0x24000420 SWORD_COL_DIRECT 0 NO_COMPU_METHOD -32768 32767 /end CHARACTERISTIC
/begin CHARACTERISTIC DEBUGIN_OMS_RR1_OutOfPosition_enable "" VALUE 0x240003ea SWORD_COL_DIRECT 0 NO_COMPU_METHOD -32768 32767 /end CHARACTERISTIC
/begin CHARACTERISTIC DEBUGIN_OMS_RR1_Rx_Status_enable "" VALUE 0x2400038a SWORD_COL_DIRECT 0 NO_COMPU_METHOD -32768 32767 /end CHARACTERISTIC
/begin CHARACTERISTIC DEBUGIN_Vehicle_BuckleStatusFL "Status of the buckle switch on the driver side.  0 - OK (Seatbelt fastened) 1 - NOT (Seatbelt not fastened) 2 - FLT (Buckle switch fault) 3 - SNA" VALUE 0x24000169 UBYTE_COL_DIRECT 0 NO_COMPU_METHOD 0 3 /end CHARACTERISTIC
/begin CHARACTERISTIC DEBUGIN_Vehicle_BuckleStatusFL_Enabled "" VALUE 0x24000168 UBYTE_COL_DIRECT 0 NO_COMPU_METHOD 0 1 /end CHARACTERISTIC
/begin CHARACTERISTIC DEBUGIN_Vehicle_BuckleStatusFR "Status of the buckle switch on the passenger side.  0 - OK (Seatbelt fastened) 1 - NOT (Seatbelt not fastened) 2 - FLT (Buckle switch fault) 3 - SNA" VALUE 0x2400016b UBYTE_COL_DIRECT 0 NO_COMPU_METHOD 0 3 /end CHARACTERISTIC
/begin CHARACTERISTIC DEBUGIN_Vehicle_BuckleStatusFR_Enabled "" VALUE 0x2400016a UBYTE_COL_DIRECT 0 NO_COMPU_METHOD 0 1 /end CHARACTERISTIC
/begin CHARACTERISTIC DEBUGIN_Vehicle_BuckleStatusRL1 "" VALUE 0x2400016d UBYTE_COL_DIRECT 0 NO_COMPU_METHOD 0 1 /end CHARACTERISTIC
/begin CHARACTERISTIC DEBUGIN_Vehicle_BuckleStatusRL1_Enabled "" VALUE 0x2400016c UBYTE_COL_DIRECT 0 NO_COMPU_METHOD 0 1 /end CHARACTERISTIC
/begin CHARACTERISTIC DEBUGIN_Vehicle_BuckleStatusRL2 "" VALUE 0x2400016f UBYTE_COL_DIRECT 0 NO_COMPU_METHOD 0 1 /end CHARACTERISTIC
/begin CHARACTERISTIC DEBUGIN_Vehicle_BuckleStatusRL2_Enabled "" VALUE 0x2400016e UBYTE_COL_DIRECT 0 NO_COMPU_METHOD 0 1 /end CHARACTERISTIC
/begin CHARACTERISTIC DEBUGIN_Vehicle_BuckleStatusRR1 "" VALUE 0x24000171 UBYTE_COL_DIRECT 0 NO_COMPU_METHOD 0 1 /end CHARACTERISTIC
/begin CHARACTERISTIC DEBUGIN_Vehicle_BuckleStatusRR1_Enabled "" VALUE 0x24000170 UBYTE_COL_DIRECT 0 NO_COMPU_METHOD 0 1 /end CHARACTERISTIC
/begin CHARACTERISTIC Enable_RetractReq_ADAS_Junc_MultipleLanes "" VALUE 0x2400000b UBYTE_COL_DIRECT 0 NO_COMPU_METHOD 0 1 /end CHARACTERISTIC
/begin CHARACTERISTIC ESP_ASR_Logic_inactive "" VALUE 0x2400018a UBYTE_COL_DIRECT 0 NO_COMPU_METHOD 0 1 /end CHARACTERISTIC
/begin CHARACTERISTIC PARAM_VS_BRK_ACC_BRK_switch_time_ms "Time interval within a high brake pressure gradient has to be\ndetected after detection of a fast accelerator pedal change.\nUsed as a necessary condition to detect EPB." VALUE 0x24016117 UBYTE_COL_DIRECT 0 EQ_LSB_10 0 2550 /end CHARACTERISTIC
/begin CHARACTERISTIC PARAM_VS_BRK_BRK_EPBD_Del_msec_1 "Duration of the EPB high brake pressure gradient detection." VALUE 0x24016115 UBYTE_COL_DIRECT 0 EQ_LSB_10 0 2550 /end CHARACTERISTIC
/begin CHARACTERISTIC PARAM_VS_BRK_EPB_Delay_ms "" VALUE 0x2401610f UBYTE_COL_DIRECT 0 EQ_LSB_10 0 2550 /end CHARACTERISTIC
/begin CHARACTERISTIC PARAM_VS_BRK_IBD_BRK_accel_delay_ms "Delay for low decceleration detection used to detect IB." VALUE 0x2401610c UBYTE_COL_DIRECT 0 EQ_LSB_10 0 2550 /end CHARACTERISTIC
/begin CHARACTERISTIC PARAM_VS_BRK_IBD_BRK_signal_delay_ms "Delay for high brake pressure detection used to detect IB." VALUE 0x24016109 UBYTE_COL_DIRECT 0 EQ_LSB_10 0 2550 /end CHARACTERISTIC
/begin CHARACTERISTIC PARAM_VS_critical_speed_factor_Req_ADAS_Junc "critical speed factor for Request ADAS Junction" VALUE 0x2400000e UWORD_COL_DIRECT 0 ALS_VehicleSped_factor 0 5 /end CHARACTERISTIC
/begin CHARACTERISTIC PARAM_VS_Indicator_Activation_Offset_s "Parameter to set Offset [s] before a Junction to define a valid window for raising Indicator." VALUE 0x24000010 UWORD_COL_DIRECT 0 ALS_Pretime_Activation_s_a 0 16383.75 /end CHARACTERISTIC
/begin CHARACTERISTIC PARAM_VS_Pretime_Junction_Activation_s "Parameter to set Pretime before Activation of a Junction Request [s]. Critical Speed for related turnangle and part of route or indicator musst be active" VALUE 0x24000012 UBYTE_COL_DIRECT 0 ALS_Pretime_Activation_s 0 63.75 /end CHARACTERISTIC
/begin CHARACTERISTIC PARAM_VS_Pretime_Roundabout_Activation_s "Parameter to set Pretime before Activation of a Junction Request [s]. Critical Speed for related turnangle of a roundabout " VALUE 0x2400000c UBYTE_COL_DIRECT 0 ALS_Pretime_Activation_s 0 63.75 /end CHARACTERISTIC
/begin CHARACTERISTIC SELK_Manager11_DEBUGIN_Error_detected_enable "" VALUE 0x24015ede SWORD_COL_DIRECT 0 NO_COMPU_METHOD -32768 32767 /end CHARACTERISTIC
/begin CHARACTERISTIC SELK_Manager22_DEBUGIN_Error_detected_enable "" VALUE 0x24015ee6 SWORD_COL_DIRECT 0 NO_COMPU_METHOD -32768 32767 /end CHARACTERISTIC
/begin CHARACTERISTIC SELK_Manager33_DEBUGIN_Error_detected_enable "" VALUE 0x24015eee SWORD_COL_DIRECT 0 NO_COMPU_METHOD -32768 32767 /end CHARACTERISTIC
/begin CHARACTERISTIC XCP_ABL_RL1_OperationRequest "" VALUE 0x24016026 SWORD_COL_DIRECT 0 NO_COMPU_METHOD 0 255 /end CHARACTERISTIC
/begin CHARACTERISTIC XCP_ABL_RL1_OperationRequest_Override "" VALUE 0x24016024 UBYTE_COL_DIRECT 0 NO_COMPU_METHOD 0 1 /end CHARACTERISTIC
/begin CHARACTERISTIC XCP_ABL_RL2_OperationRequest "" VALUE 0x2401608a SWORD_COL_DIRECT 0 NO_COMPU_METHOD 0 255 /end CHARACTERISTIC
/begin CHARACTERISTIC XCP_ABL_RL2_OperationRequest_Override "" VALUE 0x24016088 UBYTE_COL_DIRECT 0 NO_COMPU_METHOD 0 1 /end CHARACTERISTIC
/begin CHARACTERISTIC XCP_ABL_RR1_OperationRequest "" VALUE 0x24015ffa SWORD_COL_DIRECT 0 NO_COMPU_METHOD 0 255 /end CHARACTERISTIC
/begin CHARACTERISTIC XCP_ABL_RR1_OperationRequest_Override "" VALUE 0x24015ff8 UBYTE_COL_DIRECT 0 NO_COMPU_METHOD 0 1 /end CHARACTERISTIC
/begin CHARACTERISTIC XCP_ACB_FL_OperationRequest "" VALUE 0x24015fce SWORD_COL_DIRECT 0 NO_COMPU_METHOD 0 255 /end CHARACTERISTIC
/begin CHARACTERISTIC XCP_ACB_FL_OperationRequest_Override "" VALUE 0x24015fcc UBYTE_COL_DIRECT 0 NO_COMPU_METHOD 0 1 /end CHARACTERISTIC
/begin CHARACTERISTIC XCP_ACB_FR_OperationRequest "" VALUE 0x24015f8a SWORD_COL_DIRECT 0 NO_COMPU_METHOD 0 255 /end CHARACTERISTIC
/begin CHARACTERISTIC XCP_ACB_FR_OperationRequest_Override "" VALUE 0x24015f88 UBYTE_COL_DIRECT 0 NO_COMPU_METHOD 0 1 /end CHARACTERISTIC
/begin CHARACTERISTIC XCP_ACR_FL_OperationRequest "" VALUE 0x24016086 SWORD_COL_DIRECT 0 NO_COMPU_METHOD 0 255 /end CHARACTERISTIC
/begin CHARACTERISTIC XCP_ACR_FL_OperationRequest_Override "" VALUE 0x24016084 UBYTE_COL_DIRECT 0 NO_COMPU_METHOD 0 1 /end CHARACTERISTIC
/begin CHARACTERISTIC XCP_ACR_FR_OperationRequest "" VALUE 0x24016082 SWORD_COL_DIRECT 0 NO_COMPU_METHOD 0 255 /end CHARACTERISTIC
/begin CHARACTERISTIC XCP_ACR_FR_OperationRequest_Override "" VALUE 0x24016080 UBYTE_COL_DIRECT 0 NO_COMPU_METHOD 0 1 /end CHARACTERISTIC
/begin CHARACTERISTIC XCP_ACR_RL1_OperationRequest "" VALUE 0x2401607e SWORD_COL_DIRECT 0 NO_COMPU_METHOD 0 255 /end CHARACTERISTIC
/begin CHARACTERISTIC XCP_ACR_RL1_OperationRequest_Override "" VALUE 0x2401607c UBYTE_COL_DIRECT 0 NO_COMPU_METHOD 0 1 /end CHARACTERISTIC
/begin CHARACTERISTIC XCP_ACR_RL2_OperationRequest "" VALUE 0x2401608e SWORD_COL_DIRECT 0 NO_COMPU_METHOD 0 255 /end CHARACTERISTIC
/begin CHARACTERISTIC XCP_ACR_RL2_OperationRequest_Override "" VALUE 0x2401608c UBYTE_COL_DIRECT 0 NO_COMPU_METHOD 0 1 /end CHARACTERISTIC
/begin CHARACTERISTIC XCP_ACR_RR1_OperationRequest "" VALUE 0x24016052 SWORD_COL_DIRECT 0 NO_COMPU_METHOD 0 255 /end CHARACTERISTIC
/begin CHARACTERISTIC XCP_ACR_RR1_OperationRequest_Override "" VALUE 0x24016050 UBYTE_COL_DIRECT 0 NO_COMPU_METHOD 0 1 /end CHARACTERISTIC
/begin CHARACTERISTIC XCP_in_ACB_CAN_Awake_Sa534 "" VALUE 0x240004d0 UBYTE_COL_DIRECT 0 NO_COMPU_METHOD 0 1 /end CHARACTERISTIC
/begin CHARACTERISTIC XCP_in_ACB_CAN_Awake_Sa535 "" VALUE 0x24000500 UBYTE_COL_DIRECT 0 NO_COMPU_METHOD 0 1 /end CHARACTERISTIC
/begin CHARACTERISTIC XCP_in_ACB_CAN_Awake_Sa536 "" VALUE 0x24000530 UBYTE_COL_DIRECT 0 NO_COMPU_METHOD 0 1 /end CHARACTERISTIC
/begin CHARACTERISTIC XCP_in_ACB_CAN_Awake_Sa537 "" VALUE 0x24000560 UBYTE_COL_DIRECT 0 NO_COMPU_METHOD 0 1 /end CHARACTERISTIC
/begin CHARACTERISTIC XCP_in_ACB_CAN_Awake_Sa538 "" VALUE 0x24000590 UBYTE_COL_DIRECT 0 NO_COMPU_METHOD 0 1 /end CHARACTERISTIC
/begin CHARACTERISTIC XCP_in_ACB_CarSpeed_Sa534 "" VALUE 0x240004b1 UBYTE_COL_DIRECT 0 NO_COMPU_METHOD 0 255 /end CHARACTERISTIC
/begin CHARACTERISTIC XCP_in_ACB_CarSpeed_Sa535 "" VALUE 0x240004e1 UBYTE_COL_DIRECT 0 NO_COMPU_METHOD 0 255 /end CHARACTERISTIC
/begin CHARACTERISTIC XCP_in_ACB_CarSpeed_Sa536 "" VALUE 0x24000511 UBYTE_COL_DIRECT 0 NO_COMPU_METHOD 0 255 /end CHARACTERISTIC
/begin CHARACTERISTIC XCP_in_ACB_CarSpeed_Sa537 "" VALUE 0x24000541 UBYTE_COL_DIRECT 0 NO_COMPU_METHOD 0 255 /end CHARACTERISTIC
/begin CHARACTERISTIC XCP_in_ACB_CarSpeed_Sa538 "" VALUE 0x24000571 UBYTE_COL_DIRECT 0 NO_COMPU_METHOD 0 255 /end CHARACTERISTIC
/begin CHARACTERISTIC XCP_in_ACB_CLkS_LK_Sa534 "" VALUE 0x240004c8 UBYTE_COL_DIRECT 0 NO_COMPU_METHOD 0 1 /end CHARACTERISTIC
/begin CHARACTERISTIC XCP_in_ACB_CLkS_LK_Sa535 "" VALUE 0x240004f8 UBYTE_COL_DIRECT 0 NO_COMPU_METHOD 0 1 /end CHARACTERISTIC
/begin CHARACTERISTIC XCP_in_ACB_CLkS_LK_Sa536 "" VALUE 0x24000528 UBYTE_COL_DIRECT 0 NO_COMPU_METHOD 0 1 /end CHARACTERISTIC
/begin CHARACTERISTIC XCP_in_ACB_CLkS_LK_Sa537 "" VALUE 0x24000558 UBYTE_COL_DIRECT 0 NO_COMPU_METHOD 0 1 /end CHARACTERISTIC
/begin CHARACTERISTIC XCP_in_ACB_CLkS_LK_Sa538 "" VALUE 0x24000588 UBYTE_COL_DIRECT 0 NO_COMPU_METHOD 0 1 /end CHARACTERISTIC
/begin CHARACTERISTIC XCP_in_ACB_ISw_Stat_Sa534 "" VALUE 0x240004b0 UBYTE_COL_DIRECT 0 NO_COMPU_METHOD 0 255 /end CHARACTERISTIC
/begin CHARACTERISTIC XCP_in_ACB_ISw_Stat_Sa535 "" VALUE 0x240004e0 UBYTE_COL_DIRECT 0 NO_COMPU_METHOD 0 255 /end CHARACTERISTIC
/begin CHARACTERISTIC XCP_in_ACB_ISw_Stat_Sa536 "" VALUE 0x24000510 UBYTE_COL_DIRECT 0 NO_COMPU_METHOD 0 255 /end CHARACTERISTIC
/begin CHARACTERISTIC XCP_in_ACB_ISw_Stat_Sa537 "" VALUE 0x24000540 UBYTE_COL_DIRECT 0 NO_COMPU_METHOD 0 255 /end CHARACTERISTIC
/begin CHARACTERISTIC XCP_in_ACB_ISw_Stat_Sa538 "" VALUE 0x24000570 UBYTE_COL_DIRECT 0 NO_COMPU_METHOD 0 255 /end CHARACTERISTIC
/begin CHARACTERISTIC XCP_in_ACB_Open_Door_Sa534 "" VALUE 0x240004c9 UBYTE_COL_DIRECT 0 NO_COMPU_METHOD 0 1 /end CHARACTERISTIC
/begin CHARACTERISTIC XCP_in_ACB_Open_Door_Sa535 "" VALUE 0x240004f9 UBYTE_COL_DIRECT 0 NO_COMPU_METHOD 0 1 /end CHARACTERISTIC
/begin CHARACTERISTIC XCP_in_ACB_Open_Door_Sa536 "" VALUE 0x24000529 UBYTE_COL_DIRECT 0 NO_COMPU_METHOD 0 1 /end CHARACTERISTIC
/begin CHARACTERISTIC XCP_in_ACB_Open_Door_Sa537 "" VALUE 0x24000559 UBYTE_COL_DIRECT 0 NO_COMPU_METHOD 0 1 /end CHARACTERISTIC
/begin CHARACTERISTIC XCP_in_ACB_Open_Door_Sa538 "" VALUE 0x24000589 UBYTE_COL_DIRECT 0 NO_COMPU_METHOD 0 1 /end CHARACTERISTIC
/begin MEASUREMENT ACR_ABL_Prioritization_FL_Debug_PRI_WeightClass "" SBYTE NO_COMPU_METHOD 1 100 -128 127 ECU_ADDRESS 0x2402712d /end MEASUREMENT
/begin MEASUREMENT ACR_ABL_Prioritization_FL_DEBUGOUT_PRI_Out_ACR_Retract "" UBYTE NO_COMPU_METHOD 1 100 0 255 ECU_ADDRESS 0x240271a2 /end MEASUREMENT
/begin MEASUREMENT ACR_ABL_Prioritization_FR_Debug_PRI_WeightClass "" SBYTE NO_COMPU_METHOD 1 100 -128 127 ECU_ADDRESS 0x24027150 /end MEASUREMENT
/begin MEASUREMENT ACR_ABL_Prioritization_FR_DEBUGOUT_PRI_Out_ACR_Retract "" UBYTE NO_COMPU_METHOD 1 100 0 255 ECU_ADDRESS 0x2402723d /end MEASUREMENT
/begin MEASUREMENT ACR_ABL_Prioritization_RL1_Debug_PRI_WeightClass "" SBYTE NO_COMPU_METHOD 1 100 -128 127 ECU_ADDRESS 0x24027222 /end MEASUREMENT
/begin MEASUREMENT ACR_ABL_Prioritization_RL1_DEBUGOUT_PRI_Out_ACR_Retract "" UBYTE NO_COMPU_METHOD 1 100 0 255 ECU_ADDRESS 0x2402729b /end MEASUREMENT
/begin MEASUREMENT ACR_ABL_Prioritization_RL2_Debug_PRI_WeightClass "" SBYTE NO_COMPU_METHOD 1 100 -128 127 ECU_ADDRESS 0x24027201 /end MEASUREMENT
/begin MEASUREMENT ACR_ABL_Prioritization_RL2_DEBUGOUT_PRI_Out_ACR_Retract "" UBYTE NO_COMPU_METHOD 1 100 0 255 ECU_ADDRESS 0x240271c6 /end MEASUREMENT
/begin MEASUREMENT ACR_ABL_Prioritization_RR1_Debug_PRI_WeightClass "" SBYTE NO_COMPU_METHOD 1 100 -128 127 ECU_ADDRESS 0x2402719c /end MEASUREMENT
/begin MEASUREMENT ACR_ABL_Prioritization_RR1_DEBUGOUT_PRI_Out_ACR_Retract "" UBYTE NO_COMPU_METHOD 1 100 0 255 ECU_ADDRESS 0x240272ce /end MEASUREMENT
/begin MEASUREMENT ADAS_Posn_Offset_FallingEdge "" SWORD NO_COMPU_METHOD 1 100 -32768 32767 ECU_ADDRESS 0x24026b96 /end MEASUREMENT
/begin MEASUREMENT ADHOW_L3_set "" UBYTE NO_COMPU_METHOD 1 100 0 1 ECU_ADDRESS 0x240162ea /end MEASUREMENT
/begin MEASUREMENT angel_2_speed "" UWORD EQ_LSB_0_01 1 100 0 655.35 ECU_ADDRESS 0x24025bbe /end MEASUREMENT
/begin MEASUREMENT Array_ADAS_Curv_Offset "" SWORD NO_COMPU_METHOD 1 100 -32768 32767 ECU_ADDRESS 0x240253e0 ARRAY_SIZE 1000 /end MEASUREMENT
/begin MEASUREMENT Array_ADAS_Curv_PathIdx "" SWORD NO_COMPU_METHOD 1 100 -32768 32767 ECU_ADDRESS 0x24025be8 ARRAY_SIZE 1000 /end MEASUREMENT
/begin MEASUREMENT Array_ADAS_Curv_Value "" SWORD NO_COMPU_METHOD 1 100 -32768 32767 ECU_ADDRESS 0x240263bc ARRAY_SIZE 1000 /end MEASUREMENT
/begin MEASUREMENT Curv_remind_Initial_index "" SWORD NO_COMPU_METHOD 1 100 -32768 32767 ECU_ADDRESS 0x24025bdc /end MEASUREMENT
/begin MEASUREMENT Debug_ADAS_Seg_Retr "" UBYTE NO_COMPU_METHOD 1 100 0 255 ECU_ADDRESS 0x24024ccf /end MEASUREMENT
/begin MEASUREMENT Debug_AibagClose_True "" UBYTE NO_COMPU_METHOD 1 100 0 255 ECU_ADDRESS 0x24026d16 /end MEASUREMENT
/begin MEASUREMENT Debug_ALI_ISw_Stat "" UBYTE NO_COMPU_METHOD 1 100 0 255 ECU_ADDRESS 0x24026d60 /end MEASUREMENT
/begin MEASUREMENT Debug_Driving_on_CountryRoad "" UBYTE NO_COMPU_METHOD 1 100 0 1 ECU_ADDRESS 0x24025bc8 /end MEASUREMENT
/begin MEASUREMENT Debug_FNCActivationLevel "" UBYTE NO_COMPU_METHOD 1 100 0 255 ECU_ADDRESS 0x24026bf6 /end MEASUREMENT
/begin MEASUREMENT Debug_LeanLeft_True "" UBYTE NO_COMPU_METHOD 1 100 0 255 ECU_ADDRESS 0x24026c03 /end MEASUREMENT
/begin MEASUREMENT Debug_LeanRight_True "" UBYTE NO_COMPU_METHOD 1 100 0 255 ECU_ADDRESS 0x24026c7d /end MEASUREMENT
/begin MEASUREMENT Debug_Request_Roundabout "" UBYTE NO_COMPU_METHOD 1 100 0 1 ECU_ADDRESS 0x24026b94 /end MEASUREMENT
/begin MEASUREMENT Debug_Request_Stub "" UBYTE NO_COMPU_METHOD 1 100 0 1 ECU_ADDRESS 0x24026b8e /end MEASUREMENT
/begin MEASUREMENT Debug_TiltedBack_True "" UBYTE NO_COMPU_METHOD 1 100 0 255 ECU_ADDRESS 0x24026c8e /end MEASUREMENT
/begin MEASUREMENT DebugOut_ADAS_Seg_Offset_pre "" UWORD NO_COMPU_METHOD 1 100 0 65535 ECU_ADDRESS 0x240242b8 /end MEASUREMENT
/begin MEASUREMENT DebugOut_ADAS_Seg_PathIdx_pre "" UBYTE NO_COMPU_METHOD 1 100 0 255 ECU_ADDRESS 0x240249c7 /end MEASUREMENT
/begin MEASUREMENT DEBUGOUT_ELK_Algo_Status_RL1 "" SWORD NO_COMPU_METHOD 1 100 -32768 32767 ECU_ADDRESS 0x240001ae /end MEASUREMENT
/begin MEASUREMENT DEBUGOUT_ELK_Algo_Status_RL2 "" SWORD NO_COMPU_METHOD 1 100 -32768 32767 ECU_ADDRESS 0x240001b4 /end MEASUREMENT
/begin MEASUREMENT DEBUGOUT_ELK_Algo_Status_RR1 "" SWORD NO_COMPU_METHOD 1 100 -32768 32767 ECU_ADDRESS 0x240001ba /end MEASUREMENT
/begin MEASUREMENT DEBUGOUT_ELK_WriteErrorCounter_RL1_Int16 "" SWORD NO_COMPU_METHOD 1 100 -32768 32767 ECU_ADDRESS 0x24015f14 /end MEASUREMENT
/begin MEASUREMENT DEBUGOUT_ELK_WriteErrorCounter_RL2_Int16 "" SWORD NO_COMPU_METHOD 1 100 -32768 32767 ECU_ADDRESS 0x24015f0e /end MEASUREMENT
/begin MEASUREMENT DEBUGOUT_ELK_WriteErrorCounter_RR1_Int16 "" SWORD NO_COMPU_METHOD 1 100 -32768 32767 ECU_ADDRESS 0x24015f08 /end MEASUREMENT
/begin MEASUREMENT DEBUGOUT_ELK_WriteMemotyRequest_RL1_bool "" SWORD NO_COMPU_METHOD 1 100 -32768 32767 ECU_ADDRESS 0x24015ef6 /end MEASUREMENT
/begin MEASUREMENT DEBUGOUT_ELK_WriteMemotyRequest_RL2_bool "" SWORD NO_COMPU_METHOD 1 100 -32768 32767 ECU_ADDRESS 0x24015efc /end MEASUREMENT
/begin MEASUREMENT DEBUGOUT_ELK_WriteMemotyRequest_RR1_bool "" SWORD NO_COMPU_METHOD 1 100 -32768 32767 ECU_ADDRESS 0x24015f02 /end MEASUREMENT
/begin MEASUREMENT DEBUGOUT_EPBD_brk_press_react_set_true "" UBYTE NO_COMPU_METHOD 1 100 0 1 ECU_ADDRESS 0x240161a3 /end MEASUREMENT
/begin MEASUREMENT DEBUGOUT_HMI_ABL_RL1_RetractRequest "" SWORD NO_COMPU_METHOD 1 100 -32768 32767 ECU_ADDRESS 0x24000208 /end MEASUREMENT
/begin MEASUREMENT DEBUGOUT_HMI_ABL_RL2_RetractRequest "" SWORD NO_COMPU_METHOD 1 100 -32768 32767 ECU_ADDRESS 0x2400020e /end MEASUREMENT
/begin MEASUREMENT DEBUGOUT_HMI_ABL_RR1_RetractRequest "" SWORD NO_COMPU_METHOD 1 100 -32768 32767 ECU_ADDRESS 0x24000214 /end MEASUREMENT
/begin MEASUREMENT DEBUGOUT_HMI_ACR_FL_RetractRequest "" SWORD NO_COMPU_METHOD 1 100 -32768 32767 ECU_ADDRESS 0x240001d8 /end MEASUREMENT
/begin MEASUREMENT DEBUGOUT_HMI_ACR_FR_RetractRequest "" SWORD NO_COMPU_METHOD 1 100 -32768 32767 ECU_ADDRESS 0x240001de /end MEASUREMENT
/begin MEASUREMENT DEBUGOUT_HMI_ACR_RL1_RetractRequest "" SWORD NO_COMPU_METHOD 1 100 -32768 32767 ECU_ADDRESS 0x240001e4 /end MEASUREMENT
/begin MEASUREMENT DEBUGOUT_HMI_ACR_RL2_RetractRequest "" SWORD NO_COMPU_METHOD 1 100 -32768 32767 ECU_ADDRESS 0x240001ea /end MEASUREMENT
/begin MEASUREMENT DEBUGOUT_HMI_ACR_RR1_RetractRequest "" SWORD NO_COMPU_METHOD 1 100 -32768 32767 ECU_ADDRESS 0x240001f0 /end MEASUREMENT
/begin MEASUREMENT DEBUGOUT_HMI_ACR_Rx_Status "" SWORD NO_COMPU_METHOD 1 100 -32768 32767 ECU_ADDRESS 0x240001d2 /end MEASUREMENT
/begin MEASUREMENT DEBUGOUT_HMI_ELK_FL_LockingRequest "" SWORD NO_COMPU_METHOD 1 100 -32768 32767 ECU_ADDRESS 0x2400022c /end MEASUREMENT
/begin MEASUREMENT DEBUGOUT_HMI_ELK_FR_LockingRequest "" SWORD NO_COMPU_METHOD 1 100 -32768 32767 ECU_ADDRESS 0x24000220 /end MEASUREMENT
/begin MEASUREMENT DEBUGOUT_HMI_ELK_ResetErrorFlags "" SWORD NO_COMPU_METHOD 1 100 -32768 32767 ECU_ADDRESS 0x2400023e /end MEASUREMENT
/begin MEASUREMENT DEBUGOUT_HMI_ELK_RL1_LockingRequest "" SWORD NO_COMPU_METHOD 1 100 -32768 32767 ECU_ADDRESS 0x24000226 /end MEASUREMENT
/begin MEASUREMENT DEBUGOUT_HMI_ELK_RL2_LockingRequest "" SWORD NO_COMPU_METHOD 1 100 -32768 32767 ECU_ADDRESS 0x24000232 /end MEASUREMENT
/begin MEASUREMENT DEBUGOUT_HMI_ELK_RR1_LockingRequest "" SWORD NO_COMPU_METHOD 1 100 -32768 32767 ECU_ADDRESS 0x24000238 /end MEASUREMENT
/begin MEASUREMENT DEBUGOUT_HMI_ELK_Rx_Status "" SWORD NO_COMPU_METHOD 1 100 -32768 32767 ECU_ADDRESS 0x2400021a /end MEASUREMENT
/begin MEASUREMENT DEBUGOUT_HMI_ISB_FL_AddressByte0_byte "" SWORD NO_COMPU_METHOD 1 100 -32768 32767 ECU_ADDRESS 0x24000274 /end MEASUREMENT
/begin MEASUREMENT DEBUGOUT_HMI_ISB_FL_AddressByte1_byte "" SWORD NO_COMPU_METHOD 1 100 -32768 32767 ECU_ADDRESS 0x2400027a /end MEASUREMENT
/begin MEASUREMENT DEBUGOUT_HMI_ISB_FL_ColorBlue_byte "" SWORD NO_COMPU_METHOD 1 100 -32768 32767 ECU_ADDRESS 0x24000250 /end MEASUREMENT
/begin MEASUREMENT DEBUGOUT_HMI_ISB_FL_ColorGreen_byte "" SWORD NO_COMPU_METHOD 1 100 -32768 32767 ECU_ADDRESS 0x2400024a /end MEASUREMENT
/begin MEASUREMENT DEBUGOUT_HMI_ISB_FL_ColorRed_byte "" SWORD NO_COMPU_METHOD 1 100 -32768 32767 ECU_ADDRESS 0x24000256 /end MEASUREMENT
/begin MEASUREMENT DEBUGOUT_HMI_ISB_FL_GroupOrModule_bool "" SWORD NO_COMPU_METHOD 1 100 -32768 32767 ECU_ADDRESS 0x2400026e /end MEASUREMENT
/begin MEASUREMENT DEBUGOUT_HMI_ISB_FL_Intensity_perc "" SWORD NO_COMPU_METHOD 1 100 -32768 32767 ECU_ADDRESS 0x2400025c /end MEASUREMENT
/begin MEASUREMENT DEBUGOUT_HMI_ISB_FL_Normalization_bool "" SWORD NO_COMPU_METHOD 1 100 -32768 32767 ECU_ADDRESS 0x24000262 /end MEASUREMENT
/begin MEASUREMENT DEBUGOUT_HMI_ISB_FL_Rx_Status "" SWORD NO_COMPU_METHOD 1 100 -32768 32767 ECU_ADDRESS 0x24000244 /end MEASUREMENT
/begin MEASUREMENT DEBUGOUT_HMI_ISB_FL_Transitionspeed_nibble "" SWORD NO_COMPU_METHOD 1 100 -32768 32767 ECU_ADDRESS 0x24000268 /end MEASUREMENT
/begin MEASUREMENT DEBUGOUT_HMI_ISB_FR_AddressByte0 "" SWORD NO_COMPU_METHOD 1 100 -32768 32767 ECU_ADDRESS 0x240002b0 /end MEASUREMENT
/begin MEASUREMENT DEBUGOUT_HMI_ISB_FR_AddressByte1 "" SWORD NO_COMPU_METHOD 1 100 -32768 32767 ECU_ADDRESS 0x240002b6 /end MEASUREMENT
/begin MEASUREMENT DEBUGOUT_HMI_ISB_FR_ColorBlue "" SWORD NO_COMPU_METHOD 1 100 -32768 32767 ECU_ADDRESS 0x2400028c /end MEASUREMENT
/begin MEASUREMENT DEBUGOUT_HMI_ISB_FR_ColorGreen "" SWORD NO_COMPU_METHOD 1 100 -32768 32767 ECU_ADDRESS 0x24000286 /end MEASUREMENT
/begin MEASUREMENT DEBUGOUT_HMI_ISB_FR_ColorRed "" SWORD NO_COMPU_METHOD 1 100 -32768 32767 ECU_ADDRESS 0x24000292 /end MEASUREMENT
/begin MEASUREMENT DEBUGOUT_HMI_ISB_FR_GroupOrModule "" SWORD NO_COMPU_METHOD 1 100 -32768 32767 ECU_ADDRESS 0x240002aa /end MEASUREMENT
/begin MEASUREMENT DEBUGOUT_HMI_ISB_FR_Intensity_perc "" SWORD NO_COMPU_METHOD 1 100 -32768 32767 ECU_ADDRESS 0x24000298 /end MEASUREMENT
/begin MEASUREMENT DEBUGOUT_HMI_ISB_FR_Normalization "" SWORD NO_COMPU_METHOD 1 100 -32768 32767 ECU_ADDRESS 0x2400029e /end MEASUREMENT
/begin MEASUREMENT DEBUGOUT_HMI_ISB_FR_Rx_Status "" SWORD NO_COMPU_METHOD 1 100 -32768 32767 ECU_ADDRESS 0x24000280 /end MEASUREMENT
/begin MEASUREMENT DEBUGOUT_HMI_ISB_FR_Transitionspeed "" SWORD NO_COMPU_METHOD 1 100 -32768 32767 ECU_ADDRESS 0x240002a4 /end MEASUREMENT
/begin MEASUREMENT DEBUGOUT_HMI_ISB_RL1_AddressByte0 "" SWORD NO_COMPU_METHOD 1 100 -32768 32767 ECU_ADDRESS 0x240002ec /end MEASUREMENT
/begin MEASUREMENT DEBUGOUT_HMI_ISB_RL1_AddressByte1 "" SWORD NO_COMPU_METHOD 1 100 -32768 32767 ECU_ADDRESS 0x240002f2 /end MEASUREMENT
/begin MEASUREMENT DEBUGOUT_HMI_ISB_RL1_ColorBlue "" SWORD NO_COMPU_METHOD 1 100 -32768 32767 ECU_ADDRESS 0x240002c8 /end MEASUREMENT
/begin MEASUREMENT DEBUGOUT_HMI_ISB_RL1_ColorGreen "" SWORD NO_COMPU_METHOD 1 100 -32768 32767 ECU_ADDRESS 0x240002c2 /end MEASUREMENT
/begin MEASUREMENT DEBUGOUT_HMI_ISB_RL1_ColorRed "" SWORD NO_COMPU_METHOD 1 100 -32768 32767 ECU_ADDRESS 0x240002ce /end MEASUREMENT
/begin MEASUREMENT DEBUGOUT_HMI_ISB_RL1_Intensity "" SWORD NO_COMPU_METHOD 1 100 -32768 32767 ECU_ADDRESS 0x240002d4 /end MEASUREMENT
/begin MEASUREMENT DEBUGOUT_HMI_ISB_RL1_Normalization "" SWORD NO_COMPU_METHOD 1 100 -32768 32767 ECU_ADDRESS 0x240002da /end MEASUREMENT
/begin MEASUREMENT DEBUGOUT_HMI_ISB_RL1_Rx_Status "" SWORD NO_COMPU_METHOD 1 100 -32768 32767 ECU_ADDRESS 0x240002bc /end MEASUREMENT
/begin MEASUREMENT DEBUGOUT_HMI_ISB_RL1_Transitionspeed "" SWORD NO_COMPU_METHOD 1 100 -32768 32767 ECU_ADDRESS 0x240002e0 /end MEASUREMENT
/begin MEASUREMENT DEBUGOUT_IBD_brk_press_thresh "" UBYTE NO_COMPU_METHOD 1 100 0 1 ECU_ADDRESS 0x2401619a /end MEASUREMENT
/begin MEASUREMENT DEBUGOUT_IBD_SARA_AX_thresh "" UBYTE NO_COMPU_METHOD 1 100 0 1 ECU_ADDRESS 0x2401619b /end MEASUREMENT
/begin MEASUREMENT Debugout_MultipleLanes "" UBYTE NO_COMPU_METHOD 1 100 0 1 ECU_ADDRESS 0x240253dc /end MEASUREMENT
/begin MEASUREMENT ELK_WriteErrorCounter_RL1_Int16 "" SWORD NO_COMPU_METHOD 1 100 -32768 32767 ECU_ADDRESS 0x24026c5c /end MEASUREMENT
/begin MEASUREMENT ELK_WriteErrorCounter_RL2_Int16 "" SWORD NO_COMPU_METHOD 1 100 -32768 32767 ECU_ADDRESS 0x24026d30 /end MEASUREMENT
/begin MEASUREMENT ELK_WriteErrorCounter_RR1_Int16 "" SWORD NO_COMPU_METHOD 1 100 -32768 32767 ECU_ADDRESS 0x24026cc2 /end MEASUREMENT
/begin MEASUREMENT ELK_WriteMemotyRequest_RL1_bool "" SWORD NO_COMPU_METHOD 1 100 -32768 32767 ECU_ADDRESS 0x24026cac /end MEASUREMENT
/begin MEASUREMENT ELK_WriteMemotyRequest_RL2_bool "" SWORD NO_COMPU_METHOD 1 100 -32768 32767 ECU_ADDRESS 0x24026bd2 /end MEASUREMENT
/begin MEASUREMENT ELK_WriteMemotyRequest_RR1_bool "" SWORD NO_COMPU_METHOD 1 100 -32768 32767 ECU_ADDRESS 0x24026bfc /end MEASUREMENT
/begin MEASUREMENT fill_Iter_out "" SWORD NO_COMPU_METHOD 1 100 -32768 32767 ECU_ADDRESS 0x24026b9c /end MEASUREMENT
/begin MEASUREMENT ISB_FunctionLogic_FL_Debug_ISB_BuckleSignal "" UBYTE NO_COMPU_METHOD 1 100 0 1 ECU_ADDRESS 0x24026d49 /end MEASUREMENT
/begin MEASUREMENT ISB_FunctionLogic_FL_Debug_ISB_OtherOpenDoor "" UBYTE NO_COMPU_METHOD 1 100 0 1 ECU_ADDRESS 0x24026bfa /end MEASUREMENT
/begin MEASUREMENT ISB_FunctionLogic_FL_Debug_Open_Door "" UBYTE NO_COMPU_METHOD 1 100 0 1 ECU_ADDRESS 0x24026d29 /end MEASUREMENT
/begin MEASUREMENT ISB_FunctionLogic_FL_Debug_PARAM_BlinkOnBuckleBeginDrive_ms "" UBYTE NO_COMPU_METHOD 1 100 0 255 ECU_ADDRESS 0x24026d2a /end MEASUREMENT
/begin MEASUREMENT ISB_FunctionLogic_FR_Debug_ISB_BuckleSignal "" UBYTE NO_COMPU_METHOD 1 100 0 1 ECU_ADDRESS 0x24026d32 /end MEASUREMENT
/begin MEASUREMENT ISB_FunctionLogic_FR_Debug_ISB_OtherOpenDoor "" UBYTE NO_COMPU_METHOD 1 100 0 1 ECU_ADDRESS 0x24026bb6 /end MEASUREMENT
/begin MEASUREMENT ISB_FunctionLogic_FR_Debug_Open_Door "" UBYTE NO_COMPU_METHOD 1 100 0 1 ECU_ADDRESS 0x24026c1a /end MEASUREMENT
/begin MEASUREMENT ISB_FunctionLogic_FR_Debug_PARAM_BlinkOnBuckleBeginDrive_ms "" UBYTE NO_COMPU_METHOD 1 100 0 255 ECU_ADDRESS 0x24026d54 /end MEASUREMENT
/begin MEASUREMENT ISB_FunctionLogic_RL1_Debug_ISB_BuckleSignal "" UBYTE NO_COMPU_METHOD 1 100 0 1 ECU_ADDRESS 0x24026cfe /end MEASUREMENT
/begin MEASUREMENT ISB_FunctionLogic_RL1_Debug_ISB_OtherOpenDoor "" UBYTE NO_COMPU_METHOD 1 100 0 1 ECU_ADDRESS 0x24026d6e /end MEASUREMENT
/begin MEASUREMENT ISB_FunctionLogic_RL1_Debug_Open_Door "" UBYTE NO_COMPU_METHOD 1 100 0 1 ECU_ADDRESS 0x24026c12 /end MEASUREMENT
/begin MEASUREMENT ISB_FunctionLogic_RL1_Debug_PARAM_BlinkOnBuckleBeginDrive_ms "" UBYTE NO_COMPU_METHOD 1 100 0 255 ECU_ADDRESS 0x24026c9e /end MEASUREMENT
/begin MEASUREMENT ISB_FunctionLogic_RL2_Debug_ISB_BuckleSignal "" UBYTE NO_COMPU_METHOD 1 100 0 1 ECU_ADDRESS 0x24026bf5 /end MEASUREMENT
/begin MEASUREMENT ISB_FunctionLogic_RL2_Debug_ISB_OtherOpenDoor "" UBYTE NO_COMPU_METHOD 1 100 0 1 ECU_ADDRESS 0x24026c75 /end MEASUREMENT
/begin MEASUREMENT ISB_FunctionLogic_RL2_Debug_Open_Door "" UBYTE NO_COMPU_METHOD 1 100 0 1 ECU_ADDRESS 0x24026c6a /end MEASUREMENT
/begin MEASUREMENT ISB_FunctionLogic_RL2_Debug_PARAM_BlinkOnBuckleBeginDrive_ms "" UBYTE NO_COMPU_METHOD 1 100 0 255 ECU_ADDRESS 0x24026c8a /end MEASUREMENT
/begin MEASUREMENT ISB_FunctionLogic_RR1_Debug_ISB_BuckleSignal "" UBYTE NO_COMPU_METHOD 1 100 0 1 ECU_ADDRESS 0x24026d0c /end MEASUREMENT
/begin MEASUREMENT ISB_FunctionLogic_RR1_Debug_ISB_OtherOpenDoor "" UBYTE NO_COMPU_METHOD 1 100 0 1 ECU_ADDRESS 0x24026cff /end MEASUREMENT
/begin MEASUREMENT ISB_FunctionLogic_RR1_Debug_Open_Door "" UBYTE NO_COMPU_METHOD 1 100 0 1 ECU_ADDRESS 0x24026d55 /end MEASUREMENT
/begin MEASUREMENT ISB_FunctionLogic_RR1_Debug_PARAM_BlinkOnBuckleBeginDrive_ms "" UBYTE NO_COMPU_METHOD 1 100 0 255 ECU_ADDRESS 0x24026c82 /end MEASUREMENT
/begin MEASUREMENT panther_can1_in.asw_in_can1_0x20_VCLASS_CentrLockSys_Status "CAN1 receive signal 15" UBYTE NO_COMPU_METHOD 1 100 0 4 ECU_ADDRESS 0x24026fa4 SYMBOL_LINK "panther_can1_in" 64 /end MEASUREMENT
/begin MEASUREMENT panther_can6_in.asw_in_can6_0x81_HMI_SEAL_ActivationRequest "CAN6 receive signal 1" UBYTE NO_COMPU_METHOD 1 100 0 3 ECU_ADDRESS 0x24026e9c SYMBOL_LINK "panther_can6_in" 132 /end MEASUREMENT
/begin MEASUREMENT panther_can6_in.asw_in_can6_0x90_ABL_FL_RetractRequest "CAN6 receive signal 1" UBYTE NO_COMPU_METHOD 1 100 0 255 ECU_ADDRESS 0x24026e57 SYMBOL_LINK "panther_can6_in" 63 /end MEASUREMENT
/begin MEASUREMENT panther_can6_in.asw_in_can6_0x90_ABL_FR_RetractRequest "CAN6 receive signal 2" UBYTE NO_COMPU_METHOD 1 100 0 255 ECU_ADDRESS 0x24026e58 SYMBOL_LINK "panther_can6_in" 64 /end MEASUREMENT
/begin MEASUREMENT panther_can6_in.asw_in_can6_0x90_ABL_RL1_RetractRequest "CAN6 receive signal 3" UBYTE NO_COMPU_METHOD 1 100 0 255 ECU_ADDRESS 0x24026e59 SYMBOL_LINK "panther_can6_in" 65 /end MEASUREMENT
/begin MEASUREMENT panther_can6_in.asw_in_can6_0x90_ABL_RL2_RetractRequest "CAN6 receive signal 4" UBYTE NO_COMPU_METHOD 1 100 0 255 ECU_ADDRESS 0x24026e5a SYMBOL_LINK "panther_can6_in" 66 /end MEASUREMENT
/begin MEASUREMENT panther_can6_in.asw_in_can6_0x90_ABL_RR1_RetractRequest "CAN6 receive signal 5" UBYTE NO_COMPU_METHOD 1 100 0 255 ECU_ADDRESS 0x24026e5b SYMBOL_LINK "panther_can6_in" 67 /end MEASUREMENT
/begin MEASUREMENT panther_can6_in.asw_in_can6_0x90_rx_status "CAN6 Receive Status" UBYTE NO_COMPU_METHOD 1 100 0 1 ECU_ADDRESS 0x24026e56 SYMBOL_LINK "panther_can6_in" 62 /end MEASUREMENT
/begin MEASUREMENT panther_can6_in.asw_in_can6_0x91_ACR_FL_RetractRequest "CAN6 receive signal 1" UBYTE NO_COMPU_METHOD 1 100 0 255 ECU_ADDRESS 0x24026e51 SYMBOL_LINK "panther_can6_in" 57 /end MEASUREMENT
/begin MEASUREMENT panther_can6_in.asw_in_can6_0x91_ACR_FR_RetractRequest "CAN6 receive signal 2" UBYTE NO_COMPU_METHOD 1 100 0 255 ECU_ADDRESS 0x24026e52 SYMBOL_LINK "panther_can6_in" 58 /end MEASUREMENT
/begin MEASUREMENT panther_can6_in.asw_in_can6_0x91_ACR_RL1_RetractRequest "CAN6 receive signal 3" UBYTE NO_COMPU_METHOD 1 100 0 255 ECU_ADDRESS 0x24026e53 SYMBOL_LINK "panther_can6_in" 59 /end MEASUREMENT
/begin MEASUREMENT panther_can6_in.asw_in_can6_0x91_ACR_RL2_RetractRequest "CAN6 receive signal 4" UBYTE NO_COMPU_METHOD 1 100 0 255 ECU_ADDRESS 0x24026e54 SYMBOL_LINK "panther_can6_in" 60 /end MEASUREMENT
/begin MEASUREMENT panther_can6_in.asw_in_can6_0x91_ACR_RR1_RetractRequest "CAN6 receive signal 5" UBYTE NO_COMPU_METHOD 1 100 0 255 ECU_ADDRESS 0x24026e55 SYMBOL_LINK "panther_can6_in" 61 /end MEASUREMENT
/begin MEASUREMENT panther_can6_in.asw_in_can6_0x91_rx_status "CAN6 Receive Status" UBYTE NO_COMPU_METHOD 1 100 0 1 ECU_ADDRESS 0x24026e50 SYMBOL_LINK "panther_can6_in" 56 /end MEASUREMENT
/begin MEASUREMENT panther_can6_in.asw_in_can6_0x92_ELK_FL_LockingRequest "CAN6 receive signal 5" UBYTE NO_COMPU_METHOD 1 100 0 1 ECU_ADDRESS 0x24026e4b SYMBOL_LINK "panther_can6_in" 51 /end MEASUREMENT
/begin MEASUREMENT panther_can6_in.asw_in_can6_0x92_ELK_FR_LockingRequest "CAN6 receive signal 4" UBYTE NO_COMPU_METHOD 1 100 0 1 ECU_ADDRESS 0x24026e4c SYMBOL_LINK "panther_can6_in" 52 /end MEASUREMENT
/begin MEASUREMENT panther_can6_in.asw_in_can6_0x92_ELK_ResetErrorFlags "CAN6 receive signal 6" UBYTE NO_COMPU_METHOD 1 100 0 1 ECU_ADDRESS 0x24026e9a SYMBOL_LINK "panther_can6_in" 130 /end MEASUREMENT
/begin MEASUREMENT panther_can6_in.asw_in_can6_0x92_ELK_RL1_LockingRequest "CAN6 receive signal 1" UBYTE NO_COMPU_METHOD 1 100 0 1 ECU_ADDRESS 0x24026e4d SYMBOL_LINK "panther_can6_in" 53 /end MEASUREMENT
/begin MEASUREMENT panther_can6_in.asw_in_can6_0x92_ELK_RL2_LockingRequest "CAN6 receive signal 2" UBYTE NO_COMPU_METHOD 1 100 0 1 ECU_ADDRESS 0x24026e4e SYMBOL_LINK "panther_can6_in" 54 /end MEASUREMENT
/begin MEASUREMENT panther_can6_in.asw_in_can6_0x92_ELK_RR1_LockingRequest "CAN6 receive signal 3" UBYTE NO_COMPU_METHOD 1 100 0 1 ECU_ADDRESS 0x24026e4f SYMBOL_LINK "panther_can6_in" 55 /end MEASUREMENT
/begin MEASUREMENT panther_can6_in.asw_in_can6_0x92_rx_status "CAN6 Receive Status" UBYTE NO_COMPU_METHOD 1 100 0 1 ECU_ADDRESS 0x24026e4a SYMBOL_LINK "panther_can6_in" 50 /end MEASUREMENT
/begin MEASUREMENT panther_can6_in.asw_in_can6_0xA0_ISB_FL_AddressByte0_byte "CAN6 receive signal 8" UBYTE NO_COMPU_METHOD 1 100 0 255 ECU_ADDRESS 0x24026e48 SYMBOL_LINK "panther_can6_in" 48 /end MEASUREMENT
/begin MEASUREMENT panther_can6_in.asw_in_can6_0xA0_ISB_FL_AddressByte1_byte "CAN6 receive signal 9" UBYTE NO_COMPU_METHOD 1 100 0 255 ECU_ADDRESS 0x24026e49 SYMBOL_LINK "panther_can6_in" 49 /end MEASUREMENT
/begin MEASUREMENT panther_can6_in.asw_in_can6_0xA0_ISB_FL_ColorBlue_byte "CAN6 receive signal 2" UBYTE NO_COMPU_METHOD 1 100 0 255 ECU_ADDRESS 0x24026e42 SYMBOL_LINK "panther_can6_in" 42 /end MEASUREMENT
/begin MEASUREMENT panther_can6_in.asw_in_can6_0xA0_ISB_FL_ColorGreen_byte "CAN6 receive signal 1" UBYTE NO_COMPU_METHOD 1 100 0 255 ECU_ADDRESS 0x24026e41 SYMBOL_LINK "panther_can6_in" 41 /end MEASUREMENT
/begin MEASUREMENT panther_can6_in.asw_in_can6_0xA0_ISB_FL_ColorRed_byte "CAN6 receive signal 3" UBYTE NO_COMPU_METHOD 1 100 0 255 ECU_ADDRESS 0x24026e43 SYMBOL_LINK "panther_can6_in" 43 /end MEASUREMENT
/begin MEASUREMENT panther_can6_in.asw_in_can6_0xA0_ISB_FL_GroupOrModule_bool "CAN6 receive signal 7" UBYTE NO_COMPU_METHOD 1 100 0 1 ECU_ADDRESS 0x24026e47 SYMBOL_LINK "panther_can6_in" 47 /end MEASUREMENT
/begin MEASUREMENT panther_can6_in.asw_in_can6_0xA0_ISB_FL_Intensity_perc "CAN6 receive signal 4" UBYTE NO_COMPU_METHOD 1 100 0 127 ECU_ADDRESS 0x24026e44 SYMBOL_LINK "panther_can6_in" 44 /end MEASUREMENT
/begin MEASUREMENT panther_can6_in.asw_in_can6_0xA0_ISB_FL_Normalization_bool "CAN6 receive signal 5" UBYTE NO_COMPU_METHOD 1 100 0 1 ECU_ADDRESS 0x24026e45 SYMBOL_LINK "panther_can6_in" 45 /end MEASUREMENT
/begin MEASUREMENT panther_can6_in.asw_in_can6_0xA0_ISB_FL_Transitionspeed_nibble "CAN6 receive signal 6" UBYTE NO_COMPU_METHOD 1 100 0 15 ECU_ADDRESS 0x24026e46 SYMBOL_LINK "panther_can6_in" 46 /end MEASUREMENT
/begin MEASUREMENT panther_can6_in.asw_in_can6_0xA0_rx_status "CAN6 Receive Status" UBYTE NO_COMPU_METHOD 1 100 0 1 ECU_ADDRESS 0x24026e40 SYMBOL_LINK "panther_can6_in" 40 /end MEASUREMENT
/begin MEASUREMENT panther_can6_in.asw_in_can6_0xA1_ISB_FR_AddressByte0 "CAN6 receive signal 8" UBYTE NO_COMPU_METHOD 1 100 0 255 ECU_ADDRESS 0x24026e3e SYMBOL_LINK "panther_can6_in" 38 /end MEASUREMENT
/begin MEASUREMENT panther_can6_in.asw_in_can6_0xA1_ISB_FR_AddressByte1 "CAN6 receive signal 9" UBYTE NO_COMPU_METHOD 1 100 0 255 ECU_ADDRESS 0x24026e3f SYMBOL_LINK "panther_can6_in" 39 /end MEASUREMENT
/begin MEASUREMENT panther_can6_in.asw_in_can6_0xA1_ISB_FR_ColorBlue "CAN6 receive signal 2" UBYTE NO_COMPU_METHOD 1 100 0 255 ECU_ADDRESS 0x24026e38 SYMBOL_LINK "panther_can6_in" 32 /end MEASUREMENT
/begin MEASUREMENT panther_can6_in.asw_in_can6_0xA1_ISB_FR_ColorGreen "CAN6 receive signal 1" UBYTE NO_COMPU_METHOD 1 100 0 255 ECU_ADDRESS 0x24026e37 SYMBOL_LINK "panther_can6_in" 31 /end MEASUREMENT
/begin MEASUREMENT panther_can6_in.asw_in_can6_0xA1_ISB_FR_ColorRed "CAN6 receive signal 3" UBYTE NO_COMPU_METHOD 1 100 0 255 ECU_ADDRESS 0x24026e39 SYMBOL_LINK "panther_can6_in" 33 /end MEASUREMENT
/begin MEASUREMENT panther_can6_in.asw_in_can6_0xA1_ISB_FR_GroupOrModule "CAN6 receive signal 7" UBYTE NO_COMPU_METHOD 1 100 0 1 ECU_ADDRESS 0x24026e3d SYMBOL_LINK "panther_can6_in" 37 /end MEASUREMENT
/begin MEASUREMENT panther_can6_in.asw_in_can6_0xA1_ISB_FR_Intensity_perc "CAN6 receive signal 4" UBYTE NO_COMPU_METHOD 1 100 0 127 ECU_ADDRESS 0x24026e3a SYMBOL_LINK "panther_can6_in" 34 /end MEASUREMENT
/begin MEASUREMENT panther_can6_in.asw_in_can6_0xA1_ISB_FR_Normalization "CAN6 receive signal 5" UBYTE NO_COMPU_METHOD 1 100 0 1 ECU_ADDRESS 0x24026e3b SYMBOL_LINK "panther_can6_in" 35 /end MEASUREMENT
/begin MEASUREMENT panther_can6_in.asw_in_can6_0xA1_ISB_FR_Transitionspeed "CAN6 receive signal 6" UBYTE NO_COMPU_METHOD 1 100 0 15 ECU_ADDRESS 0x24026e3c SYMBOL_LINK "panther_can6_in" 36 /end MEASUREMENT
/begin MEASUREMENT panther_can6_in.asw_in_can6_0xA1_rx_status "CAN6 Receive Status" UBYTE NO_COMPU_METHOD 1 100 0 1 ECU_ADDRESS 0x24026e36 SYMBOL_LINK "panther_can6_in" 30 /end MEASUREMENT
/begin MEASUREMENT panther_can6_in.asw_in_can6_0xA2_ISB_RL1_AddressByte0 "CAN6 receive signal 8" UBYTE NO_COMPU_METHOD 1 100 0 255 ECU_ADDRESS 0x24026e34 SYMBOL_LINK "panther_can6_in" 28 /end MEASUREMENT
/begin MEASUREMENT panther_can6_in.asw_in_can6_0xA2_ISB_RL1_AddressByte1 "CAN6 receive signal 9" UBYTE NO_COMPU_METHOD 1 100 0 255 ECU_ADDRESS 0x24026e35 SYMBOL_LINK "panther_can6_in" 29 /end MEASUREMENT
/begin MEASUREMENT panther_can6_in.asw_in_can6_0xA2_ISB_RL1_ColorBlue "CAN6 receive signal 2" UBYTE NO_COMPU_METHOD 1 100 0 255 ECU_ADDRESS 0x24026e2e SYMBOL_LINK "panther_can6_in" 22 /end MEASUREMENT
/begin MEASUREMENT panther_can6_in.asw_in_can6_0xA2_ISB_RL1_ColorGreen "CAN6 receive signal 1" UBYTE NO_COMPU_METHOD 1 100 0 255 ECU_ADDRESS 0x24026e2d SYMBOL_LINK "panther_can6_in" 21 /end MEASUREMENT
/begin MEASUREMENT panther_can6_in.asw_in_can6_0xA2_ISB_RL1_ColorRed "CAN6 receive signal 3" UBYTE NO_COMPU_METHOD 1 100 0 255 ECU_ADDRESS 0x24026e2f SYMBOL_LINK "panther_can6_in" 23 /end MEASUREMENT
/begin MEASUREMENT panther_can6_in.asw_in_can6_0xA2_ISB_RL1_GroupOrModule "CAN6 receive signal 7" UBYTE NO_COMPU_METHOD 1 100 0 1 ECU_ADDRESS 0x24026e33 SYMBOL_LINK "panther_can6_in" 27 /end MEASUREMENT
/begin MEASUREMENT panther_can6_in.asw_in_can6_0xA2_ISB_RL1_Intensity "CAN6 receive signal 4" UBYTE NO_COMPU_METHOD 1 100 0 127 ECU_ADDRESS 0x24026e30 SYMBOL_LINK "panther_can6_in" 24 /end MEASUREMENT
/begin MEASUREMENT panther_can6_in.asw_in_can6_0xA2_ISB_RL1_Normalization "CAN6 receive signal 5" UBYTE NO_COMPU_METHOD 1 100 0 1 ECU_ADDRESS 0x24026e31 SYMBOL_LINK "panther_can6_in" 25 /end MEASUREMENT
/begin MEASUREMENT panther_can6_in.asw_in_can6_0xA2_ISB_RL1_Transitionspeed "CAN6 receive signal 6" UBYTE NO_COMPU_METHOD 1 100 0 15 ECU_ADDRESS 0x24026e32 SYMBOL_LINK "panther_can6_in" 26 /end MEASUREMENT
/begin MEASUREMENT panther_can6_in.asw_in_can6_0xA2_rx_status "CAN6 Receive Status" UBYTE NO_COMPU_METHOD 1 100 0 1 ECU_ADDRESS 0x24026e2c SYMBOL_LINK "panther_can6_in" 20 /end MEASUREMENT
/begin MEASUREMENT panther_can6_in.asw_in_can6_0xB3_OMS_FL_HandsOnWheel "CAN6 receive signal 1" UBYTE NO_COMPU_METHOD 1 100 0 3 ECU_ADDRESS 0x24026e69 SYMBOL_LINK "panther_can6_in" 81 /end MEASUREMENT
/begin MEASUREMENT panther_can6_in.asw_in_can6_0xB3_OMS_FL_OccupantClassification "CAN6 receive signal 2" UBYTE NO_COMPU_METHOD 1 100 0 7 ECU_ADDRESS 0x24026e6a SYMBOL_LINK "panther_can6_in" 82 /end MEASUREMENT
/begin MEASUREMENT panther_can6_in.asw_in_can6_0xB3_OMS_FL_OccupantHeightMean_cm "CAN6 receive signal 6" UBYTE NO_COMPU_METHOD 1 100 0 255 ECU_ADDRESS 0x24026e70 SYMBOL_LINK "panther_can6_in" 88 /end MEASUREMENT
/begin MEASUREMENT panther_can6_in.asw_in_can6_0xB3_OMS_FL_OccupantHeightStd_cm "CAN6 receive signal 7" UBYTE NO_COMPU_METHOD 1 100 0 255 ECU_ADDRESS 0x24026e71 SYMBOL_LINK "panther_can6_in" 89 /end MEASUREMENT
/begin MEASUREMENT panther_can6_in.asw_in_can6_0xB3_OMS_FL_OccupantPresence_bool "CAN6 receive signal 10" UBYTE NO_COMPU_METHOD 1 100 0 1 ECU_ADDRESS 0x24026e74 SYMBOL_LINK "panther_can6_in" 92 /end MEASUREMENT
/begin MEASUREMENT panther_can6_in.asw_in_can6_0xB3_OMS_FL_OccupantWeightMean_kg "CAN6 receive signal 4" UBYTE NO_COMPU_METHOD 1 100 0 255 ECU_ADDRESS 0x24026e6e SYMBOL_LINK "panther_can6_in" 86 /end MEASUREMENT
/begin MEASUREMENT panther_can6_in.asw_in_can6_0xB3_OMS_FL_OccupantWeightStd_kg "CAN6 receive signal 5" UBYTE NO_COMPU_METHOD 1 100 0 255 ECU_ADDRESS 0x24026e6f SYMBOL_LINK "panther_can6_in" 87 /end MEASUREMENT
/begin MEASUREMENT panther_can6_in.asw_in_can6_0xB3_OMS_FL_OutOfPosition "CAN6 receive signal 3" UWORD NO_COMPU_METHOD 1 100 0 4095 ECU_ADDRESS 0x24026e6c SYMBOL_LINK "panther_can6_in" 84 /end MEASUREMENT
/begin MEASUREMENT panther_can6_in.asw_in_can6_0xB3_rx_status "CAN6 Receive Status" UBYTE NO_COMPU_METHOD 1 100 0 1 ECU_ADDRESS 0x24026e68 SYMBOL_LINK "panther_can6_in" 80 /end MEASUREMENT
/begin MEASUREMENT panther_can6_in.asw_in_can6_0xB4_OMS_FR_OccupantClassification "CAN6 receive signal 1" UBYTE NO_COMPU_METHOD 1 100 0 7 ECU_ADDRESS 0x24026e5d SYMBOL_LINK "panther_can6_in" 69 /end MEASUREMENT
/begin MEASUREMENT panther_can6_in.asw_in_can6_0xB4_OMS_FR_OccupantHeightMean_cm "CAN6 receive signal 5" UBYTE NO_COMPU_METHOD 1 100 0 255 ECU_ADDRESS 0x24026e62 SYMBOL_LINK "panther_can6_in" 74 /end MEASUREMENT
/begin MEASUREMENT panther_can6_in.asw_in_can6_0xB4_OMS_FR_OccupantHeightStd_cm "CAN6 receive signal 6" UBYTE NO_COMPU_METHOD 1 100 0 255 ECU_ADDRESS 0x24026e63 SYMBOL_LINK "panther_can6_in" 75 /end MEASUREMENT
/begin MEASUREMENT panther_can6_in.asw_in_can6_0xB4_OMS_FR_OccupantPresence_bool "CAN6 receive signal 10" UBYTE NO_COMPU_METHOD 1 100 0 1 ECU_ADDRESS 0x24026e67 SYMBOL_LINK "panther_can6_in" 79 /end MEASUREMENT
/begin MEASUREMENT panther_can6_in.asw_in_can6_0xB4_OMS_FR_OccupantWeightMean_kg "CAN6 receive signal 3" UBYTE NO_COMPU_METHOD 1 100 0 255 ECU_ADDRESS 0x24026e60 SYMBOL_LINK "panther_can6_in" 72 /end MEASUREMENT
/begin MEASUREMENT panther_can6_in.asw_in_can6_0xB4_OMS_FR_OccupantWeightStd_kg "CAN6 receive signal 4" UBYTE NO_COMPU_METHOD 1 100 0 255 ECU_ADDRESS 0x24026e61 SYMBOL_LINK "panther_can6_in" 73 /end MEASUREMENT
/begin MEASUREMENT panther_can6_in.asw_in_can6_0xB4_OMS_FR_OutOfPosition "CAN6 receive signal 2" UWORD NO_COMPU_METHOD 1 100 0 4095 ECU_ADDRESS 0x24026e5e SYMBOL_LINK "panther_can6_in" 70 /end MEASUREMENT
/begin MEASUREMENT panther_can6_in.asw_in_can6_0xB4_rx_status "CAN6 Receive Status" UBYTE NO_COMPU_METHOD 1 100 0 1 ECU_ADDRESS 0x24026e5c SYMBOL_LINK "panther_can6_in" 68 /end MEASUREMENT
/begin MEASUREMENT panther_can6_in.asw_in_can6_0xB5_OMS_RL1_OccupantClassification "CAN6 receive signal 1" UBYTE NO_COMPU_METHOD 1 100 0 7 ECU_ADDRESS 0x24026e8e SYMBOL_LINK "panther_can6_in" 118 /end MEASUREMENT
/begin MEASUREMENT panther_can6_in.asw_in_can6_0xB5_OMS_RL1_OccupantHeightMean_cm "CAN6 receive signal 5" UBYTE NO_COMPU_METHOD 1 100 0 255 ECU_ADDRESS 0x24026e94 SYMBOL_LINK "panther_can6_in" 124 /end MEASUREMENT
/begin MEASUREMENT panther_can6_in.asw_in_can6_0xB5_OMS_RL1_OccupantHeightStd_cm "CAN6 receive signal 6" UBYTE NO_COMPU_METHOD 1 100 0 255 ECU_ADDRESS 0x24026e95 SYMBOL_LINK "panther_can6_in" 125 /end MEASUREMENT
/begin MEASUREMENT panther_can6_in.asw_in_can6_0xB5_OMS_RL1_OccupantPresence_bool "CAN6 receive signal 7" UBYTE NO_COMPU_METHOD 1 100 0 1 ECU_ADDRESS 0x24026e96 SYMBOL_LINK "panther_can6_in" 126 /end MEASUREMENT
/begin MEASUREMENT panther_can6_in.asw_in_can6_0xB5_OMS_RL1_OccupantWeightMean_kg "CAN6 receive signal 8" UBYTE NO_COMPU_METHOD 1 100 0 255 ECU_ADDRESS 0x24026e97 SYMBOL_LINK "panther_can6_in" 127 /end MEASUREMENT
/begin MEASUREMENT panther_can6_in.asw_in_can6_0xB5_OMS_RL1_OccupantWeightStd_kg "CAN6 receive signal 9" UBYTE NO_COMPU_METHOD 1 100 0 255 ECU_ADDRESS 0x24026e98 SYMBOL_LINK "panther_can6_in" 128 /end MEASUREMENT
/begin MEASUREMENT panther_can6_in.asw_in_can6_0xB5_OMS_RL1_OutOfPosition "CAN6 receive signal 2" UWORD NO_COMPU_METHOD 1 100 0 4095 ECU_ADDRESS 0x24026e90 SYMBOL_LINK "panther_can6_in" 120 /end MEASUREMENT
/begin MEASUREMENT panther_can6_in.asw_in_can6_0xB5_rx_status "CAN6 Receive Status" UBYTE NO_COMPU_METHOD 1 100 0 1 ECU_ADDRESS 0x24026e8d SYMBOL_LINK "panther_can6_in" 117 /end MEASUREMENT
/begin MEASUREMENT panther_can6_in.asw_in_can6_0xB6_OMS_RL2_OccupantClassification "CAN6 receive signal 2" UBYTE NO_COMPU_METHOD 1 100 0 7 ECU_ADDRESS 0x24026e77 SYMBOL_LINK "panther_can6_in" 95 /end MEASUREMENT
/begin MEASUREMENT panther_can6_in.asw_in_can6_0xB6_OMS_RL2_OccupantHeightMean_cm "CAN6 receive signal 4" UBYTE NO_COMPU_METHOD 1 100 0 255 ECU_ADDRESS 0x24026e79 SYMBOL_LINK "panther_can6_in" 97 /end MEASUREMENT
/begin MEASUREMENT panther_can6_in.asw_in_can6_0xB6_OMS_RL2_OccupantHeightStd_cm "CAN6 receive signal 5" UBYTE NO_COMPU_METHOD 1 100 0 255 ECU_ADDRESS 0x24026e7a SYMBOL_LINK "panther_can6_in" 98 /end MEASUREMENT
/begin MEASUREMENT panther_can6_in.asw_in_can6_0xB6_OMS_RL2_OccupantPresence_bool "CAN6 receive signal 6" UBYTE NO_COMPU_METHOD 1 100 0 1 ECU_ADDRESS 0x24026e7b SYMBOL_LINK "panther_can6_in" 99 /end MEASUREMENT
/begin MEASUREMENT panther_can6_in.asw_in_can6_0xB6_OMS_RL2_OccupantWeightMean_kg "CAN6 receive signal 7" UBYTE NO_COMPU_METHOD 1 100 0 255 ECU_ADDRESS 0x24026e7c SYMBOL_LINK "panther_can6_in" 100 /end MEASUREMENT
/begin MEASUREMENT panther_can6_in.asw_in_can6_0xB6_OMS_RL2_OccupantWeightStd_kg "CAN6 receive signal 8" UBYTE NO_COMPU_METHOD 1 100 0 255 ECU_ADDRESS 0x24026e7d SYMBOL_LINK "panther_can6_in" 101 /end MEASUREMENT
/begin MEASUREMENT panther_can6_in.asw_in_can6_0xB6_OMS_RL2_OutOfPosition "CAN6 receive signal 9" UWORD NO_COMPU_METHOD 1 100 0 4095 ECU_ADDRESS 0x24026e7e SYMBOL_LINK "panther_can6_in" 102 /end MEASUREMENT
/begin MEASUREMENT panther_can6_in.asw_in_can6_0xB6_rx_status "CAN6 Receive Status" UBYTE NO_COMPU_METHOD 1 100 0 1 ECU_ADDRESS 0x24026e75 SYMBOL_LINK "panther_can6_in" 93 /end MEASUREMENT
/begin MEASUREMENT panther_can6_in.asw_in_can6_0xB7_OMS_RR1_OccupantClassification "CAN6 receive signal 2" UBYTE NO_COMPU_METHOD 1 100 0 7 ECU_ADDRESS 0x24026e83 SYMBOL_LINK "panther_can6_in" 107 /end MEASUREMENT
/begin MEASUREMENT panther_can6_in.asw_in_can6_0xB7_OMS_RR1_OccupantHeightMean_cm "CAN6 receive signal 4" UBYTE NO_COMPU_METHOD 1 100 0 255 ECU_ADDRESS 0x24026e85 SYMBOL_LINK "panther_can6_in" 109 /end MEASUREMENT
/begin MEASUREMENT panther_can6_in.asw_in_can6_0xB7_OMS_RR1_OccupantHeightStd_cm "CAN6 receive signal 5" UBYTE NO_COMPU_METHOD 1 100 0 255 ECU_ADDRESS 0x24026e86 SYMBOL_LINK "panther_can6_in" 110 /end MEASUREMENT
/begin MEASUREMENT panther_can6_in.asw_in_can6_0xB7_OMS_RR1_OccupantPresence_bool "CAN6 receive signal 6" UBYTE NO_COMPU_METHOD 1 100 0 1 ECU_ADDRESS 0x24026e87 SYMBOL_LINK "panther_can6_in" 111 /end MEASUREMENT
/begin MEASUREMENT panther_can6_in.asw_in_can6_0xB7_OMS_RR1_OccupantWeightMean_kg "CAN6 receive signal 7" UBYTE NO_COMPU_METHOD 1 100 0 255 ECU_ADDRESS 0x24026e88 SYMBOL_LINK "panther_can6_in" 112 /end MEASUREMENT
/begin MEASUREMENT panther_can6_in.asw_in_can6_0xB7_OMS_RR1_OccupantWeightStd_kg "CAN6 receive signal 8" UBYTE NO_COMPU_METHOD 1 100 0 255 ECU_ADDRESS 0x24026e89 SYMBOL_LINK "panther_can6_in" 113 /end MEASUREMENT
/begin MEASUREMENT panther_can6_in.asw_in_can6_0xB7_OMS_RR1_OutOfPosition "CAN6 receive signal 9" UWORD NO_COMPU_METHOD 1 100 0 4095 ECU_ADDRESS 0x24026e8a SYMBOL_LINK "panther_can6_in" 114 /end MEASUREMENT
/begin MEASUREMENT panther_can6_in.asw_in_can6_0xB7_rx_status "CAN6 Receive Status" UBYTE NO_COMPU_METHOD 1 100 0 1 ECU_ADDRESS 0x24026e81 SYMBOL_LINK "panther_can6_in" 105 /end MEASUREMENT
/begin MEASUREMENT panther_memory_in.asw_in_memory_data_1 "in_memory_data 1" FLOAT32_IEEE NO_COMPU_METHOD 1 100 -3.402823466e38 3.402823466e38 ECU_ADDRESS 0x24016220 SYMBOL_LINK "panther_memory_in" 4 /end MEASUREMENT
/begin MEASUREMENT panther_memory_in.asw_in_memory_data_2 "in_memory_data 2" FLOAT32_IEEE NO_COMPU_METHOD 1 100 -3.402823466e38 3.402823466e38 ECU_ADDRESS 0x24016224 SYMBOL_LINK "panther_memory_in" 8 /end MEASUREMENT
/begin MEASUREMENT panther_memory_in.asw_in_memory_data_3 "in_memory_data 3" FLOAT32_IEEE NO_COMPU_METHOD 1 100 -3.402823466e38 3.402823466e38 ECU_ADDRESS 0x24016228 SYMBOL_LINK "panther_memory_in" 12 /end MEASUREMENT
/begin MEASUREMENT panther_memory_out.asw_out_memory_data_1 "Memory Outputs 1" FLOAT32_IEEE NO_COMPU_METHOD 1 100 -3.402823466e38 3.402823466e38 ECU_ADDRESS 0x24026e0c SYMBOL_LINK "panther_memory_out" 4 /end MEASUREMENT
/begin MEASUREMENT panther_memory_out.asw_out_memory_data_2 "Memory Outputs 2" FLOAT32_IEEE NO_COMPU_METHOD 1 100 -3.402823466e38 3.402823466e38 ECU_ADDRESS 0x24026e10 SYMBOL_LINK "panther_memory_out" 8 /end MEASUREMENT
/begin MEASUREMENT panther_memory_out.asw_out_memory_data_3 "Memory Outputs 3" FLOAT32_IEEE NO_COMPU_METHOD 1 100 -3.402823466e38 3.402823466e38 ECU_ADDRESS 0x24026e14 SYMBOL_LINK "panther_memory_out" 12 /end MEASUREMENT
/begin MEASUREMENT panther_memory_out.asw_out_memory_read_request_bool "Memory read request flag" UBYTE NO_COMPU_METHOD 1 100 0 1 ECU_ADDRESS 0x24026e08 SYMBOL_LINK "panther_memory_out" 0 /end MEASUREMENT
/begin MEASUREMENT panther_memory_out.asw_out_memory_write_request_bool "Memory write request flag" UBYTE NO_COMPU_METHOD 1 100 0 1 ECU_ADDRESS 0x24026e09 SYMBOL_LINK "panther_memory_out" 1 /end MEASUREMENT
/begin MEASUREMENT PathSegment_readIter_in "" SWORD NO_COMPU_METHOD 1 100 -32768 32767 ECU_ADDRESS 0x24025bb0 /end MEASUREMENT
/begin MEASUREMENT remind_index_PathSegment "" SWORD NO_COMPU_METHOD 1 100 -32768 32767 ECU_ADDRESS 0x240253de /end MEASUREMENT
/begin MEASUREMENT Roundabout_ahead "" UBYTE NO_COMPU_METHOD 1 100 0 1 ECU_ADDRESS 0x24025bc1 /end MEASUREMENT
/begin MEASUREMENT SELK_Manager11_DEBUGOUT_Error_detected "" UBYTE NO_COMPU_METHOD 1 100 0 1 ECU_ADDRESS 0x24015ee1 /end MEASUREMENT
/begin MEASUREMENT SELK_Manager22_DEBUGOUT_Error_detected "" UBYTE NO_COMPU_METHOD 1 100 0 1 ECU_ADDRESS 0x24015ee9 /end MEASUREMENT
/begin MEASUREMENT SELK_Manager33_DEBUGOUT_Error_detected "" UBYTE NO_COMPU_METHOD 1 100 0 1 ECU_ADDRESS 0x24015ef1 /end MEASUREMENT
/begin MEASUREMENT StateControl_write "" SWORD NO_COMPU_METHOD 1 100 -32768 32767 ECU_ADDRESS 0x24025be2 /end MEASUREMENT
/begin MEASUREMENT STUB_Left_turn_angle "" UWORD ALS_Stub_TurnAngle_deg 1 100 0 1023.984375 ECU_ADDRESS 0x24025bba /end MEASUREMENT
/begin MEASUREMENT STUB_Left_turn_available "" UBYTE NO_COMPU_METHOD 1 100 0 1 ECU_ADDRESS 0x24025bb2 /end MEASUREMENT
/begin MEASUREMENT STUB_Right_turn_angle "" UWORD ALS_Stub_TurnAngle_deg 1 100 0 1023.984375 ECU_ADDRESS 0x24025bb8 /end MEASUREMENT
/begin MEASUREMENT STUB_Right_turn_available "" UBYTE NO_COMPU_METHOD 1 100 0 1 ECU_ADDRESS 0x24025bc4 /end MEASUREMENT
/begin MEASUREMENT STUB_ThisPath_turn_angle "" UWORD ALS_Stub_TurnAngle_deg 1 100 0 1023.984375 ECU_ADDRESS 0x24025bde /end MEASUREMENT
/begin MEASUREMENT ThisPath_enabled "" UBYTE NO_COMPU_METHOD 1 100 0 1 ECU_ADDRESS 0x240263b8 /end MEASUREMENT
/begin MEASUREMENT VehiclePosn_Curv "" UWORD EQ_LSB_0_2 1 100 0 13107 ECU_ADDRESS 0x24025bbc /end MEASUREMENT
/begin MEASUREMENT XCPOut_RearSeat_true_Sa534 "" UBYTE NO_COMPU_METHOD 1 100 0 1 ECU_ADDRESS 0x24026c02 /end MEASUREMENT
/begin MEASUREMENT XCPOut_RearSeat_true_Sa535 "" UBYTE NO_COMPU_METHOD 1 100 0 1 ECU_ADDRESS 0x24026bf7 /end MEASUREMENT
/begin MEASUREMENT XCPOut_RearSeat_true_Sa536 "" UBYTE NO_COMPU_METHOD 1 100 0 1 ECU_ADDRESS 0x24026bf8 /end MEASUREMENT
/begin MEASUREMENT XCPOut_RearSeat_true_Sa537 "" UBYTE NO_COMPU_METHOD 1 100 0 1 ECU_ADDRESS 0x24026be9 /end MEASUREMENT
/begin MEASUREMENT XCPOut_RearSeat_true_Sa538 "" UBYTE NO_COMPU_METHOD 1 100 0 1 ECU_ADDRESS 0x24026be8 /end MEASUREMENT
/begin MEASUREMENT XCPOut_Webbing_Output_Sa534 "" UBYTE NO_COMPU_METHOD 1 100 0 1 ECU_ADDRESS 0x24026d34 /end MEASUREMENT
/begin MEASUREMENT XCPOut_Webbing_Output_Sa535 "" UBYTE NO_COMPU_METHOD 1 100 0 1 ECU_ADDRESS 0x24026d38 /end MEASUREMENT
/begin MEASUREMENT XCPOut_Webbing_Output_Sa536 "" UBYTE NO_COMPU_METHOD 1 100 0 1 ECU_ADDRESS 0x24026d43 /end MEASUREMENT
/begin MEASUREMENT XCPOut_Webbing_Output_Sa537 "" UBYTE NO_COMPU_METHOD 1 100 0 1 ECU_ADDRESS 0x24026d33 /end MEASUREMENT
/begin MEASUREMENT XCPOut_Webbing_Output_Sa538 "" UBYTE NO_COMPU_METHOD 1 100 0 1 ECU_ADDRESS 0x24026d44 /end MEASUREMENT
/begin COMPU_METHOD ALS_Pretime_Activation_s "Pretime_Activation_s " LINEAR "%5.2" "s" COEFFS_LINEAR 0.25 0 /end COMPU_METHOD
/begin COMPU_METHOD ALS_Pretime_Activation_s_a "Pretime_Activation_s " LINEAR "%8.2" "s" COEFFS_LINEAR 0.25 0 /end COMPU_METHOD
/begin COMPU_METHOD ALS_Stub_TurnAngle_deg "Stub_TurnAngle" LINEAR "%11.6" "deg" COEFFS_LINEAR 0.015625 0 /end COMPU_METHOD
/begin COMPU_METHOD ALS_VehicleSped_factor "Vehicle speed scale factor" LINEAR "%6.2" "scale factor" COEFFS_LINEAR 0.01 0 /end COMPU_METHOD
/begin COMPU_METHOD EQ_LSB_0_01 "" LINEAR "%6.2" "" COEFFS_LINEAR 0.01 0 /end COMPU_METHOD
/begin COMPU_METHOD EQ_LSB_0_2 "" LINEAR "%7.1" "" COEFFS_LINEAR 0.2 0 /end COMPU_METHOD
/begin COMPU_METHOD EQ_LSB_10 "" LINEAR "%4.0" "ms" COEFFS_LINEAR 10 0 /end COMPU_METHOD
/begin FUNCTION AL_Mainfunction_PANTHER_10ms ""
 /begin DEF_CHARACTERISTIC DEBUGIN_ALI_CAN_0x0A5_CMS_Brk_Rq_V2 DEBUGIN_ALI_CAN_0x0A5_DEBUGIN_Enabled DEBUGIN_ALI_CAN_0x13F_ALDW_LDP_Warn_Rq DEBUGIN_ALI_CAN_0x13F_DEBUGIN_Enabled DEBUGIN_ALI_CAN_0x453_AccelPdlPosn DEBUGIN_ALI_CAN_0x453_DEBUGIN_Enabled DEBUGIN_ALI_CAN_0x402_DEBUGIN_Enabled DEBUGIN_ALI_CAN_0x402_LDP_BrkMsgDisp_Rq DEBUGIN_ALI_CAN_0x453_DTQ_MsgDisp_Rq_V2 DEBUGIN_ALI_FR_8_2_4_A_BrkTrq_D_V2 DEBUGIN_ALI_FR_8_2_4_A_BrkTrq_D_V2_Enabled DEBUGIN_Vehicle_BuckleStatusFL DEBUGIN_Vehicle_BuckleStatusFL_Enabled DEBUGIN_Vehicle_BuckleStatusFR DEBUGIN_Vehicle_BuckleStatusFR_Enabled DEBUGIN_Vehicle_BuckleStatusRL1 DEBUGIN_Vehicle_BuckleStatusRL1_Enabled DEBUGIN_Vehicle_BuckleStatusRL2 DEBUGIN_Vehicle_BuckleStatusRL2_Enabled DEBUGIN_Vehicle_BuckleStatusRR1 DEBUGIN_Vehicle_BuckleStatusRR1_Enabled DEBUGIN_ACTI_CAN_0x098_DEBUGIN_Enabled DEBUGIN_ACTI_CAN_0x098_VehSpd_X DEBUGIN_ALI_CAN_0x2F7_DEBUGIN_Enabled DEBUGIN_CAN_0x2F7_EVC_List08_Country DEBUGIN_ALI_CAN_0x26B_DEBUGIN_Enabled DEBUGIN_ALI_CAN_0x26B_EPS_FtWhlAngl DEBUGIN_ALI_CAN_0x397_DEBUGIN_Enabled DEBUGIN_ALI_CAN_0x397_DrRLtch_FL_Stat DEBUGIN_ALI_CAN_0x39B_DEBUGIN_Enabled DEBUGIN_ALI_CAN_0x39B_DrRLtch_FR_Stat DEBUGIN_ALI_CAN_0x3A3_DEBUGIN_Enabled DEBUGIN_ALI_CAN_0x3A3_DrRLtch_RL_Stat DEBUGIN_ALI_CAN_0x3A5_DEBUGIN_Enabled DEBUGIN_ALI_CAN_0x3A5_DrRLtch_RR_Stat DEBUGIN_ALI_CAN_0x271_DEBUGIN_Enabled DEBUGIN_ALI_CAN_0x271_DPC_Master_Rq_Pr2 DEBUGIN_ALI_CAN_0x499_DEBUGIN_Enabled DEBUGIN_ALI_CAN_0x499_ESP_Actv_Stat_EDR DEBUGIN_ALI_CAN_0x020_ISw_Stat DEBUGIN_ALI_CAN_0x20_DEBUGIN_Enabled DEBUGIN_ALI_CAN_0x094_DEBUGIN_Enabled DEBUGIN_ALI_CAN_0x094_VehAccel_Y_V2 DEBUGIN_ALI_CAN_0x094_VehAccel_X_V2 DEBUGIN_ALI_CAN_0x020_DEBUGIN_Enabled DEBUGIN_ALI_CAN_0x020_RevGR_Engg DEBUGIN_ALI_CAN_0x11F_DEBUGIN_Enabled DEBUGIN_ALI_CAN_0x11F_EF_Actv DEBUGIN_ALI_CAN_0x096_DEBUGIN_Enabled DEBUGIN_ALI_CAN_0x096_VehYawRate_Raw ESP_ASR_Logic_inactive DEBUGIN_ELK_Lock_Status_RL1_enable DEBUGIN_ELK_Lock_Status_RL2_enable DEBUGIN_ELK_Lock_Status_RR1_enable DEBUGIN_ELK_Algo_Status_RL1_enable DEBUGIN_ELK_Algo_Status_RL2_enable DEBUGIN_ELK_Algo_Status_RR1_enable DEBUGIN_ELK_ECU_Status_RL1_enable DEBUGIN_ELK_ECU_Status_RL2_enable DEBUGIN_ELK_ECU_Status_RR1_enable DEBUGIN_HMI_ABL_Rx_Status_enable DEBUGIN_HMI_ABL_FR_RetractRequest_enable DEBUGIN_HMI_ABL_FL_RetractRequest_enable DEBUGIN_HMI_ABL_RL1_RetractRequest_enable DEBUGIN_HMI_ABL_RL2_RetractRequest_enable DEBUGIN_HMI_ABL_RR1_RetractRequest_enable DEBUGIN_HMI_ACR_Rx_Status_enable DEBUGIN_HMI_ACR_FR_RetractRequest_enable DEBUGIN_HMI_ACR_FL_RetractRequest_enable DEBUGIN_HMI_ACR_RL1_RetractRequest_enable DEBUGIN_HMI_ACR_RL2_RetractRequest_enable DEBUGIN_HMI_ACR_RR1_RetractRequest_enable DEBUGIN_HMI_ELK_Rx_Status_enable DEBUGIN_HMI_ELK_RL1_LockingRequest_enable DEBUGIN_HMI_ELK_FR_LockingRequest_enable DEBUGIN_HMI_ELK_FL_LockingRequest_enable DEBUGIN_HMI_ELK_RL2_LockingRequest_enable DEBUGIN_HMI_ELK_RR1_LockingRequest_enable DEBUGIN_HMI_ELK_ResetErrorFlags_enable DEBUGIN_HMI_ISB_FL_Rx_Status_enable DEBUGIN_HMI_ISB_FL_AddressByte1_byte_enable DEBUGIN_HMI_ISB_FL_ColorBlue_byte_enable DEBUGIN_HMI_ISB_FL_ColorGreen_byte_enable DEBUGIN_HMI_ISB_FL_ColorRed_byte_enable DEBUGIN_HMI_ISB_FL_Intensity_perc_enable DEBUGIN_HMI_ISB_FL_Normalization_bool_enable DEBUGIN_HMI_ISB_FL_Transitionspeed_nibble_enable DEBUGIN_HMI_ISB_FL_AddressByte0_byte_enable DEBUGIN_HMI_ISB_FL_GroupOrModule_bool_enable DEBUGIN_HMI_ISB_FR_Rx_Status_enable DEBUGIN_HMI_ISB_FR_AddressByte1_enable DEBUGIN_HMI_ISB_FR_ColorBlue_enable DEBUGIN_HMI_ISB_FR_ColorGreen_enable DEBUGIN_HMI_ISB_FR_ColorRed_enable DEBUGIN_HMI_ISB_FR_Intensity_perc_enable DEBUGIN_HMI_ISB_FR_Normalization_enable DEBUGIN_HMI_ISB_FR_Transitionspeed_enable DEBUGIN_HMI_ISB_FR_AddressByte0_enable DEBUGIN_HMI_ISB_FR_GroupOrModule_enable DEBUGIN_HMI_ISB_RL1_Rx_Status_enable DEBUGIN_HMI_ISB_RL1_AddressByte1_enable DEBUGIN_HMI_ISB_RL1_ColorBlue_enable DEBUGIN_HMI_ISB_RL1_ColorGreen_enable DEBUGIN_HMI_ISB_RL1_ColorRed_enable DEBUGIN_HMI_ISB_RL1_Intensity_enable DEBUGIN_HMI_ISB_RL1_Normalization_enable DEBUGIN_HMI_ISB_RL1_Transitionspeed_enable DEBUGIN_HMI_ISB_RL1_AddressByte0_enable DEBUGIN_HMI_ISB_RL1_GroupOrModule_enable DEBUGIN_HMI_ISB_RL2_Rx_Status_enable DEBUGIN_HMI_ISB_RL2_AddressByte1_enable DEBUGIN_HMI_ISB_RL2_ColorBlue_enable DEBUGIN_HMI_ISB_RL2_ColorGreen_enable DEBUGIN_HMI_ISB_RL2_ColorRed_enable DEBUGIN_HMI_ISB_RL2_Intensity_enable DEBUGIN_HMI_ISB_RL2_Normalization_enable DEBUGIN_HMI_ISB_RL2_Transitionspeed_enable DEBUGIN_HMI_ISB_RL2_AddressByte0_enable DEBUGIN_HMI_ISB_RL2_GroupOrModule_enable DEBUGIN_HMI_ISB_RR1_Rx_Status_enable DEBUGIN_HMI_ISB_RR1_AddressByte1_enable DEBUGIN_HMI_ISB_RR1_ColorBlue_enable DEBUGIN_HMI_ISB_RR1_ColorGreen_enable DEBUGIN_HMI_ISB_RR1_ColorRed_enable DEBUGIN_HMI_ISB_RR1_Intensity_enable DEBUGIN_HMI_ISB_RR1_Normalization_enable DEBUGIN_HMI_ISB_RR1_Transitionspeed_enable DEBUGIN_HMI_ISB_RR1_AddressByte0_enable DEBUGIN_HMI_ISB_RR1_GroupOrModule_enable DEBUGIN_HMI_SEAL_ActivationRequest_enable DEBUGIN_OMS_FL_Rx_Status_enable DEBUGIN_OMS_FL_OccupantClassification_enable DEBUGIN_OMS_RL2_OccupantClassification_enable DEBUGIN_OMS_RR1_OccupantClassification_enable DEBUGIN_OMS_FR_OccupantPresence_enable DEBUGIN_OMS_RL1_OutOfPosition_enable DEBUGIN_OMS_FL_OccupantWeightMean_kg_enable DEBUGIN_OMS_FR_OccupantWeightStd_kg_enable DEBUGIN_OMS_RR1_OccupantPresence_enable DEBUGIN_OMS_RL1_OccupantPresence_enable DEBUGIN_OMS_RL2_OccupantPresence_enable DEBUGIN_OMS_FL_OccupantPresence_enable DEBUGIN_OMS_FR_OutOfPosition_enable DEBUGIN_OMS_RL2_OutOfPosition_enable DEBUGIN_OMS_FL_OutOfPosition_enable DEBUGIN_OMS_FL_OccupantWeightStd_kg_enable DEBUGIN_OMS_RR1_OutOfPosition_enable DEBUGIN_OMS_FR_OccupantWeightMean_kg_enable DEBUGIN_OMS_RR1_OccupantWeightMean_kg_enable DEBUGIN_OMS_FR_OccupantHeightMean_cm_enable DEBUGIN_OMS_RL1_OccupantHeightStd_cm_enable DEBUGIN_OMS_RL2_OccupantWeightStd_kg_enable DEBUGIN_OMS_FR_Rx_Status_enable DEBUGIN_OMS_RL1_OccupantWeightStd_kg_enable DEBUGIN_OMS_RL1_OccupantWeightMean_kg_enable DEBUGIN_OMS_RR1_OccupantWeightStd_kg_enable DEBUGIN_OMS_FL_OccupantHeightStd_cm_enable DEBUGIN_OMS_RL2_OccupantWeightMean_kg_enable DEBUGIN_OMS_FR_OccupantHeightStd_cm_enable DEBUGIN_OMS_FL_OccupantHeightMean_cm_enable DEBUGIN_OMS_RL1_OccupantHeightMean_cm_enable DEBUGIN_OMS_RL1_Rx_Status_enable DEBUGIN_OMS_RL2_OccupantHeightStd_cm_enable DEBUGIN_OMS_RL2_OccupantHeightMean_cm_enable DEBUGIN_OMS_RR1_OccupantHeightStd_cm_enable DEBUGIN_OMS_RR1_OccupantHeightMean_cm_enable DEBUGIN_OMS_RL2_Rx_Status_enable DEBUGIN_OMS_FL_HandsOnWheel_enable DEBUGIN_OMS_RR1_Rx_Status_enable DEBUGIN_OMS_RL1_OccupantClassification_enable DEBUGIN_OMS_FR_OccupantClassification_enable XCP_ABL_RL1_OperationRequest XCP_ABL_RL1_OperationRequest_Override XCP_ABL_RL2_OperationRequest XCP_ABL_RL2_OperationRequest_Override XCP_ABL_RR1_OperationRequest XCP_ABL_RR1_OperationRequest_Override XCP_ACB_FL_OperationRequest XCP_ACB_FL_OperationRequest_Override XCP_ACB_FR_OperationRequest XCP_ACB_FR_OperationRequest_Override XCP_ACR_FL_OperationRequest XCP_ACR_FL_OperationRequest_Override XCP_ACR_FR_OperationRequest XCP_ACR_FR_OperationRequest_Override XCP_ACR_RL1_OperationRequest XCP_ACR_RL1_OperationRequest_Override XCP_ACR_RL2_OperationRequest XCP_ACR_RL2_OperationRequest_Override XCP_ACR_RR1_OperationRequest XCP_ACR_RR1_OperationRequest_Override DEBUGIN_ALO_COM_Status_PumaFLCan_enable DEBUGIN_ALO_COM_Status_PumaFRCan_enable DEBUGIN_ALO_COM_Status_PumaRL1Can_enable DEBUGIN_ALO_COM_Status_PumaRL2Can_enable DEBUGIN_ALO_COM_Status_PumaRR1Can_enable DEBUGIN_ALO_HB_State_FR_enable DEBUGIN_ALO_HB_State_RL1_enable DEBUGIN_ALO_HB_State_RL2_enable DEBUGIN_ALO_HB_State_RR1_enable DEBUGIN_can6_0xB6_SPS_FR_SeatDirectionX DEBUGIN_can6_0xB6_SPS_FR_SeatDirectionX_Enable DEBUGIN_can6_0xB6_SPS_FR_SeatDirectionZ DEBUGIN_can6_0xB6_SPS_FR_SeatDirectionZ_Enable DEBUGIN_can6_0x194_WMS_RR1_WebbingMovement DEBUGIN_can6_0x194_WMS_RR1_WebbingMovement_Enable DEBUGIN_can6_0x194_WMS_RR1_SpoolAngle DEBUGIN_can6_0x194_WMS_RR1_SpoolAngle_Enable DEBUGIN_can6_0x194_WMS_RR1_SensorStatus DEBUGIN_can6_0x194_WMS_RR1_SensorStatus_Enable DEBUGIN_can6_0x193_WMS_R2_WebbingMovement DEBUGIN_can6_0x193_WMS_R2_WebbingMovement_Enable DEBUGIN_can6_0x193_WMS_R2_SpoolAngle DEBUGIN_can6_0x193_WMS_R2_SpoolAngle_Enable DEBUGIN_can6_0x193_WMS_R2_SensorStatus DEBUGIN_can6_0x193_WMS_R2_SensorStatus_Enable DEBUGIN_can6_0x192_WMS_R1_WebbingMovement DEBUGIN_can6_0x192_WMS_R1_WebbingMovement_Enable DEBUGIN_can6_0x192_WMS_R1_SpoolAngle DEBUGIN_can6_0x192_WMS_R1_SpoolAngle_Enable DEBUGIN_can6_0x192_WMS_R1_SensorStatus DEBUGIN_can6_0x192_WMS_R1_SensorStatus_Enable DEBUGIN_can6_0x191_WMS_FR_WebbingMovement DEBUGIN_can6_0x191_WMS_FR_WebbingMovement_Enable DEBUGIN_can6_0xB6_SPS_FR_SeatBackRestPosition DEBUGIN_can6_0xB6_SPS_FR_SeatBackRestPosition_Enable DEBUGIN_can6_0x191_WMS_FR_SpoolAngle DEBUGIN_can6_0x191_WMS_FR_SpoolAngle_Enable DEBUGIN_can6_0x191_WMS_FR_SensorStatus DEBUGIN_can6_0x191_WMS_FR_SensorStatus_Enable DEBUGIN_can6_0x190_WMS_FL_WebbingMovement_mm DEBUGIN_can6_0x190_WMS_FL_WebbingMovement_mm_Enable DEBUGIN_can6_0x190_WMS_FL_SpoolAngle_deg DEBUGIN_can6_0x190_WMS_FL_SpoolAngle_deg_Enable DEBUGIN_can6_0x190_WMS_FL_SensorStatus_bool DEBUGIN_can6_0x190_WMS_FL_SensorStatus_bool_Enable DEBUGIN_can6_0x198_ELK_FL_LockingStatus DEBUGIN_can6_0x198_ELK_FL_LockingStatus_Enable DEBUGIN_can6_0x198_ELK_FR_LockingStatus DEBUGIN_can6_0x198_ELK_FR_LockingStatus_Enable DEBUGIN_can6_0x198_ELK_R1_LockingStatus DEBUGIN_can6_0x198_ELK_R1_LockingStatus_Enable DEBUGIN_can6_0x198_ELK_R2_LockingStatus DEBUGIN_can6_0x198_ELK_R2_LockingStatus_Enable DEBUGIN_can6_0x198_ELK_RR1_LockingStatus DEBUGIN_can6_0x198_ELK_RR1_LockingStatus_Enable DEBUGIN_can6_0xB6_SPS_FR_FootRestPosition DEBUGIN_can6_0xB6_SPS_FR_FootRestPosition_Enable DEBUGIN_can6_0x199_BSW_FL_BuckleStatus DEBUGIN_can6_0x199_BSW_FL_BuckleStatus_Enable DEBUGIN_can6_0x199_BSW_FR_BuckleStatus DEBUGIN_can6_0x199_BSW_FR_BuckleStatus_Enable DEBUGIN_can6_0x199_BSW_R1_BuckleStatus DEBUGIN_can6_0x199_BSW_R1_BuckleStatus_Enable DEBUGIN_can6_0x199_BSW_R2_BuckleStatus DEBUGIN_can6_0x199_BSW_R2_BuckleStatus_Enable DEBUGIN_can6_0x199_BSW_RR1_BuckleStatus DEBUGIN_can6_0x199_BSW_RR1_BuckleStatus_Enable DEBUGIN_can6_0xB2_ARS_FL_TimeToFireAirbag DEBUGIN_can6_0xB2_ARS_FL_TimeToFireAirbag_Enable DEBUGIN_can6_0xB2_ARS_FL_TimeToFireSeatbelt DEBUGIN_can6_0xB2_ARS_FL_TimeToFireSeatbelt_Enable DEBUGIN_can6_0xB2_ARS_FR_TimeToFireAirbag DEBUGIN_can6_0xB2_ARS_FR_TimeToFireAirbag_Enable DEBUGIN_can6_0xB2_ARS_FR_TimeToFireSeatbelt DEBUGIN_can6_0xB2_ARS_FR_TimeToFireSeatbelt_Enable DEBUGIN_can6_0xB1_ARS_FL_InjuryRiskAdaptive DEBUGIN_can6_0xB1_ARS_FL_InjuryRiskAdaptive_Enable DEBUGIN_can6_0xB6_SPS_FR_HeadRestPosition DEBUGIN_can6_0xB6_SPS_FR_HeadRestPosition_Enable DEBUGIN_can6_0xB1_ARS_FL_InjuryRiskNonAdaptive DEBUGIN_can6_0xB1_ARS_FL_InjuryRiskNonAdaptive_Enable DEBUGIN_can6_0xB1_ARS_FR_InjuryRiskAdaptive DEBUGIN_can6_0xB1_ARS_FR_InjuryRiskAdaptive_Enable DEBUGIN_can6_0xB1_ARS_FR_InjuryRiskNonAdaptive DEBUGIN_can6_0xB1_ARS_FR_InjuryRiskNonAdaptive_Enable DEBUGIN_can6_0xB5_SPS_FL_SeatDirectionX DEBUGIN_can6_0xB5_SPS_FL_SeatDirectionX_Enable DEBUGIN_can6_0xB5_SPS_FL_SeatDirectionZ DEBUGIN_can6_0xB5_SPS_FL_SeatDirectionZ_Enable DEBUGIN_can6_0xB5_SPS_FL_SeatBackRestPosition DEBUGIN_can6_0xB5_SPS_FL_SeatBackRestPosition_Enable DEBUGIN_can6_0xB5_SPS_FL_FootRestPosition DEBUGIN_can6_0xB5_SPS_FL_FootRestPosition_Enable DEBUGIN_can6_0xB5_SPS_FL_HeadRestPosition DEBUGIN_can6_0xB5_SPS_FL_HeadRestPosition_Enable /end DEF_CHARACTERISTIC
 /begin LOC_MEASUREMENT panther_can6_in.asw_in_can6_0xA2_ISB_RL1_Normalization panther_can6_in.asw_in_can6_0xA2_ISB_RL1_Transitionspeed panther_can6_in.asw_in_can6_0xA2_ISB_RL1_GroupOrModule panther_can6_in.asw_in_can6_0xA2_ISB_RL1_AddressByte0 panther_can6_in.asw_in_can6_0xA2_ISB_RL1_AddressByte1 panther_can6_in.asw_in_can6_0xA1_rx_status panther_can6_in.asw_in_can6_0xA1_ISB_FR_ColorGreen panther_can6_in.asw_in_can6_0xA1_ISB_FR_ColorBlue panther_can6_in.asw_in_can6_0xA1_ISB_FR_ColorRed panther_can6_in.asw_in_can6_0xA1_ISB_FR_Intensity_perc panther_can6_in.asw_in_can6_0xA1_ISB_FR_Normalization panther_can6_in.asw_in_can6_0xA1_ISB_FR_Transitionspeed panther_can6_in.asw_in_can6_0xA1_ISB_FR_GroupOrModule panther_can6_in.asw_in_can6_0xA1_ISB_FR_AddressByte0 panther_can6_in.asw_in_can6_0xA1_ISB_FR_AddressByte1 panther_can6_in.asw_in_can6_0xA0_rx_status panther_can6_in.asw_in_can6_0xA0_ISB_FL_ColorGreen_byte panther_can6_in.asw_in_can6_0xA0_ISB_FL_ColorBlue_byte panther_can6_in.asw_in_can6_0xA0_ISB_FL_ColorRed_byte panther_can6_in.asw_in_can6_0xA0_ISB_FL_Intensity_perc panther_can6_in.asw_in_can6_0xA0_ISB_FL_Normalization_bool panther_can6_in.asw_in_can6_0xA0_ISB_FL_Transitionspeed_nibble panther_can6_in.asw_in_can6_0xA0_ISB_FL_GroupOrModule_bool panther_can6_in.asw_in_can6_0xA0_ISB_FL_AddressByte0_byte panther_can6_in.asw_in_can6_0xA0_ISB_FL_AddressByte1_byte panther_can6_in.asw_in_can6_0x92_rx_status panther_can6_in.asw_in_can6_0x92_ELK_FL_LockingRequest panther_can6_in.asw_in_can6_0x92_ELK_FR_LockingRequest panther_can6_in.asw_in_can6_0x92_ELK_RL1_LockingRequest panther_can6_in.asw_in_can6_0x92_ELK_RL2_LockingRequest panther_can6_in.asw_in_can6_0x92_ELK_RR1_LockingRequest panther_can6_in.asw_in_can6_0x91_rx_status panther_can6_in.asw_in_can6_0x91_ACR_FL_RetractRequest panther_can6_in.asw_in_can6_0x91_ACR_FR_RetractRequest panther_can6_in.asw_in_can6_0x91_ACR_RL1_RetractRequest panther_can6_in.asw_in_can6_0x91_ACR_RL2_RetractRequest panther_can6_in.asw_in_can6_0x91_ACR_RR1_RetractRequest panther_can6_in.asw_in_can6_0x90_rx_status panther_can6_in.asw_in_can6_0x90_ABL_FL_RetractRequest panther_can6_in.asw_in_can6_0x90_ABL_FR_RetractRequest panther_can6_in.asw_in_can6_0x90_ABL_RL1_RetractRequest panther_can6_in.asw_in_can6_0x90_ABL_RL2_RetractRequest panther_can6_in.asw_in_can6_0x90_ABL_RR1_RetractRequest panther_can6_in.asw_in_can6_0xB4_rx_status panther_can6_in.asw_in_can6_0xB4_OMS_FR_OccupantClassification panther_can6_in.asw_in_can6_0xB4_OMS_FR_OutOfPosition panther_can6_in.asw_in_can6_0xB4_OMS_FR_OccupantWeightMean_kg panther_can6_in.asw_in_can6_0xB4_OMS_FR_OccupantWeightStd_kg panther_can6_in.asw_in_can6_0xB4_OMS_FR_OccupantHeightMean_cm panther_can6_in.asw_in_can6_0xB4_OMS_FR_OccupantHeightStd_cm panther_can6_in.asw_in_can6_0xB4_OMS_FR_OccupantPresence_bool panther_can6_in.asw_in_can6_0xB3_rx_status panther_can6_in.asw_in_can6_0xB3_OMS_FL_HandsOnWheel panther_can6_in.asw_in_can6_0xB3_OMS_FL_OccupantClassification panther_can6_in.asw_in_can6_0xB3_OMS_FL_OutOfPosition panther_can6_in.asw_in_can6_0xB3_OMS_FL_OccupantWeightMean_kg panther_can6_in.asw_in_can6_0xB3_OMS_FL_OccupantWeightStd_kg panther_can6_in.asw_in_can6_0xB3_OMS_FL_OccupantHeightMean_cm panther_can6_in.asw_in_can6_0xB3_OMS_FL_OccupantHeightStd_cm panther_can6_in.asw_in_can6_0xB3_OMS_FL_OccupantPresence_bool panther_can6_in.asw_in_can6_0xB6_rx_status panther_can6_in.asw_in_can6_0xB6_OMS_RL2_OccupantClassification panther_can6_in.asw_in_can6_0xB6_OMS_RL2_OccupantHeightMean_cm panther_can6_in.asw_in_can6_0xB6_OMS_RL2_OccupantHeightStd_cm panther_can6_in.asw_in_can6_0xB6_OMS_RL2_OccupantPresence_bool panther_can6_in.asw_in_can6_0xB6_OMS_RL2_OccupantWeightMean_kg panther_can6_in.asw_in_can6_0xB6_OMS_RL2_OccupantWeightStd_kg panther_can6_in.asw_in_can6_0xB6_OMS_RL2_OutOfPosition panther_can6_in.asw_in_can6_0xB7_rx_status panther_can6_in.asw_in_can6_0xB7_OMS_RR1_OccupantClassification panther_can6_in.asw_in_can6_0xB7_OMS_RR1_OccupantHeightMean_cm panther_can6_in.asw_in_can6_0xB7_OMS_RR1_OccupantHeightStd_cm panther_can6_in.asw_in_can6_0xB7_OMS_RR1_OccupantPresence_bool panther_can6_in.asw_in_can6_0xB7_OMS_RR1_OccupantWeightMean_kg panther_can6_in.asw_in_can6_0xB7_OMS_RR1_OccupantWeightStd_kg panther_can6_in.asw_in_can6_0xB7_OMS_RR1_OutOfPosition panther_can6_in.asw_in_can6_0xB5_rx_status panther_can6_in.asw_in_can6_0xB5_OMS_RL1_OccupantClassification panther_can6_in.asw_in_can6_0xB5_OMS_RL1_OutOfPosition panther_can6_in.asw_in_can6_0xB5_OMS_RL1_OccupantHeightMean_cm panther_can6_in.asw_in_can6_0xB5_OMS_RL1_OccupantHeightStd_cm panther_can6_in.asw_in_can6_0xB5_OMS_RL1_OccupantPresence_bool panther_can6_in.asw_in_can6_0xB5_OMS_RL1_OccupantWeightMean_kg panther_can6_in.asw_in_can6_0xB5_OMS_RL1_OccupantWeightStd_kg panther_can6_in.asw_in_can6_0x92_ELK_ResetErrorFlags panther_can6_in.asw_in_can6_0x81_HMI_SEAL_ActivationRequest /end LOC_MEASUREMENT
/end FUNCTION
/begin FUNCTION ALRTL_DelayRequest_8_10.Instance1 "" /begin DEF_CHARACTERISTIC PARAM_VS_BRK_EPB_Delay_ms /end DEF_CHARACTERISTIC /begin LOC_MEASUREMENT DEBUGOUT_EPBD_brk_press_react_set_true /end LOC_MEASUREMENT /end FUNCTION
/begin FUNCTION ALRTL_DelayRequest_8_10.Instance2 "" /begin DEF_CHARACTERISTIC PARAM_VS_BRK_IBD_BRK_accel_delay_ms /end DEF_CHARACTERISTIC /begin LOC_MEASUREMENT DEBUGOUT_IBD_SARA_AX_thresh /end LOC_MEASUREMENT /end FUNCTION
/begin FUNCTION ALRTL_DelayRequest_8_10.Instance3 "" /begin DEF_CHARACTERISTIC PARAM_VS_BRK_IBD_BRK_signal_delay_ms /end DEF_CHARACTERISTIC /begin LOC_MEASUREMENT DEBUGOUT_IBD_brk_press_thresh /end LOC_MEASUREMENT /end FUNCTION
/begin FUNCTION ALRTL_HoldRRequest_8_10.Instance1 "" /begin DEF_CHARACTERISTIC PARAM_VS_BRK_ACC_BRK_switch_time_ms /end DEF_CHARACTERISTIC /end FUNCTION
/begin FUNCTION ALRTL_HoldRRequest_8_10.Instance2 "" /begin DEF_CHARACTERISTIC PARAM_VS_BRK_BRK_EPBD_Del_msec_1 /end DEF_CHARACTERISTIC /end FUNCTION
/begin FUNCTION ALRTL_MinHoldRequest_8_10.Instance1 "" /begin LOC_MEASUREMENT ADHOW_L3_set /end LOC_MEASUREMENT /end FUNCTION
/begin FUNCTION Ca107_ISB_Stateflow ""
 /begin LOC_MEASUREMENT Debug_ALI_ISw_Stat ISB_FunctionLogic_RL2_Debug_ISB_BuckleSignal ISB_FunctionLogic_RL2_Debug_ISB_OtherOpenDoor ISB_FunctionLogic_RL2_Debug_Open_Door ISB_FunctionLogic_RL2_Debug_PARAM_BlinkOnBuckleBeginDrive_ms panther_can1_in.asw_in_can1_0x20_VCLASS_CentrLockSys_Status /end LOC_MEASUREMENT
/end FUNCTION
/begin FUNCTION Ca124_ISB_Stateflow ""
 /begin LOC_MEASUREMENT Debug_ALI_ISw_Stat ISB_FunctionLogic_RR1_Debug_ISB_BuckleSignal ISB_FunctionLogic_RR1_Debug_ISB_OtherOpenDoor ISB_FunctionLogic_RR1_Debug_Open_Door ISB_FunctionLogic_RR1_Debug_PARAM_BlinkOnBuckleBeginDrive_ms panther_can1_in.asw_in_can1_0x20_VCLASS_CentrLockSys_Status /end LOC_MEASUREMENT
/end FUNCTION
/begin FUNCTION Ca141_Detection_of_DynamicBelt_Retraction "" /begin LOC_MEASUREMENT Debug_FNCActivationLevel /end LOC_MEASUREMENT /end FUNCTION
/begin FUNCTION Ca145_DelayTimerLogic "" /begin LOC_MEASUREMENT Debug_TiltedBack_True /end LOC_MEASUREMENT /end FUNCTION
/begin FUNCTION Ca150_DelayTimerLogic "" /begin LOC_MEASUREMENT Debug_LeanLeft_True /end LOC_MEASUREMENT /end FUNCTION
/begin FUNCTION Ca155_DelayTimerLogic "" /begin LOC_MEASUREMENT Debug_LeanRight_True /end LOC_MEASUREMENT /end FUNCTION
/begin FUNCTION Ca16_SMA_Comfort_ACB_ABLrear ""
 /begin DEF_CHARACTERISTIC XCP_in_ACB_CAN_Awake_Sa535 XCP_in_ACB_CLkS_LK_Sa535 XCP_in_ACB_CarSpeed_Sa535 XCP_in_ACB_ISw_Stat_Sa535 XCP_in_ACB_Open_Door_Sa535 /end DEF_CHARACTERISTIC
 /begin LOC_MEASUREMENT XCPOut_RearSeat_true_Sa535 XCPOut_Webbing_Output_Sa535 /end LOC_MEASUREMENT
/end FUNCTION
/begin FUNCTION Ca160_DelayTimerLogic "" /begin LOC_MEASUREMENT Debug_AibagClose_True /end LOC_MEASUREMENT /end FUNCTION
/begin FUNCTION Ca26_SMA_Comfort_ACB_ABLrear ""
 /begin DEF_CHARACTERISTIC XCP_in_ACB_CAN_Awake_Sa536 XCP_in_ACB_CLkS_LK_Sa536 XCP_in_ACB_CarSpeed_Sa536 XCP_in_ACB_ISw_Stat_Sa536 XCP_in_ACB_Open_Door_Sa536 /end DEF_CHARACTERISTIC
 /begin LOC_MEASUREMENT XCPOut_RearSeat_true_Sa536 XCPOut_Webbing_Output_Sa536 /end LOC_MEASUREMENT
/end FUNCTION
/begin FUNCTION Ca36_SMA_Comfort_ACB_ABLrear ""
 /begin DEF_CHARACTERISTIC XCP_in_ACB_CAN_Awake_Sa537 XCP_in_ACB_CLkS_LK_Sa537 XCP_in_ACB_CarSpeed_Sa537 XCP_in_ACB_ISw_Stat_Sa537 XCP_in_ACB_Open_Door_Sa537 /end DEF_CHARACTERISTIC
 /begin LOC_MEASUREMENT XCPOut_RearSeat_true_Sa537 XCPOut_Webbing_Output_Sa537 /end LOC_MEASUREMENT
/end FUNCTION
/begin FUNCTION Ca46_SMA_Comfort_ACB_ABLrear ""
 /begin DEF_CHARACTERISTIC XCP_in_ACB_CAN_Awake_Sa538 XCP_in_ACB_CLkS_LK_Sa538 XCP_in_ACB_CarSpeed_Sa538 XCP_in_ACB_ISw_Stat_Sa538 XCP_in_ACB_Open_Door_Sa538 /end DEF_CHARACTERISTIC
 /begin LOC_MEASUREMENT XCPOut_RearSeat_true_Sa538 XCPOut_Webbing_Output_Sa538 /end LOC_MEASUREMENT
/end FUNCTION
/begin FUNCTION Ca56_ISB_Stateflow ""
 /begin LOC_MEASUREMENT Debug_ALI_ISw_Stat ISB_FunctionLogic_FL_Debug_ISB_BuckleSignal ISB_FunctionLogic_FL_Debug_ISB_OtherOpenDoor ISB_FunctionLogic_FL_Debug_Open_Door ISB_FunctionLogic_FL_Debug_PARAM_BlinkOnBuckleBeginDrive_ms panther_can1_in.asw_in_can1_0x20_VCLASS_CentrLockSys_Status /end LOC_MEASUREMENT
/end FUNCTION
/begin FUNCTION Ca6_SMA_Comfort_ACB_ABLrear ""
 /begin DEF_CHARACTERISTIC XCP_in_ACB_CAN_Awake_Sa534 XCP_in_ACB_CLkS_LK_Sa534 XCP_in_ACB_CarSpeed_Sa534 XCP_in_ACB_ISw_Stat_Sa534 XCP_in_ACB_Open_Door_Sa534 /end DEF_CHARACTERISTIC
 /begin LOC_MEASUREMENT XCPOut_RearSeat_true_Sa534 XCPOut_Webbing_Output_Sa534 /end LOC_MEASUREMENT
/end FUNCTION
/begin FUNCTION Ca73_ISB_Stateflow ""
 /begin LOC_MEASUREMENT Debug_ALI_ISw_Stat ISB_FunctionLogic_FR_Debug_ISB_BuckleSignal ISB_FunctionLogic_FR_Debug_ISB_OtherOpenDoor ISB_FunctionLogic_FR_Debug_Open_Door ISB_FunctionLogic_FR_Debug_PARAM_BlinkOnBuckleBeginDrive_ms panther_can1_in.asw_in_can1_0x20_VCLASS_CentrLockSys_Status /end LOC_MEASUREMENT
/end FUNCTION
/begin FUNCTION Ca90_ISB_Stateflow ""
 /begin LOC_MEASUREMENT Debug_ALI_ISw_Stat ISB_FunctionLogic_RL1_Debug_ISB_BuckleSignal ISB_FunctionLogic_RL1_Debug_ISB_OtherOpenDoor ISB_FunctionLogic_RL1_Debug_Open_Door ISB_FunctionLogic_RL1_Debug_PARAM_BlinkOnBuckleBeginDrive_ms panther_can1_in.asw_in_can1_0x20_VCLASS_CentrLockSys_Status /end LOC_MEASUREMENT
/end FUNCTION
/begin FUNCTION CADAS_Stub_Write_Read21_Storage_of_ADAS_Seg_data.Instance1 ""
 /begin LOC_MEASUREMENT DebugOut_ADAS_Seg_Offset_pre DebugOut_ADAS_Seg_PathIdx_pre Debug_ADAS_Seg_Retr /end LOC_MEASUREMENT
/end FUNCTION
/begin FUNCTION CritSpeed.Instance1 "" /begin DEF_CHARACTERISTIC PARAM_VS_critical_speed_factor_Req_ADAS_Junc /end DEF_CHARACTERISTIC /begin LOC_MEASUREMENT angel_2_speed /end LOC_MEASUREMENT /end FUNCTION
/begin FUNCTION CritSpeed.Instance2 "" /begin DEF_CHARACTERISTIC PARAM_VS_critical_speed_factor_Req_ADAS_Junc /end DEF_CHARACTERISTIC /begin LOC_MEASUREMENT angel_2_speed /end LOC_MEASUREMENT /end FUNCTION
/begin FUNCTION CritSpeed.Instance3 "" /begin DEF_CHARACTERISTIC PARAM_VS_critical_speed_factor_Req_ADAS_Junc /end DEF_CHARACTERISTIC /begin LOC_MEASUREMENT angel_2_speed /end LOC_MEASUREMENT /end FUNCTION
/begin FUNCTION CritSpeed.Instance4 "" /begin DEF_CHARACTERISTIC PARAM_VS_critical_speed_factor_Req_ADAS_Junc /end DEF_CHARACTERISTIC /begin LOC_MEASUREMENT angel_2_speed /end LOC_MEASUREMENT /end FUNCTION
/begin FUNCTION CVS071_Read_ADAS_data.Instance1 ""
 /begin LOC_MEASUREMENT Array_ADAS_Curv_Offset Array_ADAS_Curv_PathIdx Array_ADAS_Curv_Value Curv_remind_Initial_index PathSegment_readIter_in StateControl_write fill_Iter_out remind_index_PathSegment VehiclePosn_Curv /end LOC_MEASUREMENT
/end FUNCTION
/begin FUNCTION CVS0713_Storage_of_ADAS_data.Instance1 "" /begin LOC_MEASUREMENT ADAS_Posn_Offset_FallingEdge /end LOC_MEASUREMENT /end FUNCTION
/begin FUNCTION CVSMA_PRIO1_ActivationLevel_WeightClass_related ""
 /begin LOC_MEASUREMENT ACR_ABL_Prioritization_FL_Debug_PRI_WeightClass ACR_ABL_Prioritization_FL_DEBUGOUT_PRI_Out_ACR_Retract /end LOC_MEASUREMENT
/end FUNCTION
/begin FUNCTION CVSMA_PRIO10_ActivationLevel_WeightClass_related ""
 /begin LOC_MEASUREMENT ACR_ABL_Prioritization_RL2_Debug_PRI_WeightClass ACR_ABL_Prioritization_RL2_DEBUGOUT_PRI_Out_ACR_Retract /end LOC_MEASUREMENT
/end FUNCTION
/begin FUNCTION CVSMA_PRIO13_ActivationLevel_WeightClass_related ""
 /begin LOC_MEASUREMENT ACR_ABL_Prioritization_RR1_Debug_PRI_WeightClass ACR_ABL_Prioritization_RR1_DEBUGOUT_PRI_Out_ACR_Retract /end LOC_MEASUREMENT
/end FUNCTION
/begin FUNCTION CVSMA_PRIO4_ActivationLevel_WeightClass_related ""
 /begin LOC_MEASUREMENT ACR_ABL_Prioritization_FR_Debug_PRI_WeightClass ACR_ABL_Prioritization_FR_DEBUGOUT_PRI_Out_ACR_Retract /end LOC_MEASUREMENT
/end FUNCTION
/begin FUNCTION CVSMA_PRIO7_ActivationLevel_WeightClass_related ""
 /begin LOC_MEASUREMENT ACR_ABL_Prioritization_RL1_Debug_PRI_WeightClass ACR_ABL_Prioritization_RL1_DEBUGOUT_PRI_Out_ACR_Retract /end LOC_MEASUREMENT
/end FUNCTION
/begin FUNCTION ELK_Manager ""
 /begin DEF_CHARACTERISTIC SELK_Manager11_DEBUGIN_Error_detected_enable DEBUGIN_ELK_WriteMemotyRequest_RL1_bool_enable DEBUGIN_ELK_WriteErrorCounter_RL1_Int16_enable SELK_Manager22_DEBUGIN_Error_detected_enable DEBUGIN_ELK_WriteMemotyRequest_RL2_bool_enable DEBUGIN_ELK_WriteErrorCounter_RL2_Int16_enable SELK_Manager33_DEBUGIN_Error_detected_enable DEBUGIN_ELK_WriteMemotyRequest_RR1_bool_enable DEBUGIN_ELK_WriteErrorCounter_RR1_Int16_enable /end DEF_CHARACTERISTIC
 /begin LOC_MEASUREMENT DEBUGOUT_ELK_Algo_Status_RL1 DEBUGOUT_ELK_Algo_Status_RL2 DEBUGOUT_ELK_Algo_Status_RR1 DEBUGOUT_HMI_ELK_ResetErrorFlags ELK_WriteErrorCounter_RL1_Int16 ELK_WriteMemotyRequest_RL1_bool SELK_Manager11_DEBUGOUT_Error_detected DEBUGOUT_ELK_WriteMemotyRequest_RL1_bool DEBUGOUT_ELK_WriteErrorCounter_RL1_Int16 ELK_WriteErrorCounter_RL2_Int16 ELK_WriteMemotyRequest_RL2_bool SELK_Manager22_DEBUGOUT_Error_detected DEBUGOUT_ELK_WriteMemotyRequest_RL2_bool DEBUGOUT_ELK_WriteErrorCounter_RL2_Int16 ELK_WriteErrorCounter_RR1_Int16 ELK_WriteMemotyRequest_RR1_bool SELK_Manager33_DEBUGOUT_Error_detected DEBUGOUT_ELK_WriteMemotyRequest_RR1_bool DEBUGOUT_ELK_WriteErrorCounter_RR1_Int16 panther_memory_out.asw_out_memory_read_request_bool panther_memory_out.asw_out_memory_write_request_bool panther_memory_out.asw_out_memory_data_1 panther_memory_out.asw_out_memory_data_2 panther_memory_out.asw_out_memory_data_3 panther_memory_in.asw_in_memory_data_1 panther_memory_in.asw_in_memory_data_2 panther_memory_in.asw_in_memory_data_3 /end LOC_MEASUREMENT
 /begin IN_MEASUREMENT DEBUGOUT_ELK_Algo_Status_RL1 DEBUGOUT_ELK_Algo_Status_RL2 DEBUGOUT_ELK_Algo_Status_RR1 DEBUGOUT_HMI_ELK_ResetErrorFlags /end IN_MEASUREMENT
 /begin SUB_FUNCTION SELK_Manager19_If_Action_Subsystem1 SELK_Manager17_If_Action_Subsystem1 SELK_Manager14_If_Action_Subsystem SELK_Manager15_If_Action_Subsystem1 SELK_Manager16_If_Action_Subsystem SELK_Manager18_If_Action_Subsystem SELK_Manager30_If_Action_Subsystem1 SELK_Manager28_If_Action_Subsystem1 SELK_Manager25_If_Action_Subsystem SELK_Manager26_If_Action_Subsystem1 SELK_Manager27_If_Action_Subsystem SELK_Manager29_If_Action_Subsystem SELK_Manager41_If_Action_Subsystem1 SELK_Manager39_If_Action_Subsystem1 SELK_Manager36_If_Action_Subsystem SELK_Manager37_If_Action_Subsystem1 SELK_Manager38_If_Action_Subsystem SELK_Manager40_If_Action_Subsystem /end SUB_FUNCTION
/end FUNCTION
/begin FUNCTION JncLogic.Instance1 ""
 /begin DEF_CHARACTERISTIC Enable_RetractReq_ADAS_Junc_MultipleLanes PARAM_VS_Pretime_Junction_Activation_s PARAM_VS_Indicator_Activation_Offset_s PARAM_VS_Pretime_Roundabout_Activation_s /end DEF_CHARACTERISTIC
 /begin LOC_MEASUREMENT Debug_Driving_on_CountryRoad Debugout_MultipleLanes Debug_Request_Roundabout Roundabout_ahead Debug_Request_Stub STUB_Left_turn_angle STUB_Right_turn_angle STUB_Left_turn_available STUB_Right_turn_available STUB_ThisPath_turn_angle ThisPath_enabled /end LOC_MEASUREMENT
 /begin SUB_FUNCTION CritSpeed.Instance1 CritSpeed.Instance2 CritSpeed.Instance3 CritSpeed.Instance4 /end SUB_FUNCTION
/end FUNCTION
/begin FUNCTION Sa100_If_Action_Subsystem1 ""
 /begin LOC_MEASUREMENT DEBUGOUT_HMI_ABL_RL1_RetractRequest panther_can6_in.asw_in_can6_0x90_ABL_RL1_RetractRequest /end LOC_MEASUREMENT
/end FUNCTION
/begin FUNCTION Sa101_If_Action_Subsystem "" /begin DEF_CHARACTERISTIC DEBUGIN_HMI_ABL_RL2_RetractRequest /end DEF_CHARACTERISTIC /begin LOC_MEASUREMENT DEBUGOUT_HMI_ABL_RL2_RetractRequest /end LOC_MEASUREMENT /end FUNCTION
/begin FUNCTION Sa102_If_Action_Subsystem1 ""
 /begin LOC_MEASUREMENT DEBUGOUT_HMI_ABL_RL2_RetractRequest panther_can6_in.asw_in_can6_0x90_ABL_RL2_RetractRequest /end LOC_MEASUREMENT
/end FUNCTION
/begin FUNCTION Sa103_If_Action_Subsystem "" /begin DEF_CHARACTERISTIC DEBUGIN_HMI_ABL_RR1_RetractRequest /end DEF_CHARACTERISTIC /begin LOC_MEASUREMENT DEBUGOUT_HMI_ABL_RR1_RetractRequest /end LOC_MEASUREMENT /end FUNCTION
/begin FUNCTION Sa104_If_Action_Subsystem1 ""
 /begin LOC_MEASUREMENT DEBUGOUT_HMI_ABL_RR1_RetractRequest panther_can6_in.asw_in_can6_0x90_ABL_RR1_RetractRequest /end LOC_MEASUREMENT
/end FUNCTION
/begin FUNCTION Sa111_If_Action_Subsystem "" /begin DEF_CHARACTERISTIC DEBUGIN_HMI_ACR_Rx_Status /end DEF_CHARACTERISTIC /begin LOC_MEASUREMENT DEBUGOUT_HMI_ACR_Rx_Status /end LOC_MEASUREMENT /end FUNCTION
/begin FUNCTION Sa112_If_Action_Subsystem1 ""
 /begin LOC_MEASUREMENT DEBUGOUT_HMI_ACR_Rx_Status panther_can6_in.asw_in_can6_0x91_rx_status /end LOC_MEASUREMENT
/end FUNCTION
/begin FUNCTION Sa113_If_Action_Subsystem "" /begin DEF_CHARACTERISTIC DEBUGIN_HMI_ACR_FR_RetractRequest /end DEF_CHARACTERISTIC /begin LOC_MEASUREMENT DEBUGOUT_HMI_ACR_FR_RetractRequest /end LOC_MEASUREMENT /end FUNCTION
/begin FUNCTION Sa114_If_Action_Subsystem1 ""
 /begin LOC_MEASUREMENT DEBUGOUT_HMI_ACR_FR_RetractRequest panther_can6_in.asw_in_can6_0x91_ACR_FR_RetractRequest /end LOC_MEASUREMENT
/end FUNCTION
/begin FUNCTION Sa115_If_Action_Subsystem "" /begin DEF_CHARACTERISTIC DEBUGIN_HMI_ACR_FL_RetractRequest /end DEF_CHARACTERISTIC /begin LOC_MEASUREMENT DEBUGOUT_HMI_ACR_FL_RetractRequest /end LOC_MEASUREMENT /end FUNCTION
/begin FUNCTION Sa116_If_Action_Subsystem1 ""
 /begin LOC_MEASUREMENT DEBUGOUT_HMI_ACR_FL_RetractRequest panther_can6_in.asw_in_can6_0x91_ACR_FL_RetractRequest /end LOC_MEASUREMENT
/end FUNCTION
/begin FUNCTION Sa117_If_Action_Subsystem "" /begin DEF_CHARACTERISTIC DEBUGIN_HMI_ACR_RL1_RetractRequest /end DEF_CHARACTERISTIC /begin LOC_MEASUREMENT DEBUGOUT_HMI_ACR_RL1_RetractRequest /end LOC_MEASUREMENT /end FUNCTION
/begin FUNCTION Sa118_If_Action_Subsystem1 ""
 /begin LOC_MEASUREMENT DEBUGOUT_HMI_ACR_RL1_RetractRequest panther_can6_in.asw_in_can6_0x91_ACR_RL1_RetractRequest /end LOC_MEASUREMENT
/end FUNCTION
/begin FUNCTION Sa119_If_Action_Subsystem "" /begin DEF_CHARACTERISTIC DEBUGIN_HMI_ACR_RL2_RetractRequest /end DEF_CHARACTERISTIC /begin LOC_MEASUREMENT DEBUGOUT_HMI_ACR_RL2_RetractRequest /end LOC_MEASUREMENT /end FUNCTION
/begin FUNCTION Sa120_If_Action_Subsystem1 ""
 /begin LOC_MEASUREMENT DEBUGOUT_HMI_ACR_RL2_RetractRequest panther_can6_in.asw_in_can6_0x91_ACR_RL2_RetractRequest /end LOC_MEASUREMENT
/end FUNCTION
/begin FUNCTION Sa121_If_Action_Subsystem "" /begin DEF_CHARACTERISTIC DEBUGIN_HMI_ACR_RR1_RetractRequest /end DEF_CHARACTERISTIC /begin LOC_MEASUREMENT DEBUGOUT_HMI_ACR_RR1_RetractRequest /end LOC_MEASUREMENT /end FUNCTION
/begin FUNCTION Sa122_If_Action_Subsystem1 ""
 /begin LOC_MEASUREMENT DEBUGOUT_HMI_ACR_RR1_RetractRequest panther_can6_in.asw_in_can6_0x91_ACR_RR1_RetractRequest /end LOC_MEASUREMENT
/end FUNCTION
/begin FUNCTION Sa130_If_Action_Subsystem "" /begin DEF_CHARACTERISTIC DEBUGIN_HMI_ELK_Rx_Status /end DEF_CHARACTERISTIC /begin LOC_MEASUREMENT DEBUGOUT_HMI_ELK_Rx_Status /end LOC_MEASUREMENT /end FUNCTION
/begin FUNCTION Sa131_If_Action_Subsystem1 ""
 /begin LOC_MEASUREMENT DEBUGOUT_HMI_ELK_Rx_Status panther_can6_in.asw_in_can6_0x92_rx_status /end LOC_MEASUREMENT
/end FUNCTION
/begin FUNCTION Sa132_If_Action_Subsystem "" /begin DEF_CHARACTERISTIC DEBUGIN_HMI_ELK_RL1_LockingRequest /end DEF_CHARACTERISTIC /begin LOC_MEASUREMENT DEBUGOUT_HMI_ELK_RL1_LockingRequest /end LOC_MEASUREMENT /end FUNCTION
/begin FUNCTION Sa133_If_Action_Subsystem1 ""
 /begin LOC_MEASUREMENT DEBUGOUT_HMI_ELK_RL1_LockingRequest panther_can6_in.asw_in_can6_0x92_ELK_RL1_LockingRequest /end LOC_MEASUREMENT
/end FUNCTION
/begin FUNCTION Sa134_If_Action_Subsystem "" /begin DEF_CHARACTERISTIC DEBUGIN_HMI_ELK_FR_LockingRequest /end DEF_CHARACTERISTIC /begin LOC_MEASUREMENT DEBUGOUT_HMI_ELK_FR_LockingRequest /end LOC_MEASUREMENT /end FUNCTION
/begin FUNCTION Sa135_If_Action_Subsystem1 ""
 /begin LOC_MEASUREMENT DEBUGOUT_HMI_ELK_FR_LockingRequest panther_can6_in.asw_in_can6_0x92_ELK_FR_LockingRequest /end LOC_MEASUREMENT
/end FUNCTION
/begin FUNCTION Sa136_If_Action_Subsystem "" /begin DEF_CHARACTERISTIC DEBUGIN_HMI_ELK_FL_LockingRequest /end DEF_CHARACTERISTIC /begin LOC_MEASUREMENT DEBUGOUT_HMI_ELK_FL_LockingRequest /end LOC_MEASUREMENT /end FUNCTION
/begin FUNCTION Sa137_If_Action_Subsystem1 ""
 /begin LOC_MEASUREMENT DEBUGOUT_HMI_ELK_FL_LockingRequest panther_can6_in.asw_in_can6_0x92_ELK_FL_LockingRequest /end LOC_MEASUREMENT
/end FUNCTION
/begin FUNCTION Sa138_If_Action_Subsystem "" /begin DEF_CHARACTERISTIC DEBUGIN_HMI_ELK_RL2_LockingRequest /end DEF_CHARACTERISTIC /begin LOC_MEASUREMENT DEBUGOUT_HMI_ELK_RL2_LockingRequest /end LOC_MEASUREMENT /end FUNCTION
/begin FUNCTION Sa139_If_Action_Subsystem1 ""
 /begin LOC_MEASUREMENT DEBUGOUT_HMI_ELK_RL2_LockingRequest panther_can6_in.asw_in_can6_0x92_ELK_RL2_LockingRequest /end LOC_MEASUREMENT
/end FUNCTION
/begin FUNCTION Sa140_If_Action_Subsystem "" /begin DEF_CHARACTERISTIC DEBUGIN_HMI_ELK_RR1_LockingRequest /end DEF_CHARACTERISTIC /begin LOC_MEASUREMENT DEBUGOUT_HMI_ELK_RR1_LockingRequest /end LOC_MEASUREMENT /end FUNCTION
/begin FUNCTION Sa141_If_Action_Subsystem1 ""
 /begin LOC_MEASUREMENT DEBUGOUT_HMI_ELK_RR1_LockingRequest panther_can6_in.asw_in_can6_0x92_ELK_RR1_LockingRequest /end LOC_MEASUREMENT
/end FUNCTION
/begin FUNCTION Sa142_If_Action_Subsystem "" /begin DEF_CHARACTERISTIC DEBUGIN_HMI_ELK_ResetErrorFlags /end DEF_CHARACTERISTIC /begin LOC_MEASUREMENT DEBUGOUT_HMI_ELK_ResetErrorFlags /end LOC_MEASUREMENT /end FUNCTION
/begin FUNCTION Sa143_If_Action_Subsystem1 ""
 /begin LOC_MEASUREMENT DEBUGOUT_HMI_ELK_ResetErrorFlags panther_can6_in.asw_in_can6_0x92_ELK_ResetErrorFlags /end LOC_MEASUREMENT
/end FUNCTION
/begin FUNCTION Sa154_If_Action_Subsystem "" /begin DEF_CHARACTERISTIC DEBUGIN_HMI_ISB_FL_Rx_Status /end DEF_CHARACTERISTIC /begin LOC_MEASUREMENT DEBUGOUT_HMI_ISB_FL_Rx_Status /end LOC_MEASUREMENT /end FUNCTION
/begin FUNCTION Sa155_If_Action_Subsystem1 ""
 /begin LOC_MEASUREMENT DEBUGOUT_HMI_ISB_FL_Rx_Status panther_can6_in.asw_in_can6_0xA0_rx_status /end LOC_MEASUREMENT
/end FUNCTION
/begin FUNCTION Sa156_If_Action_Subsystem "" /begin DEF_CHARACTERISTIC DEBUGIN_HMI_ISB_FL_AddressByte1_byte /end DEF_CHARACTERISTIC /begin LOC_MEASUREMENT DEBUGOUT_HMI_ISB_FL_AddressByte1_byte /end LOC_MEASUREMENT /end FUNCTION
/begin FUNCTION Sa157_If_Action_Subsystem1 ""
 /begin LOC_MEASUREMENT DEBUGOUT_HMI_ISB_FL_AddressByte1_byte panther_can6_in.asw_in_can6_0xA0_ISB_FL_AddressByte1_byte /end LOC_MEASUREMENT
/end FUNCTION
/begin FUNCTION Sa158_If_Action_Subsystem "" /begin DEF_CHARACTERISTIC DEBUGIN_HMI_ISB_FL_ColorBlue_byte /end DEF_CHARACTERISTIC /begin LOC_MEASUREMENT DEBUGOUT_HMI_ISB_FL_ColorBlue_byte /end LOC_MEASUREMENT /end FUNCTION
/begin FUNCTION Sa159_If_Action_Subsystem1 ""
 /begin LOC_MEASUREMENT DEBUGOUT_HMI_ISB_FL_ColorBlue_byte panther_can6_in.asw_in_can6_0xA0_ISB_FL_ColorBlue_byte /end LOC_MEASUREMENT
/end FUNCTION
/begin FUNCTION Sa160_If_Action_Subsystem "" /begin DEF_CHARACTERISTIC DEBUGIN_HMI_ISB_FL_ColorGreen_byte /end DEF_CHARACTERISTIC /begin LOC_MEASUREMENT DEBUGOUT_HMI_ISB_FL_ColorGreen_byte /end LOC_MEASUREMENT /end FUNCTION
/begin FUNCTION Sa161_If_Action_Subsystem1 ""
 /begin LOC_MEASUREMENT DEBUGOUT_HMI_ISB_FL_ColorGreen_byte panther_can6_in.asw_in_can6_0xA0_ISB_FL_ColorGreen_byte /end LOC_MEASUREMENT
/end FUNCTION
/begin FUNCTION Sa162_If_Action_Subsystem "" /begin DEF_CHARACTERISTIC DEBUGIN_HMI_ISB_FL_ColorRed_byte /end DEF_CHARACTERISTIC /begin LOC_MEASUREMENT DEBUGOUT_HMI_ISB_FL_ColorRed_byte /end LOC_MEASUREMENT /end FUNCTION
/begin FUNCTION Sa163_If_Action_Subsystem1 ""
 /begin LOC_MEASUREMENT DEBUGOUT_HMI_ISB_FL_ColorRed_byte panther_can6_in.asw_in_can6_0xA0_ISB_FL_ColorRed_byte /end LOC_MEASUREMENT
/end FUNCTION
/begin FUNCTION Sa164_If_Action_Subsystem "" /begin DEF_CHARACTERISTIC DEBUGIN_HMI_ISB_FL_Intensity_perc /end DEF_CHARACTERISTIC /begin LOC_MEASUREMENT DEBUGOUT_HMI_ISB_FL_Intensity_perc /end LOC_MEASUREMENT /end FUNCTION
/begin FUNCTION Sa165_If_Action_Subsystem1 ""
 /begin LOC_MEASUREMENT DEBUGOUT_HMI_ISB_FL_Intensity_perc panther_can6_in.asw_in_can6_0xA0_ISB_FL_Intensity_perc /end LOC_MEASUREMENT
/end FUNCTION
/begin FUNCTION Sa166_If_Action_Subsystem "" /begin DEF_CHARACTERISTIC DEBUGIN_HMI_ISB_FL_Normalization_bool /end DEF_CHARACTERISTIC /begin LOC_MEASUREMENT DEBUGOUT_HMI_ISB_FL_Normalization_bool /end LOC_MEASUREMENT /end FUNCTION
/begin FUNCTION Sa167_If_Action_Subsystem1 ""
 /begin LOC_MEASUREMENT DEBUGOUT_HMI_ISB_FL_Normalization_bool panther_can6_in.asw_in_can6_0xA0_ISB_FL_Normalization_bool /end LOC_MEASUREMENT
/end FUNCTION
/begin FUNCTION Sa168_If_Action_Subsystem "" /begin DEF_CHARACTERISTIC DEBUGIN_HMI_ISB_FL_Transitionspeed_nibble /end DEF_CHARACTERISTIC /begin LOC_MEASUREMENT DEBUGOUT_HMI_ISB_FL_Transitionspeed_nibble /end LOC_MEASUREMENT /end FUNCTION
/begin FUNCTION Sa169_If_Action_Subsystem1 ""
 /begin LOC_MEASUREMENT DEBUGOUT_HMI_ISB_FL_Transitionspeed_nibble panther_can6_in.asw_in_can6_0xA0_ISB_FL_Transitionspeed_nibble /end LOC_MEASUREMENT
/end FUNCTION
/begin FUNCTION Sa170_If_Action_Subsystem "" /begin DEF_CHARACTERISTIC DEBUGIN_HMI_ISB_FL_AddressByte0_byte /end DEF_CHARACTERISTIC /begin LOC_MEASUREMENT DEBUGOUT_HMI_ISB_FL_AddressByte0_byte /end LOC_MEASUREMENT /end FUNCTION
/begin FUNCTION Sa171_If_Action_Subsystem1 ""
 /begin LOC_MEASUREMENT DEBUGOUT_HMI_ISB_FL_AddressByte0_byte panther_can6_in.asw_in_can6_0xA0_ISB_FL_AddressByte0_byte /end LOC_MEASUREMENT
/end FUNCTION
/begin FUNCTION Sa172_If_Action_Subsystem "" /begin DEF_CHARACTERISTIC DEBUGIN_HMI_ISB_FL_GroupOrModule_bool /end DEF_CHARACTERISTIC /begin LOC_MEASUREMENT DEBUGOUT_HMI_ISB_FL_GroupOrModule_bool /end LOC_MEASUREMENT /end FUNCTION
/begin FUNCTION Sa173_If_Action_Subsystem1 ""
 /begin LOC_MEASUREMENT DEBUGOUT_HMI_ISB_FL_GroupOrModule_bool panther_can6_in.asw_in_can6_0xA0_ISB_FL_GroupOrModule_bool /end LOC_MEASUREMENT
/end FUNCTION
/begin FUNCTION Sa184_If_Action_Subsystem "" /begin DEF_CHARACTERISTIC DEBUGIN_HMI_ISB_FR_Rx_Status /end DEF_CHARACTERISTIC /begin LOC_MEASUREMENT DEBUGOUT_HMI_ISB_FR_Rx_Status /end LOC_MEASUREMENT /end FUNCTION
/begin FUNCTION Sa185_If_Action_Subsystem1 ""
 /begin LOC_MEASUREMENT DEBUGOUT_HMI_ISB_FR_Rx_Status panther_can6_in.asw_in_can6_0xA1_rx_status /end LOC_MEASUREMENT
/end FUNCTION
/begin FUNCTION Sa186_If_Action_Subsystem "" /begin DEF_CHARACTERISTIC DEBUGIN_HMI_ISB_FR_AddressByte1 /end DEF_CHARACTERISTIC /begin LOC_MEASUREMENT DEBUGOUT_HMI_ISB_FR_AddressByte1 /end LOC_MEASUREMENT /end FUNCTION
/begin FUNCTION Sa187_If_Action_Subsystem1 ""
 /begin LOC_MEASUREMENT DEBUGOUT_HMI_ISB_FR_AddressByte1 panther_can6_in.asw_in_can6_0xA1_ISB_FR_AddressByte1 /end LOC_MEASUREMENT
/end FUNCTION
/begin FUNCTION Sa188_If_Action_Subsystem "" /begin DEF_CHARACTERISTIC DEBUGIN_HMI_ISB_FR_ColorBlue /end DEF_CHARACTERISTIC /begin LOC_MEASUREMENT DEBUGOUT_HMI_ISB_FR_ColorBlue /end LOC_MEASUREMENT /end FUNCTION
/begin FUNCTION Sa189_If_Action_Subsystem1 ""
 /begin LOC_MEASUREMENT DEBUGOUT_HMI_ISB_FR_ColorBlue panther_can6_in.asw_in_can6_0xA1_ISB_FR_ColorBlue /end LOC_MEASUREMENT
/end FUNCTION
/begin FUNCTION Sa190_If_Action_Subsystem "" /begin DEF_CHARACTERISTIC DEBUGIN_HMI_ISB_FR_ColorGreen /end DEF_CHARACTERISTIC /begin LOC_MEASUREMENT DEBUGOUT_HMI_ISB_FR_ColorGreen /end LOC_MEASUREMENT /end FUNCTION
/begin FUNCTION Sa191_If_Action_Subsystem1 ""
 /begin LOC_MEASUREMENT DEBUGOUT_HMI_ISB_FR_ColorGreen panther_can6_in.asw_in_can6_0xA1_ISB_FR_ColorGreen /end LOC_MEASUREMENT
/end FUNCTION
/begin FUNCTION Sa192_If_Action_Subsystem "" /begin DEF_CHARACTERISTIC DEBUGIN_HMI_ISB_FR_ColorRed /end DEF_CHARACTERISTIC /begin LOC_MEASUREMENT DEBUGOUT_HMI_ISB_FR_ColorRed /end LOC_MEASUREMENT /end FUNCTION
/begin FUNCTION Sa193_If_Action_Subsystem1 ""
 /begin LOC_MEASUREMENT DEBUGOUT_HMI_ISB_FR_ColorRed panther_can6_in.asw_in_can6_0xA1_ISB_FR_ColorRed /end LOC_MEASUREMENT
/end FUNCTION
/begin FUNCTION Sa194_If_Action_Subsystem "" /begin DEF_CHARACTERISTIC DEBUGIN_HMI_ISB_FR_Intensity_perc /end DEF_CHARACTERISTIC /begin LOC_MEASUREMENT DEBUGOUT_HMI_ISB_FR_Intensity_perc /end LOC_MEASUREMENT /end FUNCTION
/begin FUNCTION Sa195_If_Action_Subsystem1 ""
 /begin LOC_MEASUREMENT DEBUGOUT_HMI_ISB_FR_Intensity_perc panther_can6_in.asw_in_can6_0xA1_ISB_FR_Intensity_perc /end LOC_MEASUREMENT
/end FUNCTION
/begin FUNCTION Sa196_If_Action_Subsystem "" /begin DEF_CHARACTERISTIC DEBUGIN_HMI_ISB_FR_Normalization /end DEF_CHARACTERISTIC /begin LOC_MEASUREMENT DEBUGOUT_HMI_ISB_FR_Normalization /end LOC_MEASUREMENT /end FUNCTION
/begin FUNCTION Sa197_If_Action_Subsystem1 ""
 /begin LOC_MEASUREMENT DEBUGOUT_HMI_ISB_FR_Normalization panther_can6_in.asw_in_can6_0xA1_ISB_FR_Normalization /end LOC_MEASUREMENT
/end FUNCTION
/begin FUNCTION Sa198_If_Action_Subsystem "" /begin DEF_CHARACTERISTIC DEBUGIN_HMI_ISB_FR_Transitionspeed /end DEF_CHARACTERISTIC /begin LOC_MEASUREMENT DEBUGOUT_HMI_ISB_FR_Transitionspeed /end LOC_MEASUREMENT /end FUNCTION
/begin FUNCTION Sa199_If_Action_Subsystem1 ""
 /begin LOC_MEASUREMENT DEBUGOUT_HMI_ISB_FR_Transitionspeed panther_can6_in.asw_in_can6_0xA1_ISB_FR_Transitionspeed /end LOC_MEASUREMENT
/end FUNCTION
/begin FUNCTION Sa200_If_Action_Subsystem "" /begin DEF_CHARACTERISTIC DEBUGIN_HMI_ISB_FR_AddressByte0 /end DEF_CHARACTERISTIC /begin LOC_MEASUREMENT DEBUGOUT_HMI_ISB_FR_AddressByte0 /end LOC_MEASUREMENT /end FUNCTION
/begin FUNCTION Sa201_If_Action_Subsystem1 ""
 /begin LOC_MEASUREMENT DEBUGOUT_HMI_ISB_FR_AddressByte0 panther_can6_in.asw_in_can6_0xA1_ISB_FR_AddressByte0 /end LOC_MEASUREMENT
/end FUNCTION
/begin FUNCTION Sa202_If_Action_Subsystem "" /begin DEF_CHARACTERISTIC DEBUGIN_HMI_ISB_FR_GroupOrModule /end DEF_CHARACTERISTIC /begin LOC_MEASUREMENT DEBUGOUT_HMI_ISB_FR_GroupOrModule /end LOC_MEASUREMENT /end FUNCTION
/begin FUNCTION Sa203_If_Action_Subsystem1 ""
 /begin LOC_MEASUREMENT DEBUGOUT_HMI_ISB_FR_GroupOrModule panther_can6_in.asw_in_can6_0xA1_ISB_FR_GroupOrModule /end LOC_MEASUREMENT
/end FUNCTION
/begin FUNCTION Sa214_If_Action_Subsystem "" /begin DEF_CHARACTERISTIC DEBUGIN_HMI_ISB_RL1_Rx_Status /end DEF_CHARACTERISTIC /begin LOC_MEASUREMENT DEBUGOUT_HMI_ISB_RL1_Rx_Status /end LOC_MEASUREMENT /end FUNCTION
/begin FUNCTION Sa215_If_Action_Subsystem1 ""
 /begin LOC_MEASUREMENT DEBUGOUT_HMI_ISB_RL1_Rx_Status panther_can6_in.asw_in_can6_0xA2_rx_status /end LOC_MEASUREMENT
/end FUNCTION
/begin FUNCTION Sa216_If_Action_Subsystem "" /begin DEF_CHARACTERISTIC DEBUGIN_HMI_ISB_RL1_AddressByte1 /end DEF_CHARACTERISTIC /begin LOC_MEASUREMENT DEBUGOUT_HMI_ISB_RL1_AddressByte1 /end LOC_MEASUREMENT /end FUNCTION
/begin FUNCTION Sa217_If_Action_Subsystem1 ""
 /begin LOC_MEASUREMENT DEBUGOUT_HMI_ISB_RL1_AddressByte1 panther_can6_in.asw_in_can6_0xA2_ISB_RL1_AddressByte1 /end LOC_MEASUREMENT
/end FUNCTION
/begin FUNCTION Sa218_If_Action_Subsystem "" /begin DEF_CHARACTERISTIC DEBUGIN_HMI_ISB_RL1_ColorBlue /end DEF_CHARACTERISTIC /begin LOC_MEASUREMENT DEBUGOUT_HMI_ISB_RL1_ColorBlue /end LOC_MEASUREMENT /end FUNCTION
/begin FUNCTION Sa219_If_Action_Subsystem1 ""
 /begin LOC_MEASUREMENT DEBUGOUT_HMI_ISB_RL1_ColorBlue panther_can6_in.asw_in_can6_0xA2_ISB_RL1_ColorBlue /end LOC_MEASUREMENT
/end FUNCTION
/begin FUNCTION Sa220_If_Action_Subsystem "" /begin DEF_CHARACTERISTIC DEBUGIN_HMI_ISB_RL1_ColorGreen /end DEF_CHARACTERISTIC /begin LOC_MEASUREMENT DEBUGOUT_HMI_ISB_RL1_ColorGreen /end LOC_MEASUREMENT /end FUNCTION
/begin FUNCTION Sa221_If_Action_Subsystem1 ""
 /begin LOC_MEASUREMENT DEBUGOUT_HMI_ISB_RL1_ColorGreen panther_can6_in.asw_in_can6_0xA2_ISB_RL1_ColorGreen /end LOC_MEASUREMENT
/end FUNCTION
/begin FUNCTION Sa222_If_Action_Subsystem "" /begin DEF_CHARACTERISTIC DEBUGIN_HMI_ISB_RL1_ColorRed /end DEF_CHARACTERISTIC /begin LOC_MEASUREMENT DEBUGOUT_HMI_ISB_RL1_ColorRed /end LOC_MEASUREMENT /end FUNCTION
/begin FUNCTION Sa223_If_Action_Subsystem1 ""
 /begin LOC_MEASUREMENT DEBUGOUT_HMI_ISB_RL1_ColorRed panther_can6_in.asw_in_can6_0xA2_ISB_RL1_ColorRed /end LOC_MEASUREMENT
/end FUNCTION
/begin FUNCTION Sa224_If_Action_Subsystem "" /begin DEF_CHARACTERISTIC DEBUGIN_HMI_ISB_RL1_Intensity /end DEF_CHARACTERISTIC /begin LOC_MEASUREMENT DEBUGOUT_HMI_ISB_RL1_Intensity /end LOC_MEASUREMENT /end FUNCTION
/begin FUNCTION Sa225_If_Action_Subsystem1 ""
 /begin LOC_MEASUREMENT DEBUGOUT_HMI_ISB_RL1_Intensity panther_can6_in.asw_in_can6_0xA2_ISB_RL1_Intensity /end LOC_MEASUREMENT
/end FUNCTION
/begin FUNCTION Sa226_If_Action_Subsystem "" /begin DEF_CHARACTERISTIC DEBUGIN_HMI_ISB_RL1_Normalization /end DEF_CHARACTERISTIC /begin LOC_MEASUREMENT DEBUGOUT_HMI_ISB_RL1_Normalization /end LOC_MEASUREMENT /end FUNCTION
/begin FUNCTION Sa227_If_Action_Subsystem1 ""
 /begin LOC_MEASUREMENT DEBUGOUT_HMI_ISB_RL1_Normalization panther_can6_in.asw_in_can6_0xA2_ISB_RL1_Normalization /end LOC_MEASUREMENT
/end FUNCTION
/begin FUNCTION Sa228_If_Action_Subsystem "" /begin DEF_CHARACTERISTIC DEBUGIN_HMI_ISB_RL1_Transitionspeed /end DEF_CHARACTERISTIC /begin LOC_MEASUREMENT DEBUGOUT_HMI_ISB_RL1_Transitionspeed /end LOC_MEASUREMENT /end FUNCTION
/begin FUNCTION Sa229_If_Action_Subsystem1 ""
 /begin LOC_MEASUREMENT DEBUGOUT_HMI_ISB_RL1_Transitionspeed panther_can6_in.asw_in_can6_0xA2_ISB_RL1_Transitionspeed /end LOC_MEASUREMENT
/end FUNCTION
/begin FUNCTION Sa230_If_Action_Subsystem "" /begin DEF_CHARACTERISTIC DEBUGIN_HMI_ISB_RL1_AddressByte0 /end DEF_CHARACTERISTIC /begin LOC_MEASUREMENT DEBUGOUT_HMI_ISB_RL1_AddressByte0 /end LOC_MEASUREMENT /end FUNCTION
/begin FUNCTION Sa231_If_Action_Subsystem1 ""
 /begin LOC_MEASUREMENT DEBUGOUT_HMI_ISB_RL1_AddressByte0 panther_can6_in.asw_in_can6_0xA2_ISB_RL1_AddressByte0 /end LOC_MEASUREMENT
/end FUNCTION
/begin RECORD_LAYOUT FLOAT32_IEEE_COL_DIRECT FNC_VALUES 1 FLOAT32_IEEE COLUMN_DIR DIRECT /end RECORD_LAYOUT
/begin RECORD_LAYOUT SWORD_COL_DIRECT FNC_VALUES 1 SWORD COLUMN_DIR DIRECT /end RECORD_LAYOUT
/begin RECORD_LAYOUT UBYTE_COL_DIRECT FNC_VALUES 1 UBYTE COLUMN_DIR DIRECT /end RECORD_LAYOUT
/begin RECORD_LAYOUT UWORD_COL_DIRECT FNC_VALUES 1 UWORD COLUMN_DIR DIRECT /end RECORD_LAYOUT
/end MODULE
/end PROJECT
