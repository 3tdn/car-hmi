ASAP2_VERSION 1 61
/begin PROJECT AL_Mainfunction_PANTHER ""
/begin HEADER "ASAP2 File for PANTHER" /* Comment */ VERSION "2026-08-21 20:40:07" PROJECT_NO PRJ1 /end HEADER
/begin MODULE PANTHER "Prototyping unit for modelbased application"
/begin COMPU_VTAB_RANGE CM_OS_Database_OK.CONVERSION "Verbal table for OS database check" 3 0 1970855136 "not OK!" 1970855137 1970855137 "OK" 1970855138 4294967295 "not OK!" DEFAULT_VALUE "" /end COMPU_VTAB_RANGE
/begin COMPU_METHOD CM_OS_Database_OK.CONVERSION "Conversion method for OS database check" TAB_VERB "%3.1" "" COMPU_TAB_REF CM_OS_Database_OK.CONVERSION /end COMPU_METHOD
/begin MEASUREMENT OS_Database_OK "OS variable to check if a2l-database is consistent to software running on the ECU" ULONG CM_OS_Database_OK.CONVERSION 0 0 0 4294967295 ECU_ADDRESS 0x24000004 FORMAT "%3.0" /end MEASUREMENT
/begin COMPU_VTAB_RANGE CM_OS_Status.CONVERSION "Verbal table for OS status indicator" 15 0 1 "OK" 2 3 "Stopped" 4 7 "Stopped due to overrun of an Application-Task" 8 15 "Stopped due to overrun of the internal Diagnostic-Task" 16 31 "Overrun of the internal Communication-Task detected" 32 63 "Overrun of the internal Timer-Task detected" 64 127 "Stopped due to GND-Failure" 128 255 "Stopped due to AGND-Failure" 256 511 "Invalid Task Configuration" 512 1023 "Invalid App. Configuration" 1024 2047 "System Initialization failed" 2048 4095 "FPGA and BSW version are incompatible, FPGA firmware needs to be updated" 4096 8191 "FPGA and BSW version are incompatible, BSW version needs to be updated" 8192 16383 "PANTHER Configuration invalid, contact support" 16384 4294967295 "unknown" DEFAULT_VALUE "" /end COMPU_VTAB_RANGE
/begin COMPU_METHOD CM_OS_Status.CONVERSION "Conversion method for OS state indicator" TAB_VERB "%3.1" "" COMPU_TAB_REF CM_OS_Status.CONVERSION /end COMPU_METHOD
/begin MEASUREMENT OS_Status "OS variable to check status of the operating system" ULONG CM_OS_Status.CONVERSION 0 0 0 4294967295 ECU_ADDRESS 0x2402af34 FORMAT "%3.0" /end MEASUREMENT
/begin COMPU_VTAB_RANGE CM_OS_AppConfig.CONVERSION "Verbal table for application state indicator" 26 0 1 "OK" 2 3 "OS Error" 4 7 "Ethernet 100BASE-TX Error" 8 15 "Ethernet 100BASE-T1 Error" 16 31 "CAN Error" 32 63 "FlexRay Error" 64 127 "LIN Error" 128 255 "XCP Ethernet 100BASE-TX Error" 256 511 "XCP Ethernet 100BASE-T1 Error" 512 1023 "XCP CAN Error" 1024 2047 "XCP USB Error" 2048 4095 "DIGITAL-OUT Error" 4096 8191 "DIGITAL-OUT (Exp.) Error" 8192 16383 "DIGITAL-In Error" 16384 32767 "ANALOG-OUT Error" 32768 65535 "ANALOG-IN Error" 65536 131071 "TEMP-IN Error" 131072 262143 "QDEC Error" 262144 524287 "SENT Error" 524288 1048575 "SERIAL Error" 1048576 2097151 "FRAM Error" 2097152 4194303 "SLEEP Error" 4194304 8388607 "EXTERNAL-SENSOR-SUPPLY Error" 8388608 16777215 "PSI5 Error" 16777216 33554431 "POWER HVMPI Error" 33554432 67108863 "POWER HVMPI FPGA Error" 67108864 134217727 "POWER LVMPI Error" 134217728 268435455 "POWER LVMPI FPGA Error" 268435456 4294967295 "unknown" DEFAULT_VALUE "" /end COMPU_VTAB_RANGE
/begin COMPU_METHOD CM_OS_AppConfig.CONVERSION "Conversion method for application state indicator" TAB_VERB "%3.1" "" COMPU_TAB_REF CM_OS_AppConfig.CONVERSION /end COMPU_METHOD
/begin COMPU_VTAB_RANGE CM_OS_ErrorSource.CONVERSION "Verbal table for error-state indicator" 42 0 0 "OK" 1 1 "BOOT Error" 2 3 "OS Error" 4 7 "APPLICATION-CONFIG Error" 8 15 "COM Error" 16 31 "COM CAN1 Error" 32 63 "COM CAN2 Error" 64 127 "COM CAN3 Error" 128 255 "COM CAN4 Error" 256 511 "COM CAN5 Error" 512 1023 "COM CAN6 Error" 1024 2047 "COM LIN1 Error" 2048 4095 "COM LIN2 Error" 4096 8191 "COM ETH-100BASE-TX Error" 8192 16383 "COM ETH-100BASE-T1 Error" 16384 32767 "COM USB Error" 32768 65535 "MAL ADC1 Error" 65536 131071 "MAL ADC2 Error" 131072 262143 "MAL ADC3 Error" 262144 524287 "MAL FMC1 Error" 524288 1048575 "MAL FMC2 Error" 1048576 2097151 "MAL FMC3 Error" 2097152 4194303 "MAL FMC4 Error" 4194304 8388607 "MAL QSPI Error" 8388608 16777215 "MAL SPI Error" 16777216 33554431 "MAL SPI-FRAM Error" 33554432 67108863 "MAL SPI-FPGA1 Error" 67108864 134217727 "MAL SPI-FPGA2 Error" 134217728 268435455 "MAL SPI-FPGA3 Error" 268435456 536870911 "MAL SPI-FPGA4 Error" 536870912 1073741823 "MAL TIM-POWER Error" 1073741824 2147483647 "MAL TIM1 Error" 2147483648 4294967295 "MAL TIM2 Error" 4294967296 8589934591 "MAL TIM3 Error" 8589934592 17179869183 "MAL TIM4 Error" 17179869184 34359738367 "MAL TIM5 Error" 34359738368 68719476735 "MAL TIM8 Error" 68719476736 137438953471 "MAL TIM15 Error" 137438953472 274877906943 "MAL LPTIM Error" 274877906944 549755813887 "MAL IWDG Error" 549755813888 1099511627775 "MAL WWDG Error" 1099511627776 2199023255551 "POWER HVMPI Error" 2199023255552 4398046511103 "POWER LVMPI Error" 4398046511104 16802186044414 "unknown" DEFAULT_VALUE "" /end COMPU_VTAB_RANGE
/begin COMPU_METHOD CM_OS_ErrorSource.CONVERSION "Conversion method for error-state indicator" TAB_VERB "%3.1" "" COMPU_TAB_REF CM_OS_ErrorSource.CONVERSION /end COMPU_METHOD
/begin COMPU_VTAB CM_OS_ResetSourceSW.CONVERSION "Verbal table for software reset sources/exceptions" /* convers_type */ TAB_VERB 5 0 "n/a" 1 "Hard Fault" 2 "Memory Management" 3 "Bus Fault" 4 "Usage Fault" DEFAULT_VALUE "n/a" /end COMPU_VTAB
/begin COMPU_METHOD CM_OS_ResetSourceSW.CONVERSION "Conversion method for software reset sources/exceptions" TAB_VERB "%3.1" "" COMPU_TAB_REF CM_OS_ResetSourceSW.CONVERSION /end COMPU_METHOD
/begin COMPU_VTAB CM_OS_ResetSourceHW.CONVERSION "Verbal table for hardware reset sources" /* convers_type */ TAB_VERB 31 0 "COLDSTART / STARTUP" 1 "FPGA, SUPPLY, WATCHDOG, BUTTON" 2 "MCU, SUPPLY, WATCHDOG, BUTTON" 3 "SUPPLY, WATCHDOG, BUTTON" 4 "MCU, FPGA, WATCHDOG, BUTTON" 5 "FPGA, WATCHDOG, BUTTON" 6 "MCU, WATCHDOG, BUTTON" 7 "WATCHDOG, BUTTON" 8 "MCU, FPGA, SUPPLY, BUTTON" 9 "FPGA, SUPPLY, BUTTON" 10 "MCU, SUPPLY, BUTTON" 11 "SUPPLY, BUTTON" 12 "MCU, FPGA, BUTTON" 13 "FPGA, BUTTON" 14 "MCU, BUTTON" 15 "BUTTON" 16 "MCU, FPGA, SUPPLY, WATCHDOG" 17 "FPGA, SUPPLY, WATCHDOG" 18 "MCU, SUPPLY, WATCHDOG" 19 "SUPPLY, WATCHDOG" 20 "MCU, FPGA, WATCHDOG" 21 "FPGA, WATCHDOG" 22 "MCU, WATCHDOG" 23 "WATCHDOG" 24 "MCU, FPGA, SUPPLY" 25 "FPGA, SUPPLY" 26 "MCU, SUPPLY" 27 "SUPPLY" 28 "MCU, FPGA" 29 "FPGA" 30 "MCU" DEFAULT_VALUE "n/a" /end COMPU_VTAB
/begin COMPU_METHOD CM_OS_ResetSourceHW.CONVERSION "Conversion method for hardware reset sources" TAB_VERB "%3.1" "" COMPU_TAB_REF CM_OS_ResetSourceHW.CONVERSION /end COMPU_METHOD
/begin MEASUREMENT OS_AppConfig "OS variable to check state of application configuration" ULONG CM_OS_AppConfig.CONVERSION 0 0 0 4294967295 ECU_ADDRESS 0x2402aedc FORMAT "%10.0" /end MEASUREMENT
/begin MEASUREMENT OS_InitErrorSource "OS variable to check state of system-initialization" A_UINT64 CM_OS_ErrorSource.CONVERSION 0 0 0 9223372036854775807 ECU_ADDRESS 0x2402af60 FORMAT "%10.0" /end MEASUREMENT
/begin MEASUREMENT OS_InitErrorSourceLast "OS variable to check error-state of system-initialization" A_UINT64 CM_OS_ErrorSource.CONVERSION 0 0 0 9223372036854775807 ECU_ADDRESS 0x2402aee8 FORMAT "%10.0" /end MEASUREMENT
/begin MEASUREMENT OS_InitErrorReason "OS variable to check error-state of system-initialization" ULONG NO_COMPU_METHOD 0 0 0 4294967295 ECU_ADDRESS 0x2402af14 FORMAT "%10.0" /end MEASUREMENT
/begin MEASUREMENT OS_BootloaderVersion "Version of the Bootloader-Firmware" ULONG NO_COMPU_METHOD 0 0 0 4294967295 ECU_ADDRESS 0x2402afd0 FORMAT "%10.0" /end MEASUREMENT
/begin MEASUREMENT OS_FpgaVersion "Version of the FPGA-Firmware" ULONG NO_COMPU_METHOD 0 0 0 4294967295 ECU_ADDRESS 0x2402ad74 FORMAT "%10.0" /end MEASUREMENT
/begin MEASUREMENT OS_BswVersion "Version of the running Basic-Software" ULONG NO_COMPU_METHOD 0 0 0 4294967295 ECU_ADDRESS 0x24017458 FORMAT "%10.0" /end MEASUREMENT
/begin MEASUREMENT OS_RtiVersion "Version of the used Runtime-Interface" ULONG NO_COMPU_METHOD 0 0 0 4294967295 ECU_ADDRESS 0x24000000 FORMAT "%10.0" /end MEASUREMENT
/begin COMPU_METHOD OS_TaskLoad.CONVERSION "Conversion method for task load monitoring variable" RAT_FUNC "%3.1" "%" COEFFS 0 0.01 0 0 0 1 /end COMPU_METHOD
/begin COMPU_METHOD OS_Time.CONVERSION "Conversion method for time monitoring variables" RAT_FUNC "%1.0" "us" /* µs */ COEFFS 0 1e-6 0 0 0 1 /end COMPU_METHOD
/begin MEASUREMENT OS_ResetCounterSW "OS Reset Counter Software" ULONG NO_COMPU_METHOD 0 0 0 4294967295 ECU_ADDRESS 0x2402aef4 FORMAT "%10.0" /end MEASUREMENT
/begin MEASUREMENT OS_ResetSourceSW_1 "OS Reset Source Software 1" ULONG CM_OS_ResetSourceSW.CONVERSION 0 0 0 4294967295 ECU_ADDRESS 0x2402afbc FORMAT "%10.0" /end MEASUREMENT
/begin MEASUREMENT OS_ResetSourceSW_2 "OS Reset Source Software 2" ULONG CM_OS_ResetSourceSW.CONVERSION 0 0 0 4294967295 ECU_ADDRESS 0x2402afac FORMAT "%10.0" /end MEASUREMENT
/begin MEASUREMENT OS_ResetSourceSW_3 "OS Reset Source Software 3" ULONG CM_OS_ResetSourceSW.CONVERSION 0 0 0 4294967295 ECU_ADDRESS 0x2402afb4 FORMAT "%10.0" /end MEASUREMENT
/begin MEASUREMENT OS_ResetSourceSW_4 "OS Reset Source Software 4" ULONG CM_OS_ResetSourceSW.CONVERSION 0 0 0 4294967295 ECU_ADDRESS 0x2402af78 FORMAT "%10.0" /end MEASUREMENT
/begin MEASUREMENT OS_ResetSourceSW_5 "OS Reset Source Software 5" ULONG CM_OS_ResetSourceSW.CONVERSION 0 0 0 4294967295 ECU_ADDRESS 0x2402af80 FORMAT "%10.0" /end MEASUREMENT
/begin MEASUREMENT OS_ResetSourceSW_6 "OS Reset Source Software 6" ULONG CM_OS_ResetSourceSW.CONVERSION 0 0 0 4294967295 ECU_ADDRESS 0x2402af74 FORMAT "%10.0" /end MEASUREMENT
/begin MEASUREMENT OS_ResetSourceSW_7 "OS Reset Source Software 7" ULONG CM_OS_ResetSourceSW.CONVERSION 0 0 0 4294967295 ECU_ADDRESS 0x2402af70 FORMAT "%10.0" /end MEASUREMENT
/begin MEASUREMENT OS_ResetCounterHW "OS Reset Counter Hardware" ULONG NO_COMPU_METHOD 0 0 0 4294967295 ECU_ADDRESS 0x2402afa8 FORMAT "%10.0" /end MEASUREMENT
/begin MEASUREMENT OS_ResetSourceHW_1 "OS Reset Source Hardware 1" UBYTE CM_OS_ResetSourceHW.CONVERSION 0 0 0 255 ECU_ADDRESS 0x2402af0b FORMAT "%10.0" /end MEASUREMENT
/begin MEASUREMENT OS_ResetSourceHW_2 "OS Reset Source Hardware 2" UBYTE CM_OS_ResetSourceHW.CONVERSION 0 0 0 255 ECU_ADDRESS 0x2402af0a FORMAT "%10.0" /end MEASUREMENT
/begin MEASUREMENT OS_ResetSourceHW_3 "OS Reset Source Hardware 3" UBYTE CM_OS_ResetSourceHW.CONVERSION 0 0 0 255 ECU_ADDRESS 0x2402af0c FORMAT "%10.0" /end MEASUREMENT
/begin MEASUREMENT OS_ResetSourceHW_4 "OS Reset Source Hardware 4" UBYTE CM_OS_ResetSourceHW.CONVERSION 0 0 0 255 ECU_ADDRESS 0x2402af0d FORMAT "%10.0" /end MEASUREMENT
/begin MEASUREMENT OS_ResetSourceHW_5 "OS Reset Source Hardware 5" UBYTE CM_OS_ResetSourceHW.CONVERSION 0 0 0 255 ECU_ADDRESS 0x2402af09 FORMAT "%10.0" /end MEASUREMENT
/begin MEASUREMENT OS_ResetSourceHW_6 "OS Reset Source Hardware 6" UBYTE CM_OS_ResetSourceHW.CONVERSION 0 0 0 255 ECU_ADDRESS 0x2402af08 FORMAT "%10.0" /end MEASUREMENT
/begin MEASUREMENT OS_ResetSourceHW_7 "OS Reset Source Hardware 7" UBYTE CM_OS_ResetSourceHW.CONVERSION 0 0 0 255 ECU_ADDRESS 0x2402aef8 FORMAT "%10.0" /end MEASUREMENT
/begin COMPU_METHOD CM_OS_CpuTemp.CONVERSION "Conversion method for CPU temperature" RAT_FUNC "%3.0" "degC" COEFFS 0 1 0 0 0 1 /end COMPU_METHOD
/begin MEASUREMENT OS_CpuTemp "Temperature of the CPU" SBYTE CM_OS_CpuTemp.CONVERSION 0 0 -128 127 ECU_ADDRESS 0x2402af54 FORMAT "%10.0" /end MEASUREMENT
/begin MEASUREMENT OS_TaskLoad1 "OS variable to monitor cpu load for task 1" FLOAT32_IEEE OS_TaskLoad.CONVERSION 0 0 0 100 ECU_ADDRESS 0x2402af88 FORMAT "%3.2" /end MEASUREMENT
/begin MEASUREMENT OS_Overrun1 "OS variable to monitor application overruns for task 1" UBYTE NO_COMPU_METHOD 0 0 0 1 ECU_ADDRESS 0x2402afb0 FORMAT "%1.0" /end MEASUREMENT
/begin MEASUREMENT OS_RunTime1 "OS variable to monitor actual application runtime for task 1" FLOAT32_IEEE OS_Time.CONVERSION 0 0 0 1 ECU_ADDRESS 0x2402afcc FORMAT "%2.0" /end MEASUREMENT
/begin MEASUREMENT OS_RunTimeMax1 "OS variable to display maximal application runtime for task 1" FLOAT32_IEEE OS_Time.CONVERSION 0 0 0 1 ECU_ADDRESS 0x2402af38 FORMAT "%2.0" /end MEASUREMENT
/begin MEASUREMENT OS_RunTimeMin1 "OS variable to display minimum application runtime for task 1" FLOAT32_IEEE OS_Time.CONVERSION 0 0 0 1 ECU_ADDRESS 0x2402afc4 FORMAT "%2.0" /end MEASUREMENT
/begin MEASUREMENT OS_TaskTime1 "OS variable to display application sample time for task 1" FLOAT32_IEEE OS_Time.CONVERSION 0 0 0 1 ECU_ADDRESS 0x2402af20 FORMAT "%2.0" /end MEASUREMENT
/begin GROUP OS "Variables to display Operating System (OS) information" ROOT /begin SUB_GROUP OS_Reset /end SUB_GROUP /begin FUNCTION_LIST /end FUNCTION_LIST /begin REF_CHARACTERISTIC /end REF_CHARACTERISTIC
 /begin REF_MEASUREMENT OS_Database_OK OS_BswVersion OS_RtiVersion OS_BootloaderVersion OS_FpgaVersion OS_Status OS_AppConfig OS_CpuTemp OS_TaskTime1 OS_RunTime1 OS_RunTimeMax1 OS_RunTimeMin1 OS_TaskLoad1 OS_Overrun1 /end REF_MEASUREMENT
/end GROUP
/begin GROUP OS_Reset "Variables to display information about the past resets" /begin SUB_GROUP /end SUB_GROUP /begin FUNCTION_LIST /end FUNCTION_LIST /begin REF_CHARACTERISTIC /end REF_CHARACTERISTIC
 /begin REF_MEASUREMENT OS_ResetSourceHW_1 OS_ResetSourceHW_2 OS_ResetSourceHW_3 OS_ResetSourceHW_4 OS_ResetSourceHW_5 OS_ResetCounterSW OS_ResetSourceSW_1 OS_ResetSourceSW_2 OS_ResetSourceSW_3 OS_ResetSourceSW_4 OS_ResetSourceSW_5 /end REF_MEASUREMENT
/end GROUP
/begin MOD_COMMON "" ALIGNMENT_BYTE 1 ALIGNMENT_WORD 2 ALIGNMENT_LONG 4 ALIGNMENT_FLOAT32_IEEE 4 ALIGNMENT_FLOAT64_IEEE 8 BYTE_ORDER MSB_LAST DEPOSIT ABSOLUTE /end MOD_COMMON
/begin CHARACTERISTIC ACR_ABL_Prioritization_FL_DD_SVSMA_PRIO9_PARAM_ACB_PRI_ActLevel_Deact "" VALUE 0x24016300 UBYTE_COL_DIRECT 0 NO_COMPU_METHOD 0 255 /end CHARACTERISTIC
/begin CHARACTERISTIC ACR_ABL_Prioritization_FL_PARAM_ACR_PRI_ActLevel_Deact_XX "" VALUE 0x24016308 SWORD_COL_DIRECT 0 NO_COMPU_METHOD -32768 32767 /end CHARACTERISTIC
/begin CHARACTERISTIC ACR_ABL_Prioritization_FL_PARAM_VS_PRI_ActLvl_Del_msec_1 "" VALUE 0x24016456 SWORD_COL_DIRECT 0 NO_COMPU_METHOD -32768 32767 /end CHARACTERISTIC
/begin CHARACTERISTIC ACR_ABL_Prioritization_FL_PARAM_VS_PRI_ActLvl_Del_msec_2 "" VALUE 0x24016462 SWORD_COL_DIRECT 0 NO_COMPU_METHOD -32768 32767 /end CHARACTERISTIC
/begin CHARACTERISTIC ACR_ABL_Prioritization_FL_Parameter_OccupantClass "" VALUE 0x24016306 SBYTE_COL_DIRECT 0 NO_COMPU_METHOD -128 127 /end CHARACTERISTIC
/begin CHARACTERISTIC ACR_ABL_Prioritization_FL_Parameter_OccupantClass_enable "" VALUE 0x24016305 SBYTE_COL_DIRECT 0 NO_COMPU_METHOD -128 127 /end CHARACTERISTIC
/begin CHARACTERISTIC ACR_ABL_Prioritization_FR_DD_SVSMA_PRIO65_PARAM_ACB_PRI_ActLevel_Deact "" VALUE 0x24016301 UBYTE_COL_DIRECT 0 NO_COMPU_METHOD 0 255 /end CHARACTERISTIC
/begin CHARACTERISTIC ACR_ABL_Prioritization_FR_PARAM_ACR_PRI_ActLevel_Deact_XX "" VALUE 0x24016334 SWORD_COL_DIRECT 0 NO_COMPU_METHOD -32768 32767 /end CHARACTERISTIC
/begin CHARACTERISTIC ACR_ABL_Prioritization_FR_PARAM_VS_PRI_ActLvl_Del_msec_1 "" VALUE 0x2401643e SWORD_COL_DIRECT 0 NO_COMPU_METHOD -32768 32767 /end CHARACTERISTIC
/begin CHARACTERISTIC ACR_ABL_Prioritization_FR_PARAM_VS_PRI_ActLvl_Del_msec_2 "" VALUE 0x2401644a SWORD_COL_DIRECT 0 NO_COMPU_METHOD -32768 32767 /end CHARACTERISTIC
/begin CHARACTERISTIC ACR_ABL_Prioritization_FR_Parameter_OccupantClass "" VALUE 0x24016333 SBYTE_COL_DIRECT 0 NO_COMPU_METHOD -128 127 /end CHARACTERISTIC
/begin CHARACTERISTIC ACR_ABL_Prioritization_FR_Parameter_OccupantClass_enable "" VALUE 0x24016332 SBYTE_COL_DIRECT 0 NO_COMPU_METHOD -128 127 /end CHARACTERISTIC
/begin CHARACTERISTIC ACR_ABL_Prioritization_RL1_DD_SVSMA_PRIO121_PARAM_ACB_PRI_ActLevel_Deact "" VALUE 0x24016302 UBYTE_COL_DIRECT 0 NO_COMPU_METHOD 0 255 /end CHARACTERISTIC
/begin CHARACTERISTIC ACR_ABL_Prioritization_RL1_PARAM_ACR_PRI_ActLevel_Deact_XX "" VALUE 0x24016364 SWORD_COL_DIRECT 0 NO_COMPU_METHOD -32768 32767 /end CHARACTERISTIC
/begin CHARACTERISTIC ACR_ABL_Prioritization_RL1_PARAM_VS_PRI_ActLvl_Del_msec_1 "" VALUE 0x24016426 SWORD_COL_DIRECT 0 NO_COMPU_METHOD -32768 32767 /end CHARACTERISTIC
/begin CHARACTERISTIC ACR_ABL_Prioritization_RL1_PARAM_VS_PRI_ActLvl_Del_msec_2 "" VALUE 0x24016432 SWORD_COL_DIRECT 0 NO_COMPU_METHOD -32768 32767 /end CHARACTERISTIC
/begin CHARACTERISTIC ACR_ABL_Prioritization_RL1_Parameter_OccupantClass "" VALUE 0x24016363 SBYTE_COL_DIRECT 0 NO_COMPU_METHOD -128 127 /end CHARACTERISTIC
/begin CHARACTERISTIC ACR_ABL_Prioritization_RL1_Parameter_OccupantClass_enable "" VALUE 0x24016362 SBYTE_COL_DIRECT 0 NO_COMPU_METHOD -128 127 /end CHARACTERISTIC
/begin CHARACTERISTIC ACR_ABL_Prioritization_RL2_DD_SVSMA_PRIO177_PARAM_ACB_PRI_ActLevel_Deact "" VALUE 0x24016303 UBYTE_COL_DIRECT 0 NO_COMPU_METHOD 0 255 /end CHARACTERISTIC
/begin CHARACTERISTIC ACR_ABL_Prioritization_RL2_PARAM_ACR_PRI_ActLevel_Deact_XX "" VALUE 0x24016394 SWORD_COL_DIRECT 0 NO_COMPU_METHOD -32768 32767 /end CHARACTERISTIC
/begin CHARACTERISTIC ACR_ABL_Prioritization_RL2_PARAM_VS_PRI_ActLvl_Del_msec_1 "" VALUE 0x2401640e SWORD_COL_DIRECT 0 NO_COMPU_METHOD -32768 32767 /end CHARACTERISTIC
/begin CHARACTERISTIC ACR_ABL_Prioritization_RL2_PARAM_VS_PRI_ActLvl_Del_msec_2 "" VALUE 0x2401641a SWORD_COL_DIRECT 0 NO_COMPU_METHOD -32768 32767 /end CHARACTERISTIC
/begin CHARACTERISTIC ACR_ABL_Prioritization_RL2_Parameter_OccupantClass "" VALUE 0x24016393 SBYTE_COL_DIRECT 0 NO_COMPU_METHOD -128 127 /end CHARACTERISTIC
/begin CHARACTERISTIC ACR_ABL_Prioritization_RL2_Parameter_OccupantClass_enable "" VALUE 0x24016392 SBYTE_COL_DIRECT 0 NO_COMPU_METHOD -128 127 /end CHARACTERISTIC
/begin CHARACTERISTIC ACR_ABL_Prioritization_RR1_DD_SVSMA_PRIO233_PARAM_ACB_PRI_ActLevel_Deact "" VALUE 0x24016304 UBYTE_COL_DIRECT 0 NO_COMPU_METHOD 0 255 /end CHARACTERISTIC
/begin CHARACTERISTIC ACR_ABL_Prioritization_RR1_PARAM_ACR_PRI_ActLevel_Deact_XX "" VALUE 0x240163c4 SWORD_COL_DIRECT 0 NO_COMPU_METHOD -32768 32767 /end CHARACTERISTIC
/begin CHARACTERISTIC ACR_ABL_Prioritization_RR1_PARAM_VS_PRI_ActLvl_Del_msec_1 "" VALUE 0x240163f4 SWORD_COL_DIRECT 0 NO_COMPU_METHOD -32768 32767 /end CHARACTERISTIC
/begin CHARACTERISTIC ACR_ABL_Prioritization_RR1_PARAM_VS_PRI_ActLvl_Del_msec_2 "" VALUE 0x24016402 SWORD_COL_DIRECT 0 NO_COMPU_METHOD -32768 32767 /end CHARACTERISTIC
/begin CHARACTERISTIC ACR_ABL_Prioritization_RR1_Parameter_OccupantClass "" VALUE 0x240163c3 SBYTE_COL_DIRECT 0 NO_COMPU_METHOD -128 127 /end CHARACTERISTIC
/begin CHARACTERISTIC ACR_ABL_Prioritization_RR1_Parameter_OccupantClass_enable "" VALUE 0x240163c2 SBYTE_COL_DIRECT 0 NO_COMPU_METHOD -128 127 /end CHARACTERISTIC
/begin CHARACTERISTIC DEBUGIN_EBLT_ReleaseRequest_FL "" VALUE 0x240162c2 UBYTE_COL_DIRECT 0 NO_COMPU_METHOD 0 255 /end CHARACTERISTIC
/begin CHARACTERISTIC DEBUGIN_EBLT_ReleaseRequest_FL_Enabled "" VALUE 0x240162c1 UBYTE_COL_DIRECT 0 NO_COMPU_METHOD 0 1 /end CHARACTERISTIC
/begin CHARACTERISTIC DEBUGIN_EBLT_ReleaseRequest_FR "" VALUE 0x240162c0 UBYTE_COL_DIRECT 0 NO_COMPU_METHOD 0 3 /end CHARACTERISTIC
/begin CHARACTERISTIC DEBUGIN_EBLT_ReleaseRequest_FR_Enabled "" VALUE 0x240162bf UBYTE_COL_DIRECT 0 NO_COMPU_METHOD 0 1 /end CHARACTERISTIC
/begin CHARACTERISTIC DEBUGIN_EBLT_ReleaseRequest_RL1 "" VALUE 0x240162be UBYTE_COL_DIRECT 0 NO_COMPU_METHOD 0 3 /end CHARACTERISTIC
/begin CHARACTERISTIC DEBUGIN_EBLT_ReleaseRequest_RL1_Enabled "" VALUE 0x240162bd UBYTE_COL_DIRECT 0 NO_COMPU_METHOD 0 1 /end CHARACTERISTIC
/begin CHARACTERISTIC DEBUGIN_EBLT_ReleaseRequest_RL2 "" VALUE 0x240162bc UBYTE_COL_DIRECT 0 NO_COMPU_METHOD 0 3 /end CHARACTERISTIC
/begin CHARACTERISTIC DEBUGIN_EBLT_ReleaseRequest_RL2_Enabled "" VALUE 0x240162bb UBYTE_COL_DIRECT 0 NO_COMPU_METHOD 0 1 /end CHARACTERISTIC
/begin CHARACTERISTIC DEBUGIN_EBLT_ReleaseRequest_RR1 "" VALUE 0x240162ba UBYTE_COL_DIRECT 0 NO_COMPU_METHOD 0 3 /end CHARACTERISTIC
/begin CHARACTERISTIC DEBUGIN_EBLT_ReleaseRequest_RR1_Enabled "" VALUE 0x240162b9 UBYTE_COL_DIRECT 0 NO_COMPU_METHOD 0 1 /end CHARACTERISTIC
/begin CHARACTERISTIC EPBD_Enable "" VALUE 0x24016260 UBYTE_COL_DIRECT 0 NO_COMPU_METHOD 0 1 /end CHARACTERISTIC
/begin CHARACTERISTIC HSW_Enable "" VALUE 0x240162de UBYTE_COL_DIRECT 0 NO_COMPU_METHOD 0 1 /end CHARACTERISTIC
/begin CHARACTERISTIC HVDD_Enable "" VALUE 0x24016268 UBYTE_COL_DIRECT 0 NO_COMPU_METHOD 0 1 /end CHARACTERISTIC
/begin CHARACTERISTIC IBD_Enable "" VALUE 0x24016275 UBYTE_COL_DIRECT 0 NO_COMPU_METHOD 0 1 /end CHARACTERISTIC
/begin CHARACTERISTIC ISB_PARAM_Colour_Green "" VAL_BLK 0x24016148 UBYTE_COL_DIRECT 0 NO_COMPU_METHOD 0 255 MATRIX_DIM 1 3 1 /end CHARACTERISTIC
/begin CHARACTERISTIC ISB_PARAM_Colour_Orange "" VAL_BLK 0x24016144 UBYTE_COL_DIRECT 0 NO_COMPU_METHOD 0 255 MATRIX_DIM 1 3 1 /end CHARACTERISTIC
/begin CHARACTERISTIC ISB_PARAM_Colour_Red "" VAL_BLK 0x24016140 UBYTE_COL_DIRECT 0 NO_COMPU_METHOD 0 255 MATRIX_DIM 1 3 1 /end CHARACTERISTIC
/begin CHARACTERISTIC ISB_PARAM_Colour_White "" VAL_BLK 0x2401613c UBYTE_COL_DIRECT 0 NO_COMPU_METHOD 0 255 MATRIX_DIM 1 3 1 /end CHARACTERISTIC
/begin CHARACTERISTIC ISB_PARAM_Colour_Yellow "" VAL_BLK 0x24016138 UBYTE_COL_DIRECT 0 NO_COMPU_METHOD 0 255 MATRIX_DIM 1 3 1 /end CHARACTERISTIC
/begin CHARACTERISTIC ISB_PARAM_Colour_ZFblue "" VAL_BLK 0x24016134 UBYTE_COL_DIRECT 0 NO_COMPU_METHOD 0 255 MATRIX_DIM 1 3 1 /end CHARACTERISTIC
/begin CHARACTERISTIC newPath104_Enable "" VALUE 0x240162a9 UBYTE_COL_DIRECT 0 NO_COMPU_METHOD 0 1 /end CHARACTERISTIC
/begin CHARACTERISTIC Oversteer_ESPOff_Enable "" VALUE 0x24016297 UBYTE_COL_DIRECT 0 NO_COMPU_METHOD 0 1 /end CHARACTERISTIC
/begin CHARACTERISTIC Oversteer_high_Enable "" VALUE 0x24016288 UBYTE_COL_DIRECT 0 NO_COMPU_METHOD 0 1 /end CHARACTERISTIC
/begin CHARACTERISTIC Oversteer_low_Enable "" VALUE 0x2401628f UBYTE_COL_DIRECT 0 NO_COMPU_METHOD 0 1 /end CHARACTERISTIC
/begin CHARACTERISTIC PARAM_ABL_Acti_DemoTablet_enable_FL "" VALUE 0x240162aa UBYTE_COL_DIRECT 0 NO_COMPU_METHOD 0 1 /end CHARACTERISTIC
/begin CHARACTERISTIC PARAM_ABL_Acti_DemoTablet_enable_FR "" VALUE 0x240162ab UBYTE_COL_DIRECT 0 NO_COMPU_METHOD 0 1 /end CHARACTERISTIC
/begin CHARACTERISTIC PARAM_ABL_Acti_DemoTablet_enable_RL1 "" VALUE 0x240162ac UBYTE_COL_DIRECT 0 NO_COMPU_METHOD 0 1 /end CHARACTERISTIC
/begin CHARACTERISTIC PARAM_ABL_Acti_DemoTablet_enable_RL2 "" VALUE 0x240162ad UBYTE_COL_DIRECT 0 NO_COMPU_METHOD 0 1 /end CHARACTERISTIC
/begin CHARACTERISTIC PARAM_ABL_Acti_DemoTablet_enable_RR1 "" VALUE 0x240162ae UBYTE_COL_DIRECT 0 NO_COMPU_METHOD 0 1 /end CHARACTERISTIC
/begin CHARACTERISTIC PARAM_ACR_Acti_DemoTablet_enable_FL "" VALUE 0x240162b2 UBYTE_COL_DIRECT 0 NO_COMPU_METHOD 0 1 /end CHARACTERISTIC
/begin CHARACTERISTIC PARAM_ACR_Acti_DemoTablet_enable_FR "" VALUE 0x240162b1 UBYTE_COL_DIRECT 0 NO_COMPU_METHOD 0 1 /end CHARACTERISTIC
/begin CHARACTERISTIC PARAM_ACR_Acti_DemoTablet_enable_RL1 "" VALUE 0x240162b0 UBYTE_COL_DIRECT 0 NO_COMPU_METHOD 0 1 /end CHARACTERISTIC
/begin CHARACTERISTIC PARAM_ACR_Acti_DemoTablet_enable_RL2 "" VALUE 0x240162af UBYTE_COL_DIRECT 0 NO_COMPU_METHOD 0 1 /end CHARACTERISTIC
/begin CHARACTERISTIC PARAM_ACR_Acti_DemoTablet_enable_RR1 "" VALUE 0x240162c3 UBYTE_COL_DIRECT 0 NO_COMPU_METHOD 0 1 /end CHARACTERISTIC
/begin CHARACTERISTIC PARAM_EBLT_BP_Task_FL_Enable "0 Bit: Lane Change Detected; 1 bit: Opened Door Detected; 2 bit: High Speed Detected " VALUE 0x24016132 UBYTE_COL_DIRECT 0 NO_COMPU_METHOD 0 255 /end CHARACTERISTIC
/begin CHARACTERISTIC PARAM_EBLT_BP_Task_FR_Enable "0 Bit: Lane Change Detected; 1 bit: Opened Door Detected; 2 bit: High Speed Detected " VALUE 0x24016131 UBYTE_COL_DIRECT 0 NO_COMPU_METHOD 0 255 /end CHARACTERISTIC
/begin CHARACTERISTIC PARAM_EBLT_BRK_Task_FL_Enable_b "Braking Task Driver Side.Bit 0: REB.Bit 1: PEB.Bit 2: EPBD. Bit 3: HVDD.Bit 4: IBD.Bit 5: HBA.1 enabled, 0 disabled." VALUE 0x24016130 UBYTE_COL_DIRECT 0 NO_COMPU_METHOD 0 255 /end CHARACTERISTIC
/begin CHARACTERISTIC PARAM_EBLT_BRK_Task_FR_Enable_b "Braking Task Passenger Side.Bit 0: REB.Bit 1: PEB.Bit 2: EPBD. Bit 3: HVDD.Bit 4: IBD.Bit5 HBA.1 enabled, 0 disabled." VALUE 0x2401612f UBYTE_COL_DIRECT 0 NO_COMPU_METHOD 0 255 /end CHARACTERISTIC
/begin CHARACTERISTIC PARAM_EBLT_BRK_Task_RL1_Enable_b "Braking Task Passenger Side.Bit 0: REB.Bit 1: PEB.Bit 2: EPBD. Bit 3: HVDD.Bit 4: IBD.Bit5 HBA.1 enabled, 0 disabled." VALUE 0x2401612e UBYTE_COL_DIRECT 0 NO_COMPU_METHOD 0 255 /end CHARACTERISTIC
/begin CHARACTERISTIC PARAM_EBLT_BRK_Task_RL2_Enable_b "Braking Task Passenger Side.Bit 0: REB.Bit 1: PEB.Bit 2: EPBD. Bit 3: HVDD.Bit 4: IBD.Bit5 HBA.1 enabled, 0 disabled." VALUE 0x2401612d UBYTE_COL_DIRECT 0 NO_COMPU_METHOD 0 255 /end CHARACTERISTIC
/begin CHARACTERISTIC PARAM_EBLT_BRK_Task_RR1_Enable_b "Braking Task Passenger Side.Bit 0: REB.Bit 1: PEB.Bit 2: EPBD. Bit 3: HVDD.Bit 4: IBD.Bit5 HBA.1 enabled, 0 disabled." VALUE 0x2401612c UBYTE_COL_DIRECT 0 NO_COMPU_METHOD 0 255 /end CHARACTERISTIC
/begin CHARACTERISTIC PARAM_EBLT_CD_Task_FL_Enable_b "Critical Driving Task Driver Side.Bit 0: Precrash.Bit 1: Dynamic Support 1.Bit 2: Dynamic Support 2 (Path104).Bit 3: ESP Off.1 enabled,0 disabled." VALUE 0x2401612b UBYTE_COL_DIRECT 0 NO_COMPU_METHOD 0 255 /end CHARACTERISTIC
/begin CHARACTERISTIC PARAM_EBLT_CD_Task_FR_Enable_b "Critical Driving Task Passenger Side.Bit 0: Precrash.Bit 1: Dynamic Support 1.Bit 2: Dynamic Support 2 (Path104).Bit 3: ESP Off.1 enabled.0 disabled." VALUE 0x2401612a UBYTE_COL_DIRECT 0 NO_COMPU_METHOD 0 255 /end CHARACTERISTIC
/begin CHARACTERISTIC PARAM_EBLT_CD_Task_RL1_Enable_b "Critical Driving Task Passenger Side.Bit 0: Precrash.Bit 1: Dynamic Support 1.Bit 2: Dynamic Support 2 (Path104).Bit 3: ESP Off.1 enabled.0 disabled." VALUE 0x24016129 UBYTE_COL_DIRECT 0 NO_COMPU_METHOD 0 255 /end CHARACTERISTIC
/begin CHARACTERISTIC PARAM_EBLT_CD_Task_RL2_Enable_b "Critical Driving Task Passenger Side.Bit 0: Precrash.Bit 1: Dynamic Support 1.Bit 2: Dynamic Support 2 (Path104).Bit 3: ESP Off.1 enabled.0 disabled." VALUE 0x24016128 UBYTE_COL_DIRECT 0 NO_COMPU_METHOD 0 255 /end CHARACTERISTIC
/begin CHARACTERISTIC PARAM_EBLT_CD_Task_RR1_Enable_b "Critical Driving Task Passenger Side.Bit 0: Precrash.Bit 1: Dynamic Support 1.Bit 2: Dynamic Support 2 (Path104).Bit 3: ESP Off.1 enabled.0 disabled." VALUE 0x24016127 UBYTE_COL_DIRECT 0 NO_COMPU_METHOD 0 255 /end CHARACTERISTIC
/begin CHARACTERISTIC PARAM_EBLT_DA_Task_FL_Enable "0 Bit: Lane Change Detected; 1 bit: Opened Door Detected; 2 bit: High Speed Detected " VALUE 0x2401615c UWORD_COL_DIRECT 0 NO_COMPU_METHOD 0 65535 /end CHARACTERISTIC
/begin CHARACTERISTIC PARAM_EBLT_DA_Task_FR_Enable "0 Bit: Lane Change Detected; 1 bit: Opened Door Detected; 2 bit: High Speed Detected " VALUE 0x2401615a UWORD_COL_DIRECT 0 NO_COMPU_METHOD 0 65535 /end CHARACTERISTIC
/begin CHARACTERISTIC PARAM_EBLT_DA_Task_RL1_Enable "0 Bit: Lane Change Detected; 1 bit: Opened Door Detected; 2 bit: High Speed Detected " VALUE 0x24016158 UWORD_COL_DIRECT 0 NO_COMPU_METHOD 0 65535 /end CHARACTERISTIC
/begin CHARACTERISTIC PARAM_EBLT_DA_Task_RL2_Enable "0 Bit: Lane Change Detected; 1 bit: Opened Door Detected; 2 bit: High Speed Detected " VALUE 0x24016156 UWORD_COL_DIRECT 0 NO_COMPU_METHOD 0 65535 /end CHARACTERISTIC
/begin CHARACTERISTIC PARAM_EBLT_DA_Task_RR1_Enable "0 Bit: Lane Change Detected; 1 bit: Opened Door Detected; 2 bit: High Speed Detected " VALUE 0x24016154 UWORD_COL_DIRECT 0 NO_COMPU_METHOD 0 65535 /end CHARACTERISTIC
/begin CHARACTERISTIC PARAM_EBLT_DB_Task_FL_Enable_b "" VALUE 0x24016126 UBYTE_COL_DIRECT 0 NO_COMPU_METHOD 0 255 /end CHARACTERISTIC
/begin CHARACTERISTIC PARAM_EBLT_DB_Task_FR_Enable_b "" VALUE 0x24016125 UBYTE_COL_DIRECT 0 NO_COMPU_METHOD 0 255 /end CHARACTERISTIC
/begin CHARACTERISTIC PARAM_EBLT_DB_Task_RL1_Enable_b "" VALUE 0x24016124 UBYTE_COL_DIRECT 0 NO_COMPU_METHOD 0 255 /end CHARACTERISTIC
/begin CHARACTERISTIC PARAM_EBLT_DB_Task_RL2_Enable_b "" VALUE 0x24016123 UBYTE_COL_DIRECT 0 NO_COMPU_METHOD 0 255 /end CHARACTERISTIC
/begin CHARACTERISTIC PARAM_EBLT_DB_Task_RR1_Enable_b "" VALUE 0x24016122 UBYTE_COL_DIRECT 0 NO_COMPU_METHOD 0 255 /end CHARACTERISTIC
/begin CHARACTERISTIC PARAM_EBLT_min_Geschw_kmh "" VALUE 0x2401611a UBYTE_COL_DIRECT 0 NO_COMPU_METHOD 0 255 /end CHARACTERISTIC
/begin CHARACTERISTIC PARAM_EBLT_Release_Task_FL_Enable_b "Release Task Driver Side.Bit 0: Rating Stable (inverted).Bit 1: Kugel Stable (inverted).Bit 2: Release Stable.1 enabled, 0 disabled." VALUE 0x24016121 UBYTE_COL_DIRECT 0 NO_COMPU_METHOD 0 255 /end CHARACTERISTIC
/begin CHARACTERISTIC PARAM_EBLT_Release_Task_FR_Enable_b "Release Task Passenger Side.Bit 0: Rating Stable (inverted).Bit 1: Kugel Stable (inverted).Bit 2: Release Stable.1 enabled, 0 disabled." VALUE 0x24016120 UBYTE_COL_DIRECT 0 NO_COMPU_METHOD 0 255 /end CHARACTERISTIC
/begin CHARACTERISTIC PARAM_EBLT_Release_Task_RL1_Enable_b "Release Task Passenger Side.Bit 0: Rating Stable (inverted).Bit 1: Kugel Stable (inverted).Bit 2: Release Stable.1 enabled, 0 disabled." VALUE 0x2401611f UBYTE_COL_DIRECT 0 NO_COMPU_METHOD 0 255 /end CHARACTERISTIC
/begin CHARACTERISTIC PARAM_EBLT_Release_Task_RL2_Enable_b "Release Task Passenger Side.Bit 0: Rating Stable (inverted).Bit 1: Kugel Stable (inverted).Bit 2: Release Stable.1 enabled, 0 disabled." VALUE 0x2401611e UBYTE_COL_DIRECT 0 NO_COMPU_METHOD 0 255 /end CHARACTERISTIC
/begin CHARACTERISTIC PARAM_EBLT_Release_Task_RR1_Enable_b "Release Task Passenger Side.Bit 0: Rating Stable (inverted).Bit 1: Kugel Stable (inverted).Bit 2: Release Stable.1 enabled, 0 disabled." VALUE 0x2401611d UBYTE_COL_DIRECT 0 NO_COMPU_METHOD 0 255 /end CHARACTERISTIC
/begin CHARACTERISTIC PARAM_EBLT_SLR_Task_FL_Enable "0 Bit: Lane Change Detected; 1 bit: Opened Door Detected; 2 bit: High Speed Detected " VALUE 0x2401611c UBYTE_COL_DIRECT 0 NO_COMPU_METHOD 0 255 /end CHARACTERISTIC
/begin CHARACTERISTIC PARAM_EBLT_SLR_Task_FR_Enable "0 Bit: Lane Change Detected; 1 bit: Opened Door Detected; 2 bit: High Speed Detected " VALUE 0x2401611b UBYTE_COL_DIRECT 0 NO_COMPU_METHOD 0 255 /end CHARACTERISTIC
/begin CHARACTERISTIC PARAM_EBLT_VehObs_Task_FL_Enable "" VALUE 0x240162b8 UBYTE_COL_DIRECT 0 NO_COMPU_METHOD 0 255 /end CHARACTERISTIC
/begin CHARACTERISTIC PARAM_VS_BRK_ACC_BRK_switch_grad_bars "Threshold of brake pressure gradient (in bar per 20ms) necessary to\nbe exceeded in order to detect EPB." VALUE 0x24016119 UBYTE_COL_DIRECT 0 EQ_LSB_1_g 0 255 /end CHARACTERISTIC
/begin CHARACTERISTIC PARAM_VS_BRK_ACC_BRK_switch_press_bar "Threshold of brake pressure (in bar) necessary to\nbe exceeded in order to detect EPB." VALUE 0x24016118 UBYTE_COL_DIRECT 0 EQ_LSB_1_f 0 255 /end CHARACTERISTIC
/begin CHARACTERISTIC PARAM_VS_BRK_ACC_BRK_switch_time_ms "Time interval within a high brake pressure gradient has to be\ndetected after detection of a fast accelerator pedal change.\nUsed as a necessary condition to detect EPB." VALUE 0x24016117 UBYTE_COL_DIRECT 0 EQ_LSB_10 0 2550 /end CHARACTERISTIC
/begin CHARACTERISTIC PARAM_VS_BRK_ACC_pos_grad_max_percs "Threshold for acceleration pedal gradient (in percent per 10ms) used in EPB." VALUE 0x24016116 UBYTE_COL_DIRECT 0 EQ_LSB_1_e 0 255 /end CHARACTERISTIC
/begin CHARACTERISTIC PARAM_VS_BRK_BRK_ax_filter "Gain for low pass filtering of the longitudinal accelearation:\n\nLow Pass Filter: y_k = y_k + e*(y_k-1 + y_k)\nSMA_fapp_BRK_ax_filter can be set in a range of 0 to 255.\nThen the effective gain e is calculated in a range of 0.745 to 1.\n\nSo the time constant of the filter is greater with higher values of SMA_fapp_BRK_ax_filter.\nWhen set to 255 the filter output is constant zero." VALUE 0x24016114 UBYTE_COL_DIRECT 0 NO_COMPU_METHOD 0 255 /end CHARACTERISTIC
/begin CHARACTERISTIC PARAM_VS_BRK_BRK_delay_2_ms "Delay for brake pressure gradient used in PEB." VALUE 0x24016113 UBYTE_COL_DIRECT 0 EQ_LSB_1 0 255 /end CHARACTERISTIC
/begin CHARACTERISTIC PARAM_VS_BRK_BRK_EPBD_Del_msec_1 "Duration of the EPB high brake pressure gradient detection." VALUE 0x24016115 UBYTE_COL_DIRECT 0 EQ_LSB_10 0 2550 /end CHARACTERISTIC
/begin CHARACTERISTIC PARAM_VS_BRK_BRK_grad_max_2_bars "Threshold for brake pressure gradient used in PEB." VALUE 0x24016112 UBYTE_COL_DIRECT 0 EQ_LSB_1_g 0 255 /end CHARACTERISTIC
/begin CHARACTERISTIC PARAM_VS_BRK_BRK_grad_max_bars "Threshold of brake pressure gradient (in bar per 20ms) used to detect\nRapid Emergency Braking (REB)." VALUE 0x24016111 UBYTE_COL_DIRECT 0 EQ_LSB_1_g 0 255 /end CHARACTERISTIC
/begin CHARACTERISTIC PARAM_VS_BRK_BRK_press_max_2_bar "Threshold for brake pressure used in PEB." VALUE 0x24016110 UBYTE_COL_DIRECT 0 EQ_LSB_1_f 0 255 /end CHARACTERISTIC
/begin CHARACTERISTIC PARAM_VS_BRK_EPB_Delay_ms "" VALUE 0x2401610f UBYTE_COL_DIRECT 0 EQ_LSB_10 0 2550 /end CHARACTERISTIC
/begin CHARACTERISTIC PARAM_VS_BRK_HVDD_BRK_ax_max_ms2 "Decceleration threshold used to detect HVD." VALUE 0x2401610e UBYTE_COL_DIRECT 0 EQ_LSB_0_1_h 0 25.5 /end CHARACTERISTIC
/begin CHARACTERISTIC PARAM_VS_BRK_HVDD_BRK_press_max_bar "Brake pressure threshold used to detect HVD." VALUE 0x2401610d UBYTE_COL_DIRECT 0 EQ_LSB_1_f 0 255 /end CHARACTERISTIC
/begin CHARACTERISTIC PARAM_VS_BRK_IBD_BRK_accel_delay_ms "Delay for low decceleration detection used to detect IB." VALUE 0x2401610c UBYTE_COL_DIRECT 0 EQ_LSB_10 0 2550 /end CHARACTERISTIC
/begin CHARACTERISTIC PARAM_VS_BRK_IBD_BRK_ax_max_ms2 "Decceleration threshold used to detect IB." VALUE 0x2401610b UBYTE_COL_DIRECT 0 EQ_LSB_0_1_h 0 25.5 /end CHARACTERISTIC
/begin CHARACTERISTIC PARAM_VS_BRK_IBD_BRK_press_max_bar "Brake pressure threshold used to detect IB." VALUE 0x2401610a UBYTE_COL_DIRECT 0 EQ_LSB_1_f 0 255 /end CHARACTERISTIC
/begin CHARACTERISTIC PARAM_VS_BRK_IBD_BRK_signal_delay_ms "Delay for high brake pressure detection used to detect IB." VALUE 0x24016109 UBYTE_COL_DIRECT 0 EQ_LSB_10 0 2550 /end CHARACTERISTIC
/begin CHARACTERISTIC PARAM_VS_BRK_PEB_Eva_Delay_ms "Hold time used in PEB." VALUE 0x24016108 UBYTE_COL_DIRECT 0 EQ_LSB_1 0 255 /end CHARACTERISTIC
/begin CHARACTERISTIC PARAM_VS_CDT_ay_angleich "" VALUE 0x24016101 UBYTE_COL_DIRECT 0 EQ_LSB_0_01_j 0 2.5500000000000003 /end CHARACTERISTIC
/begin CHARACTERISTIC PARAM_VS_CDT_ay_diff_verstaerk_ueber "" VALUE 0x24016100 UBYTE_COL_DIRECT 0 EQ_LSB_0_01_j 0 2.5500000000000003 /end CHARACTERISTIC
/begin CHARACTERISTIC PARAM_VS_CDT_ay_diff_verstaerk_unter "" VALUE 0x240160ff UBYTE_COL_DIRECT 0 EQ_LSB_0_01_j 0 2.5500000000000003 /end CHARACTERISTIC
/begin CHARACTERISTIC PARAM_VS_CDT_C_D_ay_filter "" VALUE 0x24016106 UBYTE_COL_DIRECT 0 NO_COMPU_METHOD 0 255 /end CHARACTERISTIC
/begin CHARACTERISTIC PARAM_VS_CDT_C_D_gier_filter "" VALUE 0x24016105 UBYTE_COL_DIRECT 0 NO_COMPU_METHOD 0 255 /end CHARACTERISTIC
/begin CHARACTERISTIC PARAM_VS_CDT_CDR_01_Enable "" VALUE 0x24016107 UBYTE_COL_DIRECT 0 NO_COMPU_METHOD 0 255 /end CHARACTERISTIC
/begin CHARACTERISTIC PARAM_VS_CDT_charak_v_a_y "" VALUE 0x240160fe UBYTE_COL_DIRECT 0 NO_COMPU_METHOD 0 255 /end CHARACTERISTIC
/begin CHARACTERISTIC PARAM_VS_CDT_charak_v_psi_dot "" VALUE 0x240160fd UBYTE_COL_DIRECT 0 NO_COMPU_METHOD 0 255 /end CHARACTERISTIC
/begin CHARACTERISTIC PARAM_VS_CDT_DSUO_Enable "Dynamic support in Oversteer and Understeer configurable." VALUE 0x24016104 UBYTE_COL_DIRECT 0 NO_COMPU_METHOD 0 255 /end CHARACTERISTIC
/begin CHARACTERISTIC PARAM_VS_CDT_ESPOffUO_Enable " Precrash by ESP Off in Oversteer and Understeer configurable." VALUE 0x24016103 UBYTE_COL_DIRECT 0 NO_COMPU_METHOD 0 255 /end CHARACTERISTIC
/begin CHARACTERISTIC PARAM_VS_CDT_gier_angleich "" VALUE 0x240160fc UBYTE_COL_DIRECT 0 EQ_LSB_0_01_j 0 2.5500000000000003 /end CHARACTERISTIC
/begin CHARACTERISTIC PARAM_VS_CDT_gier_diff_verstaerk_ueber "" VALUE 0x240160fb UBYTE_COL_DIRECT 0 EQ_LSB_0_01_j 0 2.5500000000000003 /end CHARACTERISTIC
/begin CHARACTERISTIC PARAM_VS_CDT_gier_diff_verstaerk_unter "" VALUE 0x240160fa UBYTE_COL_DIRECT 0 EQ_LSB_0_01_j 0 2.5500000000000003 /end CHARACTERISTIC
/begin CHARACTERISTIC PARAM_VS_CDT_gier_ueber_unter_hyster "" VALUE 0x240160f9 UBYTE_COL_DIRECT 0 EQ_LSB_0_1_d 0 25.5 /end CHARACTERISTIC
/begin CHARACTERISTIC PARAM_VS_CDT_instabil_ESP_BRK_min_bar "" VALUE 0x240160f8 UBYTE_COL_DIRECT 0 NO_COMPU_METHOD 0 255 /end CHARACTERISTIC
/begin CHARACTERISTIC PARAM_VS_CDT_instabil_ESP_off_ueber_3 "" VALUE 0x240160f7 UBYTE_COL_DIRECT 0 NO_COMPU_METHOD 0 255 /end CHARACTERISTIC
/begin CHARACTERISTIC PARAM_VS_CDT_instabil_ESP_off_unter_3 "" VALUE 0x240160f6 UBYTE_COL_DIRECT 0 NO_COMPU_METHOD 0 255 /end CHARACTERISTIC
/begin CHARACTERISTIC PARAM_VS_CDT_instabil_ueber_steuern_1 "" VALUE 0x240160f5 UBYTE_COL_DIRECT 0 NO_COMPU_METHOD 0 255 /end CHARACTERISTIC
/begin CHARACTERISTIC PARAM_VS_CDT_instabil_ueber_steuern_2 "" VALUE 0x240160f4 UBYTE_COL_DIRECT 0 NO_COMPU_METHOD 0 255 /end CHARACTERISTIC
/begin CHARACTERISTIC PARAM_VS_CDT_instabil_unter_steuern_1 "" VALUE 0x240160f3 UBYTE_COL_DIRECT 0 NO_COMPU_METHOD 0 255 /end CHARACTERISTIC
/begin CHARACTERISTIC PARAM_VS_CDT_instabil_unter_steuern_2 "" VALUE 0x240160f2 UBYTE_COL_DIRECT 0 NO_COMPU_METHOD 0 255 /end CHARACTERISTIC
/begin CHARACTERISTIC PARAM_VS_CDT_lenkfilter_ay_esm "" VALUE 0x240160f1 UBYTE_COL_DIRECT 0 NO_COMPU_METHOD 0 255 /end CHARACTERISTIC
/begin CHARACTERISTIC PARAM_VS_CDT_lenkfilter_gier_esm "" VALUE 0x240160f0 UBYTE_COL_DIRECT 0 NO_COMPU_METHOD 0 255 /end CHARACTERISTIC
/begin CHARACTERISTIC PARAM_VS_CDT_PCUO_Enable "Precrash in Oversteer and Understeer configurable." VALUE 0x24016102 UBYTE_COL_DIRECT 0 NO_COMPU_METHOD 0 255 /end CHARACTERISTIC
/begin CHARACTERISTIC PARAM_VS_CDT_wheel_base_mm "" VALUE 0x24016152 UWORD_COL_DIRECT 0 NO_COMPU_METHOD 0 65535 /end CHARACTERISTIC
/begin CHARACTERISTIC PARAM_VS_EBLT_VehObs_Task_Dr2Row_Enable "" VALUE 0x240162b6 UBYTE_COL_DIRECT 0 NO_COMPU_METHOD 0 255 /end CHARACTERISTIC
/begin CHARACTERISTIC PARAM_VS_EBLT_VehObs_Task_Pa_Enable "" VALUE 0x240162b7 UBYTE_COL_DIRECT 0 NO_COMPU_METHOD 0 255 /end CHARACTERISTIC
/begin CHARACTERISTIC PARAM_VS_EBLT_VehObs_Task_Pa2Row_Enable "" VALUE 0x240162b5 UBYTE_COL_DIRECT 0 NO_COMPU_METHOD 0 255 /end CHARACTERISTIC
/begin CHARACTERISTIC PARAM_VS_EBLT_VehObsWarn_Task_Dr_Enable "" VALUE 0x240162b4 UBYTE_COL_DIRECT 0 NO_COMPU_METHOD 0 255 /end CHARACTERISTIC
/begin CHARACTERISTIC PARAM_VS_EBLT_VehObsWarn_Task_Pa_Enable "" VALUE 0x240162b3 UBYTE_COL_DIRECT 0 NO_COMPU_METHOD 0 255 /end CHARACTERISTIC
/begin CHARACTERISTIC PARAM_VS_HPW_HSpeed_Threshold_kmh "" VALUE 0x24016150 UWORD_COL_DIRECT 0 EQ_LSB_0_1 0 6553.5 /end CHARACTERISTIC
/begin CHARACTERISTIC PARAM_VS_ODWD_Speed_kmh "" VALUE 0x2401614e UWORD_COL_DIRECT 0 EQ_LSB_0_1 0 6553.5 /end CHARACTERISTIC
/begin CHARACTERISTIC PARAM_VS_REL_Brake_press_max_bar "" VALUE 0x240160ee UBYTE_COL_DIRECT 0 NO_COMPU_METHOD 0 255 /end CHARACTERISTIC
/begin CHARACTERISTIC PARAM_VS_REL_BRK_press_max_Gier_deg "" VALUE 0x240160ef UBYTE_COL_DIRECT 0 NO_COMPU_METHOD 0 255 /end CHARACTERISTIC
/begin CHARACTERISTIC PARAM_VS_REL_Gierbeschleunigung_max_2_degs "" VALUE 0x240160ec UBYTE_COL_DIRECT 0 NO_COMPU_METHOD 0 255 /end CHARACTERISTIC
/begin CHARACTERISTIC PARAM_VS_REL_Gierrate_max_2_degs "" VALUE 0x240160eb UBYTE_COL_DIRECT 0 NO_COMPU_METHOD 0 255 /end CHARACTERISTIC
/begin CHARACTERISTIC PARAM_VS_REL_Gierrate_max_degs "" VALUE 0x240160ea UBYTE_COL_DIRECT 0 NO_COMPU_METHOD 0 255 /end CHARACTERISTIC
/begin CHARACTERISTIC PARAM_VS_REL_Kugel_Filter "" VALUE 0x240160e9 UBYTE_COL_DIRECT 0 NO_COMPU_METHOD 0 255 /end CHARACTERISTIC
/begin CHARACTERISTIC PARAM_VS_REL_Kugel_max "" VALUE 0x240160e7 UBYTE_COL_DIRECT 0 NO_COMPU_METHOD 0 255 /end CHARACTERISTIC
/begin CHARACTERISTIC PARAM_VS_REL_Kugel_Qualitime_msec "Time duration within the vehicle has to stable before the stability is determined for release." VALUE 0x240160e8 UBYTE_COL_DIRECT 0 EQ_LSB_10 0 2550 /end CHARACTERISTIC
/begin CHARACTERISTIC PARAM_VS_REL_release_acceleration_ms2 "" VALUE 0x240160e4 UBYTE_COL_DIRECT 0 NO_COMPU_METHOD 0 255 /end CHARACTERISTIC
/begin CHARACTERISTIC PARAM_VS_REL_release_criticality "" VALUE 0x240160e3 UBYTE_COL_DIRECT 0 NO_COMPU_METHOD 0 255 /end CHARACTERISTIC
/begin CHARACTERISTIC PARAM_VS_REL_release_fahrped_roh_perc "" VALUE 0x240160e2 UBYTE_COL_DIRECT 0 NO_COMPU_METHOD 0 255 /end CHARACTERISTIC
/begin CHARACTERISTIC PARAM_VS_REL_release_gier_filter "" VALUE 0x240160e1 UBYTE_COL_DIRECT 0 NO_COMPU_METHOD 0 255 /end CHARACTERISTIC
/begin CHARACTERISTIC PARAM_VS_REL_V_BRK_Thr_kmh_1 "" VALUE 0x240160e5 UBYTE_COL_DIRECT 0 EQ_LSB_0_1_d 0 25.5 /end CHARACTERISTIC
/begin CHARACTERISTIC PARAM_VS_SLR_AccelPad_Thr_perc "" VALUE 0x240160df UBYTE_COL_DIRECT 0 EQ_LSB_0_4 0 102 /end CHARACTERISTIC
/begin CHARACTERISTIC PARAM_VS_SLR_AX_THR_ms2 "" VALUE 0x240160e0 UBYTE_COL_DIRECT 0 EQ_LSB_0_1_d 0 25.5 /end CHARACTERISTIC
/begin CHARACTERISTIC PARAM_VS_SLR_BKL_Approved_1 "" VALUE 0x2401614c UWORD_COL_DIRECT 0 EQ_LSB_0_01_k 0 655.35 /end CHARACTERISTIC
/begin CHARACTERISTIC PARAM_VS_SLR_CarSpeed_Thr1_kmh "" VALUE 0x240160de UBYTE_COL_DIRECT 0 NO_COMPU_METHOD 0 255 /end CHARACTERISTIC
/begin CHARACTERISTIC PARAM_VS_SLR_CarSpeed_Thr2_kmh "" VALUE 0x240160dd UBYTE_COL_DIRECT 0 NO_COMPU_METHOD 0 255 /end CHARACTERISTIC
/begin CHARACTERISTIC PARAM_VS_SLR_Del_1 "" VALUE 0x240160dc UBYTE_COL_DIRECT 0 EQ_LSB_0_1_d 0 25.5 /end CHARACTERISTIC
/begin CHARACTERISTIC PEB_Enable "" VALUE 0x2401624a UBYTE_COL_DIRECT 0 NO_COMPU_METHOD 0 1 /end CHARACTERISTIC
/begin CHARACTERISTIC REB_Enable "" VALUE 0x24016234 UBYTE_COL_DIRECT 0 NO_COMPU_METHOD 0 1 /end CHARACTERISTIC
/begin CHARACTERISTIC SVSMA_HPW3_BSD_Left_Enable "" VALUE 0x240162fa UBYTE_COL_DIRECT 0 NO_COMPU_METHOD 0 1 /end CHARACTERISTIC
/begin CHARACTERISTIC SVSMA_HPW3_BSD_Right_Enable "" VALUE 0x240162fb UBYTE_COL_DIRECT 0 NO_COMPU_METHOD 0 1 /end CHARACTERISTIC
/begin CHARACTERISTIC SVSMA_HPW5_ALDPW_Enable "" VALUE 0x240162c4 UBYTE_COL_DIRECT 0 NO_COMPU_METHOD 0 1 /end CHARACTERISTIC
/begin CHARACTERISTIC SVSMA_SLR15_SLR1_FL_Enable "" VALUE 0x2401650e UBYTE_COL_DIRECT 0 NO_COMPU_METHOD 0 1 /end CHARACTERISTIC
/begin CHARACTERISTIC SVSMA_SLR15_SLR1_RL1_Enable "" VALUE 0x240164ce UBYTE_COL_DIRECT 0 NO_COMPU_METHOD 0 1 /end CHARACTERISTIC
/begin CHARACTERISTIC SVSMA_SLR15_SLR1_RL2_Enable "" VALUE 0x240164ae UBYTE_COL_DIRECT 0 NO_COMPU_METHOD 0 1 /end CHARACTERISTIC
/begin CHARACTERISTIC SVSMA_SLR15_SLR2_FR_Enable "" VALUE 0x240164ee UBYTE_COL_DIRECT 0 NO_COMPU_METHOD 0 1 /end CHARACTERISTIC
/begin CHARACTERISTIC SVSMA_SLR15_SLR2_RR1_Enable "" VALUE 0x24016494 UBYTE_COL_DIRECT 0 NO_COMPU_METHOD 0 1 /end CHARACTERISTIC
/begin CHARACTERISTIC SVSMA_SLR16_SLR2_FL_Enable "" VALUE 0x2401651c UBYTE_COL_DIRECT 0 NO_COMPU_METHOD 0 1 /end CHARACTERISTIC
/begin CHARACTERISTIC SVSMA_SLR16_SLR2_FR_Enable "" VALUE 0x240164fc UBYTE_COL_DIRECT 0 NO_COMPU_METHOD 0 1 /end CHARACTERISTIC
/begin CHARACTERISTIC SVSMA_SLR16_SLR2_RL1_Enable "" VALUE 0x240164dc UBYTE_COL_DIRECT 0 NO_COMPU_METHOD 0 1 /end CHARACTERISTIC
/begin CHARACTERISTIC SVSMA_SLR16_SLR2_RL2_Enable "" VALUE 0x2401649c UBYTE_COL_DIRECT 0 NO_COMPU_METHOD 0 1 /end CHARACTERISTIC
/begin CHARACTERISTIC SVSMA_SLR16_SLR2_RR1_Enable "" VALUE 0x240164bc UBYTE_COL_DIRECT 0 NO_COMPU_METHOD 0 1 /end CHARACTERISTIC
/begin CHARACTERISTIC Understeer_ESPOff_Enable "" VALUE 0x24016296 UBYTE_COL_DIRECT 0 NO_COMPU_METHOD 0 1 /end CHARACTERISTIC
/begin CHARACTERISTIC Understeer_high_Enable "" VALUE 0x24016287 UBYTE_COL_DIRECT 0 NO_COMPU_METHOD 0 1 /end CHARACTERISTIC
/begin CHARACTERISTIC Understeer_low_Enable "" VALUE 0x2401628e UBYTE_COL_DIRECT 0 NO_COMPU_METHOD 0 1 /end CHARACTERISTIC
/begin MEASUREMENT ACR_ABL_Prioritization_FL_DD_SVSMA_PRIO50_DEBUGOUT_PRI_Out_ABL_Retract "" UBYTE NO_COMPU_METHOD 1 100 0 255 ECU_ADDRESS 0x24027276 /end MEASUREMENT
/begin MEASUREMENT ACR_ABL_Prioritization_FL_DD_SVSMA_PRIO7_DEBUGOUT_PRI_DG_Out_Release "" UBYTE NO_COMPU_METHOD 1 100 0 255 ECU_ADDRESS 0x24027134 /end MEASUREMENT
/begin MEASUREMENT ACR_ABL_Prioritization_FL_DD_SVSMA_PRIO7_DEBUGOUT_PRI_In_Bkl "" UBYTE NO_COMPU_METHOD 1 100 0 255 ECU_ADDRESS 0x240271f6 /end MEASUREMENT
/begin MEASUREMENT ACR_ABL_Prioritization_FL_DD_SVSMA_PRIO7_DEBUGOUT_PRI_In_BRK "" UBYTE NO_COMPU_METHOD 1 100 0 255 ECU_ADDRESS 0x24027182 /end MEASUREMENT
/begin MEASUREMENT ACR_ABL_Prioritization_FL_DD_SVSMA_PRIO7_DEBUGOUT_PRI_In_CD "" UBYTE NO_COMPU_METHOD 1 100 0 255 ECU_ADDRESS 0x240271b0 /end MEASUREMENT
/begin MEASUREMENT ACR_ABL_Prioritization_FL_DD_SVSMA_PRIO7_DEBUGOUT_PRI_In_DA "" UWORD NO_COMPU_METHOD 1 100 0 65535 ECU_ADDRESS 0x24027248 /end MEASUREMENT
/begin MEASUREMENT ACR_ABL_Prioritization_FL_DD_SVSMA_PRIO7_DEBUGOUT_PRI_In_DB "" UBYTE NO_COMPU_METHOD 1 100 0 255 ECU_ADDRESS 0x24027220 /end MEASUREMENT
/begin MEASUREMENT ACR_ABL_Prioritization_FL_DD_SVSMA_PRIO7_DEBUGOUT_PRI_In_REL "" UBYTE NO_COMPU_METHOD 1 100 0 255 ECU_ADDRESS 0x240272b6 /end MEASUREMENT
/begin MEASUREMENT ACR_ABL_Prioritization_FL_DD_SVSMA_PRIO7_DEBUGOUT_PRI_In_SLR "" UBYTE NO_COMPU_METHOD 1 100 0 255 ECU_ADDRESS 0x24027164 /end MEASUREMENT
/begin MEASUREMENT ACR_ABL_Prioritization_FL_DD_SVSMA_PRIO7_DEBUGOUT_PRI_In_VehObs "" UBYTE NO_COMPU_METHOD 1 100 0 255 ECU_ADDRESS 0x240271ac /end MEASUREMENT
/begin MEASUREMENT ACR_ABL_Prioritization_FL_DD_SVSMA_PRIO7_DEBUGOUT_PRI_In_VehObsWarning "" UBYTE NO_COMPU_METHOD 1 100 0 255 ECU_ADDRESS 0x24027217 /end MEASUREMENT
/begin MEASUREMENT ACR_ABL_Prioritization_FL_Debug_ACR_ActivationLevel "" UBYTE NO_COMPU_METHOD 1 100 0 255 ECU_ADDRESS 0x2402720a /end MEASUREMENT
/begin MEASUREMENT ACR_ABL_Prioritization_FL_Debug_ExtAct_Retract1 "" UBYTE NO_COMPU_METHOD 1 100 0 1 ECU_ADDRESS 0x24027234 /end MEASUREMENT
/begin MEASUREMENT ACR_ABL_Prioritization_FL_Debug_ExtAct_SLR "" UBYTE NO_COMPU_METHOD 1 100 0 1 ECU_ADDRESS 0x24027192 /end MEASUREMENT
/begin MEASUREMENT ACR_ABL_Prioritization_FL_Debug_PRI_OccupantWeight "" UBYTE NO_COMPU_METHOD 1 100 0 255 ECU_ADDRESS 0x240271dd /end MEASUREMENT
/begin MEASUREMENT ACR_ABL_Prioritization_FL_Debug_PRI_WeightClass "" SBYTE NO_COMPU_METHOD 1 100 -128 127 ECU_ADDRESS 0x2402712d /end MEASUREMENT
/begin MEASUREMENT ACR_ABL_Prioritization_FL_Debug_SLR_out "" UBYTE NO_COMPU_METHOD 1 100 0 1 ECU_ADDRESS 0x2402713c /end MEASUREMENT
/begin MEASUREMENT ACR_ABL_Prioritization_FL_DEBUGOUT_PRI_Out_ACR_Retract "" UBYTE NO_COMPU_METHOD 1 100 0 255 ECU_ADDRESS 0x240271a2 /end MEASUREMENT
/begin MEASUREMENT ACR_ABL_Prioritization_FL_VS_Abort_Retract_Buckle "" UBYTE NO_COMPU_METHOD 1 100 0 1 ECU_ADDRESS 0x240271b1 /end MEASUREMENT
/begin MEASUREMENT ACR_ABL_Prioritization_FL_VS_Abort_Retract_ISwStat "" UBYTE NO_COMPU_METHOD 1 100 0 1 ECU_ADDRESS 0x2402725d /end MEASUREMENT
/begin MEASUREMENT ACR_ABL_Prioritization_FR_DD_SVSMA_PRIO106_DEBUGOUT_PRI_Out_ABL_Retract "" UBYTE NO_COMPU_METHOD 1 100 0 255 ECU_ADDRESS 0x2402719d /end MEASUREMENT
/begin MEASUREMENT ACR_ABL_Prioritization_FR_DD_SVSMA_PRIO63_DEBUGOUT_PRI_DG_Out_Release "" UBYTE NO_COMPU_METHOD 1 100 0 255 ECU_ADDRESS 0x240271fc /end MEASUREMENT
/begin MEASUREMENT ACR_ABL_Prioritization_FR_DD_SVSMA_PRIO63_DEBUGOUT_PRI_In_Bkl "" UBYTE NO_COMPU_METHOD 1 100 0 255 ECU_ADDRESS 0x24027270 /end MEASUREMENT
/begin MEASUREMENT ACR_ABL_Prioritization_FR_DD_SVSMA_PRIO63_DEBUGOUT_PRI_In_BRK "" UBYTE NO_COMPU_METHOD 1 100 0 255 ECU_ADDRESS 0x2402727f /end MEASUREMENT
/begin MEASUREMENT ACR_ABL_Prioritization_FR_DD_SVSMA_PRIO63_DEBUGOUT_PRI_In_CD "" UBYTE NO_COMPU_METHOD 1 100 0 255 ECU_ADDRESS 0x240272a1 /end MEASUREMENT
/begin MEASUREMENT ACR_ABL_Prioritization_FR_DD_SVSMA_PRIO63_DEBUGOUT_PRI_In_DA "" UWORD NO_COMPU_METHOD 1 100 0 65535 ECU_ADDRESS 0x2402716e /end MEASUREMENT
/begin MEASUREMENT ACR_ABL_Prioritization_FR_DD_SVSMA_PRIO63_DEBUGOUT_PRI_In_DB "" UBYTE NO_COMPU_METHOD 1 100 0 255 ECU_ADDRESS 0x24027165 /end MEASUREMENT
/begin MEASUREMENT ACR_ABL_Prioritization_FR_DD_SVSMA_PRIO63_DEBUGOUT_PRI_In_REL "" UBYTE NO_COMPU_METHOD 1 100 0 255 ECU_ADDRESS 0x2402721b /end MEASUREMENT
/begin MEASUREMENT ACR_ABL_Prioritization_FR_DD_SVSMA_PRIO63_DEBUGOUT_PRI_In_SLR "" UBYTE NO_COMPU_METHOD 1 100 0 255 ECU_ADDRESS 0x240271c2 /end MEASUREMENT
/begin MEASUREMENT ACR_ABL_Prioritization_FR_DD_SVSMA_PRIO63_DEBUGOUT_PRI_In_VehObs "" UBYTE NO_COMPU_METHOD 1 100 0 255 ECU_ADDRESS 0x2402712c /end MEASUREMENT
/begin MEASUREMENT ACR_ABL_Prioritization_FR_DD_SVSMA_PRIO63_DEBUGOUT_PRI_In_VehObsWarning "" UBYTE NO_COMPU_METHOD 1 100 0 255 ECU_ADDRESS 0x240271f7 /end MEASUREMENT
/begin MEASUREMENT ACR_ABL_Prioritization_FR_Debug_ACR_ActivationLevel "" UBYTE NO_COMPU_METHOD 1 100 0 255 ECU_ADDRESS 0x2402718e /end MEASUREMENT
/begin MEASUREMENT ACR_ABL_Prioritization_FR_Debug_ExtAct_Retract1 "" UBYTE NO_COMPU_METHOD 1 100 0 1 ECU_ADDRESS 0x24027257 /end MEASUREMENT
/begin MEASUREMENT ACR_ABL_Prioritization_FR_Debug_ExtAct_SLR "" UBYTE NO_COMPU_METHOD 1 100 0 1 ECU_ADDRESS 0x24027265 /end MEASUREMENT
/begin MEASUREMENT ACR_ABL_Prioritization_FR_Debug_PRI_OccupantWeight "" UBYTE NO_COMPU_METHOD 1 100 0 255 ECU_ADDRESS 0x2402726c /end MEASUREMENT
/begin MEASUREMENT ACR_ABL_Prioritization_FR_Debug_PRI_WeightClass "" SBYTE NO_COMPU_METHOD 1 100 -128 127 ECU_ADDRESS 0x24027150 /end MEASUREMENT
/begin MEASUREMENT ACR_ABL_Prioritization_FR_Debug_SLR_out "" UBYTE NO_COMPU_METHOD 1 100 0 1 ECU_ADDRESS 0x24027242 /end MEASUREMENT
/begin MEASUREMENT ACR_ABL_Prioritization_FR_DEBUGOUT_PRI_Out_ACR_Retract "" UBYTE NO_COMPU_METHOD 1 100 0 255 ECU_ADDRESS 0x2402723d /end MEASUREMENT
/begin MEASUREMENT ACR_ABL_Prioritization_FR_VS_Abort_Retract_Buckle "" UBYTE NO_COMPU_METHOD 1 100 0 1 ECU_ADDRESS 0x240271be /end MEASUREMENT
/begin MEASUREMENT ACR_ABL_Prioritization_FR_VS_Abort_Retract_ISwStat "" UBYTE NO_COMPU_METHOD 1 100 0 1 ECU_ADDRESS 0x2402724e /end MEASUREMENT
/begin MEASUREMENT ACR_ABL_Prioritization_RL1_DD_SVSMA_PRIO119_DEBUGOUT_PRI_DG_Out_Release "" UBYTE NO_COMPU_METHOD 1 100 0 255 ECU_ADDRESS 0x24027136 /end MEASUREMENT
/begin MEASUREMENT ACR_ABL_Prioritization_RL1_DD_SVSMA_PRIO119_DEBUGOUT_PRI_In_Bkl "" UBYTE NO_COMPU_METHOD 1 100 0 255 ECU_ADDRESS 0x24027186 /end MEASUREMENT
/begin MEASUREMENT ACR_ABL_Prioritization_RL1_DD_SVSMA_PRIO119_DEBUGOUT_PRI_In_BRK "" UBYTE NO_COMPU_METHOD 1 100 0 255 ECU_ADDRESS 0x2402728c /end MEASUREMENT
/begin MEASUREMENT ACR_ABL_Prioritization_RL1_DD_SVSMA_PRIO119_DEBUGOUT_PRI_In_CD "" UBYTE NO_COMPU_METHOD 1 100 0 255 ECU_ADDRESS 0x24027224 /end MEASUREMENT
/begin MEASUREMENT ACR_ABL_Prioritization_RL1_DD_SVSMA_PRIO119_DEBUGOUT_PRI_In_DA "" UWORD NO_COMPU_METHOD 1 100 0 65535 ECU_ADDRESS 0x240271c0 /end MEASUREMENT
/begin MEASUREMENT ACR_ABL_Prioritization_RL1_DD_SVSMA_PRIO119_DEBUGOUT_PRI_In_DB "" UBYTE NO_COMPU_METHOD 1 100 0 255 ECU_ADDRESS 0x240271ca /end MEASUREMENT
/begin MEASUREMENT ACR_ABL_Prioritization_RL1_DD_SVSMA_PRIO119_DEBUGOUT_PRI_In_REL "" UBYTE NO_COMPU_METHOD 1 100 0 255 ECU_ADDRESS 0x24027223 /end MEASUREMENT
/begin MEASUREMENT ACR_ABL_Prioritization_RL1_DD_SVSMA_PRIO119_DEBUGOUT_PRI_In_SLR "" UBYTE NO_COMPU_METHOD 1 100 0 255 ECU_ADDRESS 0x24027277 /end MEASUREMENT
/begin MEASUREMENT ACR_ABL_Prioritization_RL1_DD_SVSMA_PRIO119_DEBUGOUT_PRI_In_VehObs "" UBYTE NO_COMPU_METHOD 1 100 0 255 ECU_ADDRESS 0x240272c4 /end MEASUREMENT
/begin MEASUREMENT ACR_ABL_Prioritization_RL1_DD_SVSMA_PRIO119_DEBUGOUT_PRI_In_VehObsWarning "" UBYTE NO_COMPU_METHOD 1 100 0 255 ECU_ADDRESS 0x24027243 /end MEASUREMENT
/begin MEASUREMENT ACR_ABL_Prioritization_RL1_DD_SVSMA_PRIO162_DEBUGOUT_PRI_Out_ABL_Retract "" UBYTE NO_COMPU_METHOD 1 100 0 255 ECU_ADDRESS 0x2402729a /end MEASUREMENT
/begin MEASUREMENT ACR_ABL_Prioritization_RL1_Debug_ACR_ActivationLevel "" UBYTE NO_COMPU_METHOD 1 100 0 255 ECU_ADDRESS 0x240271ce /end MEASUREMENT
/begin MEASUREMENT ACR_ABL_Prioritization_RL1_Debug_ExtAct_Retract1 "" UBYTE NO_COMPU_METHOD 1 100 0 1 ECU_ADDRESS 0x240271e8 /end MEASUREMENT
/begin MEASUREMENT ACR_ABL_Prioritization_RL1_Debug_ExtAct_SLR "" UBYTE NO_COMPU_METHOD 1 100 0 1 ECU_ADDRESS 0x2402716d /end MEASUREMENT
/begin MEASUREMENT ACR_ABL_Prioritization_RL1_Debug_PRI_OccupantWeight "" UBYTE NO_COMPU_METHOD 1 100 0 255 ECU_ADDRESS 0x24027174 /end MEASUREMENT
/begin MEASUREMENT ACR_ABL_Prioritization_RL1_Debug_PRI_WeightClass "" SBYTE NO_COMPU_METHOD 1 100 -128 127 ECU_ADDRESS 0x24027222 /end MEASUREMENT
/begin MEASUREMENT ACR_ABL_Prioritization_RL1_Debug_SLR_out "" UBYTE NO_COMPU_METHOD 1 100 0 1 ECU_ADDRESS 0x24027221 /end MEASUREMENT
/begin MEASUREMENT ACR_ABL_Prioritization_RL1_DEBUGOUT_PRI_Out_ACR_Retract "" UBYTE NO_COMPU_METHOD 1 100 0 255 ECU_ADDRESS 0x2402729b /end MEASUREMENT
/begin MEASUREMENT ACR_ABL_Prioritization_RL1_VS_Abort_Retract_Buckle "" UBYTE NO_COMPU_METHOD 1 100 0 1 ECU_ADDRESS 0x2402712e /end MEASUREMENT
/begin MEASUREMENT ACR_ABL_Prioritization_RL1_VS_Abort_Retract_ISwStat "" UBYTE NO_COMPU_METHOD 1 100 0 1 ECU_ADDRESS 0x2402723c /end MEASUREMENT
/begin MEASUREMENT ACR_ABL_Prioritization_RL2_DD_SVSMA_PRIO175_DEBUGOUT_PRI_DG_Out_Release "" UBYTE NO_COMPU_METHOD 1 100 0 255 ECU_ADDRESS 0x2402711d /end MEASUREMENT
/begin MEASUREMENT ACR_ABL_Prioritization_RL2_DD_SVSMA_PRIO175_DEBUGOUT_PRI_In_Bkl "" UBYTE NO_COMPU_METHOD 1 100 0 255 ECU_ADDRESS 0x24027290 /end MEASUREMENT
/begin MEASUREMENT ACR_ABL_Prioritization_RL2_DD_SVSMA_PRIO175_DEBUGOUT_PRI_In_BRK "" UBYTE NO_COMPU_METHOD 1 100 0 255 ECU_ADDRESS 0x24027160 /end MEASUREMENT
/begin MEASUREMENT ACR_ABL_Prioritization_RL2_DD_SVSMA_PRIO175_DEBUGOUT_PRI_In_CD "" UBYTE NO_COMPU_METHOD 1 100 0 255 ECU_ADDRESS 0x24027204 /end MEASUREMENT
/begin MEASUREMENT ACR_ABL_Prioritization_RL2_DD_SVSMA_PRIO175_DEBUGOUT_PRI_In_DA "" UWORD NO_COMPU_METHOD 1 100 0 65535 ECU_ADDRESS 0x24027284 /end MEASUREMENT
/begin MEASUREMENT ACR_ABL_Prioritization_RL2_DD_SVSMA_PRIO175_DEBUGOUT_PRI_In_DB "" UBYTE NO_COMPU_METHOD 1 100 0 255 ECU_ADDRESS 0x24027282 /end MEASUREMENT
/begin MEASUREMENT ACR_ABL_Prioritization_RL2_DD_SVSMA_PRIO175_DEBUGOUT_PRI_In_REL "" UBYTE NO_COMPU_METHOD 1 100 0 255 ECU_ADDRESS 0x24027210 /end MEASUREMENT
/begin MEASUREMENT ACR_ABL_Prioritization_RL2_DD_SVSMA_PRIO175_DEBUGOUT_PRI_In_SLR "" UBYTE NO_COMPU_METHOD 1 100 0 255 ECU_ADDRESS 0x2402717c /end MEASUREMENT
/begin MEASUREMENT ACR_ABL_Prioritization_RL2_DD_SVSMA_PRIO175_DEBUGOUT_PRI_In_VehObs "" UBYTE NO_COMPU_METHOD 1 100 0 255 ECU_ADDRESS 0x2402711c /end MEASUREMENT
/begin MEASUREMENT ACR_ABL_Prioritization_RL2_DD_SVSMA_PRIO175_DEBUGOUT_PRI_In_VehObsWarning "" UBYTE NO_COMPU_METHOD 1 100 0 255 ECU_ADDRESS 0x2402727e /end MEASUREMENT
/begin MEASUREMENT ACR_ABL_Prioritization_RL2_DD_SVSMA_PRIO218_DEBUGOUT_PRI_Out_ABL_Retract "" UBYTE NO_COMPU_METHOD 1 100 0 255 ECU_ADDRESS 0x24027288 /end MEASUREMENT
/begin MEASUREMENT ACR_ABL_Prioritization_RL2_Debug_ACR_ActivationLevel "" UBYTE NO_COMPU_METHOD 1 100 0 255 ECU_ADDRESS 0x2402721f /end MEASUREMENT
/begin MEASUREMENT ACR_ABL_Prioritization_RL2_Debug_ExtAct_Retract1 "" UBYTE NO_COMPU_METHOD 1 100 0 1 ECU_ADDRESS 0x240272cf /end MEASUREMENT
/begin MEASUREMENT ACR_ABL_Prioritization_RL2_Debug_ExtAct_SLR "" UBYTE NO_COMPU_METHOD 1 100 0 1 ECU_ADDRESS 0x24027256 /end MEASUREMENT
/begin MEASUREMENT ACR_ABL_Prioritization_RL2_Debug_PRI_OccupantWeight "" UBYTE NO_COMPU_METHOD 1 100 0 255 ECU_ADDRESS 0x24027216 /end MEASUREMENT
/begin MEASUREMENT ACR_ABL_Prioritization_RL2_Debug_PRI_WeightClass "" SBYTE NO_COMPU_METHOD 1 100 -128 127 ECU_ADDRESS 0x24027201 /end MEASUREMENT
/begin MEASUREMENT ACR_ABL_Prioritization_RL2_Debug_SLR_out "" UBYTE NO_COMPU_METHOD 1 100 0 1 ECU_ADDRESS 0x2402718f /end MEASUREMENT
/begin MEASUREMENT ACR_ABL_Prioritization_RL2_DEBUGOUT_PRI_Out_ACR_Retract "" UBYTE NO_COMPU_METHOD 1 100 0 255 ECU_ADDRESS 0x240271c6 /end MEASUREMENT
/begin MEASUREMENT ACR_ABL_Prioritization_RL2_VS_Abort_Retract_Buckle "" UBYTE NO_COMPU_METHOD 1 100 0 1 ECU_ADDRESS 0x24027200 /end MEASUREMENT
/begin MEASUREMENT ACR_ABL_Prioritization_RL2_VS_Abort_Retract_ISwStat "" UBYTE NO_COMPU_METHOD 1 100 0 1 ECU_ADDRESS 0x2402721a /end MEASUREMENT
/begin MEASUREMENT ACR_ABL_Prioritization_RR1_DD_SVSMA_PRIO231_DEBUGOUT_PRI_DG_Out_Release "" UBYTE NO_COMPU_METHOD 1 100 0 255 ECU_ADDRESS 0x24027170 /end MEASUREMENT
/begin MEASUREMENT ACR_ABL_Prioritization_RR1_DD_SVSMA_PRIO231_DEBUGOUT_PRI_In_Bkl "" UBYTE NO_COMPU_METHOD 1 100 0 255 ECU_ADDRESS 0x2402718d /end MEASUREMENT
/begin MEASUREMENT ACR_ABL_Prioritization_RR1_DD_SVSMA_PRIO231_DEBUGOUT_PRI_In_BRK "" UBYTE NO_COMPU_METHOD 1 100 0 255 ECU_ADDRESS 0x24027135 /end MEASUREMENT
/begin MEASUREMENT ACR_ABL_Prioritization_RR1_DD_SVSMA_PRIO231_DEBUGOUT_PRI_In_CD "" UBYTE NO_COMPU_METHOD 1 100 0 255 ECU_ADDRESS 0x24027238 /end MEASUREMENT
/begin MEASUREMENT ACR_ABL_Prioritization_RR1_DD_SVSMA_PRIO231_DEBUGOUT_PRI_In_DA "" UWORD NO_COMPU_METHOD 1 100 0 65535 ECU_ADDRESS 0x240271d2 /end MEASUREMENT
/begin MEASUREMENT ACR_ABL_Prioritization_RR1_DD_SVSMA_PRIO231_DEBUGOUT_PRI_In_DB "" UBYTE NO_COMPU_METHOD 1 100 0 255 ECU_ADDRESS 0x240271d4 /end MEASUREMENT
/begin MEASUREMENT ACR_ABL_Prioritization_RR1_DD_SVSMA_PRIO231_DEBUGOUT_PRI_In_REL "" UBYTE NO_COMPU_METHOD 1 100 0 255 ECU_ADDRESS 0x24027260 /end MEASUREMENT
/begin MEASUREMENT ACR_ABL_Prioritization_RR1_DD_SVSMA_PRIO231_DEBUGOUT_PRI_In_SLR "" UBYTE NO_COMPU_METHOD 1 100 0 255 ECU_ADDRESS 0x24027158 /end MEASUREMENT
/begin MEASUREMENT ACR_ABL_Prioritization_RR1_DD_SVSMA_PRIO231_DEBUGOUT_PRI_In_VehObs "" UBYTE NO_COMPU_METHOD 1 100 0 255 ECU_ADDRESS 0x2402721e /end MEASUREMENT
/begin MEASUREMENT ACR_ABL_Prioritization_RR1_DD_SVSMA_PRIO231_DEBUGOUT_PRI_In_VehObsWarning "" UBYTE NO_COMPU_METHOD 1 100 0 255 ECU_ADDRESS 0x2402721d /end MEASUREMENT
/begin MEASUREMENT ACR_ABL_Prioritization_RR1_DD_SVSMA_PRIO274_DEBUGOUT_PRI_Out_ABL_Retract "" UBYTE NO_COMPU_METHOD 1 100 0 255 ECU_ADDRESS 0x240272a0 /end MEASUREMENT
/begin MEASUREMENT ACR_ABL_Prioritization_RR1_Debug_ACR_ActivationLevel "" UBYTE NO_COMPU_METHOD 1 100 0 255 ECU_ADDRESS 0x2402725c /end MEASUREMENT
/begin MEASUREMENT ACR_ABL_Prioritization_RR1_Debug_ExtAct_Retract1 "" UBYTE NO_COMPU_METHOD 1 100 0 1 ECU_ADDRESS 0x24027196 /end MEASUREMENT
/begin MEASUREMENT ACR_ABL_Prioritization_RR1_Debug_ExtAct_SLR "" UBYTE NO_COMPU_METHOD 1 100 0 1 ECU_ADDRESS 0x2402718c /end MEASUREMENT
/begin MEASUREMENT ACR_ABL_Prioritization_RR1_Debug_PRI_OccupantWeight "" UBYTE NO_COMPU_METHOD 1 100 0 255 ECU_ADDRESS 0x240272c0 /end MEASUREMENT
/begin MEASUREMENT ACR_ABL_Prioritization_RR1_Debug_PRI_WeightClass "" SBYTE NO_COMPU_METHOD 1 100 -128 127 ECU_ADDRESS 0x2402719c /end MEASUREMENT
/begin MEASUREMENT ACR_ABL_Prioritization_RR1_Debug_SLR_out "" UBYTE NO_COMPU_METHOD 1 100 0 1 ECU_ADDRESS 0x240271dc /end MEASUREMENT
/begin MEASUREMENT ACR_ABL_Prioritization_RR1_DEBUGOUT_PRI_Out_ACR_Retract "" UBYTE NO_COMPU_METHOD 1 100 0 255 ECU_ADDRESS 0x240272ce /end MEASUREMENT
/begin MEASUREMENT ACR_ABL_Prioritization_RR1_VS_Abort_Retract_Buckle "" UBYTE NO_COMPU_METHOD 1 100 0 1 ECU_ADDRESS 0x240271ee /end MEASUREMENT
/begin MEASUREMENT ACR_ABL_Prioritization_RR1_VS_Abort_Retract_ISwStat "" UBYTE NO_COMPU_METHOD 1 100 0 1 ECU_ADDRESS 0x24027264 /end MEASUREMENT
/begin MEASUREMENT ADHOW_L1_set "" UBYTE NO_COMPU_METHOD 1 100 0 1 ECU_ADDRESS 0x240162e5 /end MEASUREMENT
/begin MEASUREMENT ADHOW_L2_set "" UBYTE NO_COMPU_METHOD 1 100 0 1 ECU_ADDRESS 0x240162e4 /end MEASUREMENT
/begin MEASUREMENT ADHOW_L3_set "" UBYTE NO_COMPU_METHOD 1 100 0 1 ECU_ADDRESS 0x240162ea /end MEASUREMENT
/begin MEASUREMENT ALI_AcceleratorPedal_perc "Acceleration Pedal position" UBYTE SMA_FNC_AcceleratorPedal 1 100 0 102 ECU_ADDRESS 0x24026db5 /end MEASUREMENT
/begin MEASUREMENT ALI_Active_LDP_Assist_Request "" UBYTE NO_COMPU_METHOD 1 100 0 255 ECU_ADDRESS 0x24026df7 /end MEASUREMENT
/begin MEASUREMENT ALI_AutonDrivHandover_Req "" UBYTE NO_COMPU_METHOD 1 100 0 255 ECU_ADDRESS 0x24027118 /end MEASUREMENT
/begin MEASUREMENT ALI_BrakePressure_bar "Brake Pressure" SWORD SMA_FNC_BrakePressure 1 100 -16384 16383.5 ECU_ADDRESS 0x24026d9a /end MEASUREMENT
/begin MEASUREMENT ALI_BSD_Left_Request "" UBYTE NO_COMPU_METHOD 1 100 0 255 ECU_ADDRESS 0x24026da7 /end MEASUREMENT
/begin MEASUREMENT ALI_BSD_Right_Request "" UBYTE NO_COMPU_METHOD 1 100 0 255 ECU_ADDRESS 0x24026dd6 /end MEASUREMENT
/begin MEASUREMENT ALI_CarSpeed_kmh "Vehicle Speed" UWORD SMA_FNC_CarSpeed 1 100 0 655.35 ECU_ADDRESS 0x24026de0 /end MEASUREMENT
/begin MEASUREMENT ALI_ESP_Deactivated "ESP Status  1 Deactivated   0 Activated" UBYTE NO_COMPU_METHOD 1 100 0 1 ECU_ADDRESS 0x24026d8e /end MEASUREMENT
/begin MEASUREMENT ALI_FLDoors_Open "" UBYTE NO_COMPU_METHOD 1 100 0 255 ECU_ADDRESS 0x24026dc9 /end MEASUREMENT
/begin MEASUREMENT ALI_FRDoors_Open "" UBYTE NO_COMPU_METHOD 1 100 0 255 ECU_ADDRESS 0x24026db4 /end MEASUREMENT
/begin MEASUREMENT ALI_LateralAccel_Y_ms2 "Lateral Acceleration" SWORD SMA_FNC_LateralAccel_Y 1 100 -3276.8 3276.7000000000003 ECU_ADDRESS 0x24026de6 /end MEASUREMENT
/begin MEASUREMENT ALI_LongitudinalAccel_X_ms2 "Longitudinal Acceleration" SWORD SMA_FNC_LongitudinalAccel_X 1 100 -3276.8 3276.7000000000003 ECU_ADDRESS 0x24026db0 /end MEASUREMENT
/begin MEASUREMENT ALI_ReverseGearIndicator "Drive in Reverse Gear: 1  Backward  0 Forward" UBYTE NO_COMPU_METHOD 1 100 0 1 ECU_ADDRESS 0x24026dbf /end MEASUREMENT
/begin MEASUREMENT ALI_RLDoors_Open "" UBYTE NO_COMPU_METHOD 1 100 0 255 ECU_ADDRESS 0x24026db7 /end MEASUREMENT
/begin MEASUREMENT ALI_RRDoors_Open "" UBYTE NO_COMPU_METHOD 1 100 0 255 ECU_ADDRESS 0x24026dc2 /end MEASUREMENT
/begin MEASUREMENT ALI_WarnBlinking_active "" UBYTE NO_COMPU_METHOD 1 100 0 1 ECU_ADDRESS 0x24027117 /end MEASUREMENT
/begin MEASUREMENT BKU_DG_VehicleStart_f "" UBYTE NO_COMPU_METHOD 1 100 0 1 ECU_ADDRESS 0x24026df8 /end MEASUREMENT
/begin MEASUREMENT BSD_Left "" UBYTE NO_COMPU_METHOD 1 100 0 1 ECU_ADDRESS 0x24027111 /end MEASUREMENT
/begin MEASUREMENT BSD_Right "" UBYTE NO_COMPU_METHOD 1 100 0 1 ECU_ADDRESS 0x24027116 /end MEASUREMENT
/begin MEASUREMENT CAN1_CDTin_Direct_WheelAngle_deg "" SWORD SMA_FNC_DirectWheelAngle 1 100 -163.84 163.835 ECU_ADDRESS 0x24026d94 /end MEASUREMENT
/begin MEASUREMENT DD_SVSMA_CRD3_1 "" UBYTE NO_COMPU_METHOD 1 100 0 1 ECU_ADDRESS 0x2402705e /end MEASUREMENT
/begin MEASUREMENT DD_SVSMA_CRD3_2 "" UBYTE NO_COMPU_METHOD 1 100 0 1 ECU_ADDRESS 0x2402705f /end MEASUREMENT
/begin MEASUREMENT DD_SVSMA_CRD4_1 "" UBYTE NO_COMPU_METHOD 1 100 0 1 ECU_ADDRESS 0x2402705d /end MEASUREMENT
/begin MEASUREMENT DD_SVSMA_CRD4_2 "" UBYTE NO_COMPU_METHOD 1 100 0 1 ECU_ADDRESS 0x2402705c /end MEASUREMENT
/begin MEASUREMENT Debug_OOP_Status_FL "" UBYTE NO_COMPU_METHOD 1 100 0 1 ECU_ADDRESS 0x2402710a /end MEASUREMENT
/begin MEASUREMENT Debug_OOP_Status_FR "" UBYTE NO_COMPU_METHOD 1 100 0 1 ECU_ADDRESS 0x240270f0 /end MEASUREMENT
/begin MEASUREMENT DEBUGOUT_brake_task_brk_press "" SWORD EQ_LSB_0_5 1 100 -16384 16383.5 ECU_ADDRESS 0x240161f4 /end MEASUREMENT
/begin MEASUREMENT DEBUGOUT_brake_task_brk_press_grad "" SWORD EQ_LSB_0_5 1 100 -16384 16383.5 ECU_ADDRESS 0x240161f2 /end MEASUREMENT
/begin MEASUREMENT DEBUGOUT_brake_task_Fapedrowe "" UBYTE EQ_LSB_0_4 1 100 0 102 ECU_ADDRESS 0x24016177 /end MEASUREMENT
/begin MEASUREMENT DEBUGOUT_brake_task_SARA_AX "" SWORD EQ_LSB_0_1 1 100 -3276.8 3276.7000000000003 ECU_ADDRESS 0x240161f8 /end MEASUREMENT
/begin MEASUREMENT DEBUGOUT_brake_task_SARA_AX_invert "" SWORD EQ_LSB_0_1 1 100 -3276.8 3276.7000000000003 ECU_ADDRESS 0x240161f6 /end MEASUREMENT
/begin MEASUREMENT DEBUGOUT_C_I_Dyn_Supp_BRK_threshold "" UBYTE NO_COMPU_METHOD 1 100 0 1 ECU_ADDRESS 0x240161d7 /end MEASUREMENT
/begin MEASUREMENT DEBUGOUT_C_I_Dyn_Supp_crit_thresh_over "" UBYTE NO_COMPU_METHOD 1 100 0 1 ECU_ADDRESS 0x240161d5 /end MEASUREMENT
/begin MEASUREMENT DEBUGOUT_C_I_Dyn_Supp_crit_thresh_under "" UBYTE NO_COMPU_METHOD 1 100 0 1 ECU_ADDRESS 0x240161d4 /end MEASUREMENT
/begin MEASUREMENT DEBUGOUT_C_I_Dyn_Supp_ESP_BRK "" UBYTE NO_COMPU_METHOD 1 100 0 1 ECU_ADDRESS 0x240161d6 /end MEASUREMENT
/begin MEASUREMENT DEBUGOUT_C_I_ESPOff_thresh_over "" UBYTE NO_COMPU_METHOD 1 100 0 1 ECU_ADDRESS 0x240161d3 /end MEASUREMENT
/begin MEASUREMENT DEBUGOUT_C_I_ESPOff_thresh_under "" UBYTE NO_COMPU_METHOD 1 100 0 1 ECU_ADDRESS 0x240161d2 /end MEASUREMENT
/begin MEASUREMENT DEBUGOUT_C_I_Precrash_crit_thresh_over "" UBYTE NO_COMPU_METHOD 1 100 0 1 ECU_ADDRESS 0x240161d1 /end MEASUREMENT
/begin MEASUREMENT DEBUGOUT_C_I_Precrash_crit_thresh_under "" UBYTE NO_COMPU_METHOD 1 100 0 1 ECU_ADDRESS 0x240161d0 /end MEASUREMENT
/begin MEASUREMENT DEBUGOUT_crit_index_over_ay_diff "" UWORD EQ_LSB_0_1 1 100 0 6553.5 ECU_ADDRESS 0x240161f0 /end MEASUREMENT
/begin MEASUREMENT DEBUGOUT_crit_index_over_psi_dot_diff "" UWORD EQ_LSB_0_1 1 100 0 6553.5 ECU_ADDRESS 0x240161ee /end MEASUREMENT
/begin MEASUREMENT DEBUGOUT_crit_index_under_ay_diff "" UWORD EQ_LSB_0_1 1 100 0 6553.5 ECU_ADDRESS 0x240161ec /end MEASUREMENT
/begin MEASUREMENT DEBUGOUT_crit_index_under_psi_dot_diff "" UWORD EQ_LSB_0_1 1 100 0 6553.5 ECU_ADDRESS 0x240161ea /end MEASUREMENT
/begin MEASUREMENT DEBUGOUT_criticality_index_oversteer "" UWORD EQ_LSB_0_1 1 100 0 6553.5 ECU_ADDRESS 0x240161e8 /end MEASUREMENT
/begin MEASUREMENT DEBUGOUT_criticality_index_sum "" UWORD EQ_LSB_0_1 1 100 0 6553.5 ECU_ADDRESS 0x240161e6 /end MEASUREMENT
/begin MEASUREMENT DEBUGOUT_criticality_index_understeer "" UWORD EQ_LSB_0_1 1 100 0 6553.5 ECU_ADDRESS 0x240161e4 /end MEASUREMENT
/begin MEASUREMENT DEBUGOUT_Dyn_Supp_Oversteer_request "" UBYTE NO_COMPU_METHOD 1 100 0 1 ECU_ADDRESS 0x240161cf /end MEASUREMENT
/begin MEASUREMENT DEBUGOUT_Dyn_Supp_Understeer_request "" UBYTE NO_COMPU_METHOD 1 100 0 1 ECU_ADDRESS 0x240161ce /end MEASUREMENT
/begin MEASUREMENT DEBUGOUT_EBL_DG_Sum_BRK_FL_b "" UBYTE NO_COMPU_METHOD 1 100 0 255 ECU_ADDRESS 0x240161cd /end MEASUREMENT
/begin MEASUREMENT DEBUGOUT_EBL_DG_Sum_BRK_FR_b "" UBYTE NO_COMPU_METHOD 1 100 0 255 ECU_ADDRESS 0x240161cc /end MEASUREMENT
/begin MEASUREMENT DEBUGOUT_EBL_DG_Sum_CD_FL_b "" UBYTE NO_COMPU_METHOD 1 100 0 255 ECU_ADDRESS 0x240161cb /end MEASUREMENT
/begin MEASUREMENT DEBUGOUT_EBL_DG_Sum_CD_FR_b "" UBYTE NO_COMPU_METHOD 1 100 0 255 ECU_ADDRESS 0x240161ca /end MEASUREMENT
/begin MEASUREMENT DEBUGOUT_EBL_DG_Sum_CD_RL1_b "" UBYTE NO_COMPU_METHOD 1 100 0 255 ECU_ADDRESS 0x240270e1 /end MEASUREMENT
/begin MEASUREMENT DEBUGOUT_EBL_DG_Sum_CD_RL2_b "" UBYTE NO_COMPU_METHOD 1 100 0 255 ECU_ADDRESS 0x240270ef /end MEASUREMENT
/begin MEASUREMENT DEBUGOUT_EBL_DG_Sum_CD_RR1_b "" UBYTE NO_COMPU_METHOD 1 100 0 255 ECU_ADDRESS 0x240270ce /end MEASUREMENT
/begin MEASUREMENT DEBUGOUT_EBL_DG_Sum_DB_FL_b "" UBYTE NO_COMPU_METHOD 1 100 0 255 ECU_ADDRESS 0x240270d8 /end MEASUREMENT
/begin MEASUREMENT DEBUGOUT_EBL_DG_Sum_DB_FR_b "" UBYTE NO_COMPU_METHOD 1 100 0 255 ECU_ADDRESS 0x240270aa /end MEASUREMENT
/begin MEASUREMENT DEBUGOUT_EBL_DG_Sum_DB_RL1_b "" UBYTE NO_COMPU_METHOD 1 100 0 255 ECU_ADDRESS 0x240270c4 /end MEASUREMENT
/begin MEASUREMENT DEBUGOUT_EBL_DG_Sum_DB_RL2_b "" UBYTE NO_COMPU_METHOD 1 100 0 255 ECU_ADDRESS 0x24027110 /end MEASUREMENT
/begin MEASUREMENT DEBUGOUT_EBL_DG_Sum_DB_RR1_b "" UBYTE NO_COMPU_METHOD 1 100 0 255 ECU_ADDRESS 0x240270d2 /end MEASUREMENT
/begin MEASUREMENT DEBUGOUT_EBL_DG_Sum_REL_FL_b "" UBYTE NO_COMPU_METHOD 1 100 0 255 ECU_ADDRESS 0x240161c9 /end MEASUREMENT
/begin MEASUREMENT DEBUGOUT_EBL_DG_Sum_REL_FR_b "" UBYTE NO_COMPU_METHOD 1 100 0 255 ECU_ADDRESS 0x240161c8 /end MEASUREMENT
/begin MEASUREMENT DEBUGOUT_EBL_DG_Sum_REL_RL1_b "" UBYTE NO_COMPU_METHOD 1 100 0 255 ECU_ADDRESS 0x240161c7 /end MEASUREMENT
/begin MEASUREMENT DEBUGOUT_EBL_DG_Sum_REL_RL2_b "" UBYTE NO_COMPU_METHOD 1 100 0 255 ECU_ADDRESS 0x240161c6 /end MEASUREMENT
/begin MEASUREMENT DEBUGOUT_EBL_DG_Sum_REL_RR1_b "" UBYTE NO_COMPU_METHOD 1 100 0 255 ECU_ADDRESS 0x240161c5 /end MEASUREMENT
/begin MEASUREMENT DEBUGOUT_EBL_DG_Sum_VehObs_Dr_b "" UBYTE NO_COMPU_METHOD 1 100 0 255 ECU_ADDRESS 0x24027068 /end MEASUREMENT
/begin MEASUREMENT DEBUGOUT_EBL_DG_Sum_VehObs_Pa_b "" UBYTE NO_COMPU_METHOD 1 100 0 255 ECU_ADDRESS 0x240270e0 /end MEASUREMENT
/begin MEASUREMENT DEBUGOUT_EBL_DG_Sum_VehObs_RL_b "" UBYTE NO_COMPU_METHOD 1 100 0 255 ECU_ADDRESS 0x24027084 /end MEASUREMENT
/begin MEASUREMENT DEBUGOUT_EBL_DG_Sum_VehObs_RR_b "" UBYTE NO_COMPU_METHOD 1 100 0 255 ECU_ADDRESS 0x240270e6 /end MEASUREMENT
/begin MEASUREMENT DEBUGOUT_EBL_DG_Sum_VehObsWarn_Dr_b "" UBYTE NO_COMPU_METHOD 1 100 0 255 ECU_ADDRESS 0x240270c8 /end MEASUREMENT
/begin MEASUREMENT DEBUGOUT_EBL_DG_Sum_VehObsWarn_Pa_b "" UBYTE NO_COMPU_METHOD 1 100 0 255 ECU_ADDRESS 0x2402708c /end MEASUREMENT
/begin MEASUREMENT DEBUGOUT_EBL_In_ABL_Request_FL_b "" UBYTE NO_COMPU_METHOD 1 100 0 255 ECU_ADDRESS 0x240161c4 /end MEASUREMENT
/begin MEASUREMENT DEBUGOUT_EBL_In_ABL_Request_FR_b "" UBYTE NO_COMPU_METHOD 1 100 0 255 ECU_ADDRESS 0x240270b4 /end MEASUREMENT
/begin MEASUREMENT DEBUGOUT_EBL_In_ABL_Request_RL1_b "" UBYTE NO_COMPU_METHOD 1 100 0 255 ECU_ADDRESS 0x240270a6 /end MEASUREMENT
/begin MEASUREMENT DEBUGOUT_EBL_In_ABL_Request_RL2_b "" UBYTE NO_COMPU_METHOD 1 100 0 255 ECU_ADDRESS 0x240270f6 /end MEASUREMENT
/begin MEASUREMENT DEBUGOUT_EBL_In_ABL_Request_RR1_b "" UBYTE NO_COMPU_METHOD 1 100 0 255 ECU_ADDRESS 0x240270e7 /end MEASUREMENT
/begin MEASUREMENT DEBUGOUT_EBL_In_ACR_Request_FL_b "" UBYTE NO_COMPU_METHOD 1 100 0 255 ECU_ADDRESS 0x240161c3 /end MEASUREMENT
/begin MEASUREMENT DEBUGOUT_EBL_In_ACR_Request_FR_b "" UBYTE NO_COMPU_METHOD 1 100 0 255 ECU_ADDRESS 0x240270e2 /end MEASUREMENT
/begin MEASUREMENT DEBUGOUT_EBL_In_ACR_Request_RL1_b "" UBYTE NO_COMPU_METHOD 1 100 0 255 ECU_ADDRESS 0x240270ee /end MEASUREMENT
/begin MEASUREMENT DEBUGOUT_EBL_In_ACR_Request_RL2_b "" UBYTE NO_COMPU_METHOD 1 100 0 255 ECU_ADDRESS 0x240270fc /end MEASUREMENT
/begin MEASUREMENT DEBUGOUT_EBL_In_ACR_Request_RR1_b "" UBYTE NO_COMPU_METHOD 1 100 0 255 ECU_ADDRESS 0x240270d9 /end MEASUREMENT
/begin MEASUREMENT DEBUGOUT_EBL_In_BP_FL_b "" UBYTE NO_COMPU_METHOD 1 100 0 255 ECU_ADDRESS 0x240161c2 /end MEASUREMENT
/begin MEASUREMENT DEBUGOUT_EBL_In_BP_FR_b "" UBYTE NO_COMPU_METHOD 1 100 0 255 ECU_ADDRESS 0x240161c1 /end MEASUREMENT
/begin MEASUREMENT DEBUGOUT_EBL_In_BRK_b "" UBYTE NO_COMPU_METHOD 1 100 0 255 ECU_ADDRESS 0x240161c0 /end MEASUREMENT
/begin MEASUREMENT DEBUGOUT_EBL_In_CD_b "" UBYTE NO_COMPU_METHOD 1 100 0 255 ECU_ADDRESS 0x240161bf /end MEASUREMENT
/begin MEASUREMENT DEBUGOUT_EBL_In_DA_b "" UWORD NO_COMPU_METHOD 1 100 0 65535 ECU_ADDRESS 0x24016218 /end MEASUREMENT
/begin MEASUREMENT DEBUGOUT_EBL_In_DB_b "" UBYTE NO_COMPU_METHOD 1 100 0 255 ECU_ADDRESS 0x240161be /end MEASUREMENT
/begin MEASUREMENT DEBUGOUT_EBL_In_MinSpd_b "" UBYTE NO_COMPU_METHOD 1 100 0 255 ECU_ADDRESS 0x240161bd /end MEASUREMENT
/begin MEASUREMENT DEBUGOUT_EBL_In_MoDir_b "" UBYTE NO_COMPU_METHOD 1 100 0 255 ECU_ADDRESS 0x240161bc /end MEASUREMENT
/begin MEASUREMENT DEBUGOUT_EBL_In_REL_b "" UBYTE NO_COMPU_METHOD 1 100 0 255 ECU_ADDRESS 0x240161bb /end MEASUREMENT
/begin MEASUREMENT DEBUGOUT_EBL_In_SLR_FL_b "" UBYTE NO_COMPU_METHOD 1 100 0 255 ECU_ADDRESS 0x240161ba /end MEASUREMENT
/begin MEASUREMENT DEBUGOUT_EBL_In_SLR_FR_b "" UBYTE NO_COMPU_METHOD 1 100 0 255 ECU_ADDRESS 0x240161b9 /end MEASUREMENT
/begin MEASUREMENT DEBUGOUT_EBL_In_SLR_RL1_b "" UBYTE NO_COMPU_METHOD 1 100 0 255 ECU_ADDRESS 0x240161b8 /end MEASUREMENT
/begin MEASUREMENT DEBUGOUT_EBL_In_SLR_RL2_b "" UBYTE NO_COMPU_METHOD 1 100 0 255 ECU_ADDRESS 0x240161b7 /end MEASUREMENT
/begin MEASUREMENT DEBUGOUT_EBL_In_SLR_RR1_b "" UBYTE NO_COMPU_METHOD 1 100 0 255 ECU_ADDRESS 0x240161b6 /end MEASUREMENT
/begin MEASUREMENT DEBUGOUT_EBL_Out_BRK_FL_b "" UBYTE NO_COMPU_METHOD 1 100 0 255 ECU_ADDRESS 0x240161b5 /end MEASUREMENT
/begin MEASUREMENT DEBUGOUT_EBL_Out_BRK_FR_b "" UBYTE NO_COMPU_METHOD 1 100 0 255 ECU_ADDRESS 0x240161b4 /end MEASUREMENT
/begin MEASUREMENT DEBUGOUT_EBL_Out_BRK_RL1_b "" UBYTE NO_COMPU_METHOD 1 100 0 255 ECU_ADDRESS 0x240161b3 /end MEASUREMENT
/begin MEASUREMENT DEBUGOUT_EBL_Out_BRK_RL2_b "" UBYTE NO_COMPU_METHOD 1 100 0 255 ECU_ADDRESS 0x240161b2 /end MEASUREMENT
/begin MEASUREMENT DEBUGOUT_EBL_Out_BRK_RR1_b "" UBYTE NO_COMPU_METHOD 1 100 0 255 ECU_ADDRESS 0x240161b1 /end MEASUREMENT
/begin MEASUREMENT DEBUGOUT_EBL_Out_CD_FL_b "" UBYTE NO_COMPU_METHOD 1 100 0 255 ECU_ADDRESS 0x240161b0 /end MEASUREMENT
/begin MEASUREMENT DEBUGOUT_EBL_Out_CD_FR_b "" UBYTE NO_COMPU_METHOD 1 100 0 255 ECU_ADDRESS 0x240161af /end MEASUREMENT
/begin MEASUREMENT DEBUGOUT_EBL_Out_CD_RL1_b "" UBYTE NO_COMPU_METHOD 1 100 0 255 ECU_ADDRESS 0x240161ae /end MEASUREMENT
/begin MEASUREMENT DEBUGOUT_EBL_Out_CD_RL2_b "" UBYTE NO_COMPU_METHOD 1 100 0 255 ECU_ADDRESS 0x240161ad /end MEASUREMENT
/begin MEASUREMENT DEBUGOUT_EBL_Out_CD_RR1_b "" UBYTE NO_COMPU_METHOD 1 100 0 255 ECU_ADDRESS 0x240161ac /end MEASUREMENT
/begin MEASUREMENT DEBUGOUT_EBL_Out_DA_FL_b "" UWORD NO_COMPU_METHOD 1 100 0 65535 ECU_ADDRESS 0x240270ea /end MEASUREMENT
/begin MEASUREMENT DEBUGOUT_EBL_Out_DA_FR_b "" UWORD NO_COMPU_METHOD 1 100 0 65535 ECU_ADDRESS 0x2402710e /end MEASUREMENT
/begin MEASUREMENT DEBUGOUT_EBL_Out_DA_RL1_b "" UWORD NO_COMPU_METHOD 1 100 0 65535 ECU_ADDRESS 0x24027102 /end MEASUREMENT
/begin MEASUREMENT DEBUGOUT_EBL_Out_DA_RL2_b "" UWORD NO_COMPU_METHOD 1 100 0 65535 ECU_ADDRESS 0x240270ca /end MEASUREMENT
/begin MEASUREMENT DEBUGOUT_EBL_Out_DA_RR1_b "" UWORD NO_COMPU_METHOD 1 100 0 65535 ECU_ADDRESS 0x240270d0 /end MEASUREMENT
/begin MEASUREMENT DEBUGOUT_EBL_Out_DB_FL_b "" UBYTE NO_COMPU_METHOD 1 100 0 255 ECU_ADDRESS 0x240270e8 /end MEASUREMENT
/begin MEASUREMENT DEBUGOUT_EBL_Out_DB_FR_b "" UBYTE NO_COMPU_METHOD 1 100 0 255 ECU_ADDRESS 0x24027085 /end MEASUREMENT
/begin MEASUREMENT DEBUGOUT_EBL_Out_DB_RL1_b "" UBYTE NO_COMPU_METHOD 1 100 0 255 ECU_ADDRESS 0x240270e3 /end MEASUREMENT
/begin MEASUREMENT DEBUGOUT_EBL_Out_DB_RL2_b "" UBYTE NO_COMPU_METHOD 1 100 0 255 ECU_ADDRESS 0x24027076 /end MEASUREMENT
/begin MEASUREMENT DEBUGOUT_EBL_Out_DB_RR1_b "" UBYTE NO_COMPU_METHOD 1 100 0 255 ECU_ADDRESS 0x24027088 /end MEASUREMENT
/begin MEASUREMENT DEBUGOUT_EBL_Out_SLR_FL_b "" UBYTE NO_COMPU_METHOD 1 100 0 255 ECU_ADDRESS 0x240161ab /end MEASUREMENT
/begin MEASUREMENT DEBUGOUT_EBL_Out_SLR_FR_b "" UBYTE NO_COMPU_METHOD 1 100 0 255 ECU_ADDRESS 0x240161aa /end MEASUREMENT
/begin MEASUREMENT DEBUGOUT_EBL_Out_SLR_RL1_b "" UBYTE NO_COMPU_METHOD 1 100 0 255 ECU_ADDRESS 0x240161a9 /end MEASUREMENT
/begin MEASUREMENT DEBUGOUT_EBL_Out_SLR_RL2_b "" UBYTE NO_COMPU_METHOD 1 100 0 255 ECU_ADDRESS 0x240161a8 /end MEASUREMENT
/begin MEASUREMENT DEBUGOUT_EBL_Out_SLR_RR1_b "" UBYTE NO_COMPU_METHOD 1 100 0 255 ECU_ADDRESS 0x240161a7 /end MEASUREMENT
/begin MEASUREMENT DEBUGOUT_EBL_Out_VehObs_Dr_2Row_b "" UBYTE NO_COMPU_METHOD 1 100 0 255 ECU_ADDRESS 0x24027060 /end MEASUREMENT
/begin MEASUREMENT DEBUGOUT_EBL_Out_VehObs_Dr_b "" UBYTE NO_COMPU_METHOD 1 100 0 255 ECU_ADDRESS 0x24027090 /end MEASUREMENT
/begin MEASUREMENT DEBUGOUT_EBL_Out_VehObs_Pa_2Row_b "" UBYTE NO_COMPU_METHOD 1 100 0 255 ECU_ADDRESS 0x24027061 /end MEASUREMENT
/begin MEASUREMENT DEBUGOUT_EBL_Out_VehObs_Pa_b "" UBYTE NO_COMPU_METHOD 1 100 0 255 ECU_ADDRESS 0x240270c9 /end MEASUREMENT
/begin MEASUREMENT DEBUGOUT_EPBD_brk_press_grad_thresh "" UBYTE NO_COMPU_METHOD 1 100 0 1 ECU_ADDRESS 0x240161a4 /end MEASUREMENT
/begin MEASUREMENT DEBUGOUT_EPBD_brk_press_react_set_true "" UBYTE NO_COMPU_METHOD 1 100 0 1 ECU_ADDRESS 0x240161a3 /end MEASUREMENT
/begin MEASUREMENT DEBUGOUT_EPBD_brk_press_thresh "" UBYTE NO_COMPU_METHOD 1 100 0 1 ECU_ADDRESS 0x240161a2 /end MEASUREMENT
/begin MEASUREMENT DEBUGOUT_EPBD_Fapedrowe_grad "" SWORD EQ_LSB_0_4_c 1 100 -10200 10200 ECU_ADDRESS 0x24016216 /end MEASUREMENT
/begin MEASUREMENT DEBUGOUT_EPBD_Fapedrowe_grad_sign "" UBYTE NO_COMPU_METHOD 1 100 0 1 ECU_ADDRESS 0x240161a6 /end MEASUREMENT
/begin MEASUREMENT DEBUGOUT_EPBD_Fapedrowe_grad_thresh "" UBYTE NO_COMPU_METHOD 1 100 0 1 ECU_ADDRESS 0x240161a5 /end MEASUREMENT
/begin MEASUREMENT DEBUGOUT_EPBD_set "" UBYTE NO_COMPU_METHOD 1 100 0 1 ECU_ADDRESS 0x240161a1 /end MEASUREMENT
/begin MEASUREMENT DEBUGOUT_ESPOff_Oversteer_request "" UBYTE NO_COMPU_METHOD 1 100 0 1 ECU_ADDRESS 0x240161a0 /end MEASUREMENT
/begin MEASUREMENT DEBUGOUT_ESPOff_Understeer_request "" UBYTE NO_COMPU_METHOD 1 100 0 1 ECU_ADDRESS 0x2401619f /end MEASUREMENT
/begin MEASUREMENT DEBUGOUT_HVDD_brk_press_thresh "" UBYTE NO_COMPU_METHOD 1 100 0 1 ECU_ADDRESS 0x2401619d /end MEASUREMENT
/begin MEASUREMENT DEBUGOUT_HVDD_SARA_AX_thresh "" UBYTE NO_COMPU_METHOD 1 100 0 1 ECU_ADDRESS 0x2401619e /end MEASUREMENT
/begin MEASUREMENT DEBUGOUT_HVDD_set "" UBYTE NO_COMPU_METHOD 1 100 0 1 ECU_ADDRESS 0x2401619c /end MEASUREMENT
/begin MEASUREMENT DEBUGOUT_IBD_brk_press_thresh "" UBYTE NO_COMPU_METHOD 1 100 0 1 ECU_ADDRESS 0x2401619a /end MEASUREMENT
/begin MEASUREMENT DEBUGOUT_IBD_SARA_AX_thresh "" UBYTE NO_COMPU_METHOD 1 100 0 1 ECU_ADDRESS 0x2401619b /end MEASUREMENT
/begin MEASUREMENT DEBUGOUT_IBD_set "" UBYTE NO_COMPU_METHOD 1 100 0 1 ECU_ADDRESS 0x24016199 /end MEASUREMENT
/begin MEASUREMENT DEBUGOUT_Instab_Fahr_ESP_Bremsdruck "" SWORD EQ_LSB_0_5 1 100 -16384 16383.5 ECU_ADDRESS 0x24016214 /end MEASUREMENT
/begin MEASUREMENT DEBUGOUT_Instab_Fahr_ESP_Tastung_passiv "" UBYTE NO_COMPU_METHOD 1 100 0 255 ECU_ADDRESS 0x24016198 /end MEASUREMENT
/begin MEASUREMENT DEBUGOUT_Instab_Fahr_ESP_v_Signal "" UWORD EQ_LSB_0_01 1 100 0 655.35 ECU_ADDRESS 0x24016212 /end MEASUREMENT
/begin MEASUREMENT DEBUGOUT_Instab_Fahr_SARA_AY "" SWORD EQ_LSB_0_1 1 100 -3276.8 3276.7000000000003 ECU_ADDRESS 0x24016210 /end MEASUREMENT
/begin MEASUREMENT DEBUGOUT_Instab_Fahr_SARA_Omega_Z "" SWORD EQ_LSB_0_01 1 100 -327.68 327.67 ECU_ADDRESS 0x2401620e /end MEASUREMENT
/begin MEASUREMENT DebugOut_MinSpeed_01_f "" UBYTE NO_COMPU_METHOD 1 100 0 1 ECU_ADDRESS 0x24016174 /end MEASUREMENT
/begin MEASUREMENT DEBUGOUT_over_under_s_r_ff_set "" UBYTE NO_COMPU_METHOD 1 100 0 1 ECU_ADDRESS 0x24016176 /end MEASUREMENT
/begin MEASUREMENT DEBUGOUT_over_under_set "" UBYTE NO_COMPU_METHOD 1 100 0 1 ECU_ADDRESS 0x24016175 /end MEASUREMENT
/begin MEASUREMENT DEBUGOUT_PEB_brk_press_grad_thresh "" UBYTE NO_COMPU_METHOD 1 100 0 1 ECU_ADDRESS 0x24016197 /end MEASUREMENT
/begin MEASUREMENT DEBUGOUT_PEB_brk_press_thresh "" UBYTE NO_COMPU_METHOD 1 100 0 1 ECU_ADDRESS 0x24016196 /end MEASUREMENT
/begin MEASUREMENT DEBUGOUT_PEB_set "" UBYTE NO_COMPU_METHOD 1 100 0 1 ECU_ADDRESS 0x24016195 /end MEASUREMENT
/begin MEASUREMENT DEBUGOUT_REB_set "" UBYTE NO_COMPU_METHOD 1 100 0 1 ECU_ADDRESS 0x24016194 /end MEASUREMENT
/begin MEASUREMENT DEBUGOUT_Release_Accel_Detect_stable "" UBYTE NO_COMPU_METHOD 1 100 0 1 ECU_ADDRESS 0x240272d2 /end MEASUREMENT
/begin MEASUREMENT DEBUGOUT_Release_Accel_thresh_set "" UBYTE NO_COMPU_METHOD 1 100 0 1 ECU_ADDRESS 0x2401618d /end MEASUREMENT
/begin MEASUREMENT DEBUGOUT_Release_ax_ay "" UWORD EQ_LSB_0_01 1 100 0 655.35 ECU_ADDRESS 0x2401620a /end MEASUREMENT
/begin MEASUREMENT DEBUGOUT_Release_ax_ay_filtered "" UWORD EQ_LSB_0_01 1 100 0 655.35 ECU_ADDRESS 0x24016208 /end MEASUREMENT
/begin MEASUREMENT DEBUGOUT_Release_ax_ay_positive "" UWORD EQ_LSB_0_01 1 100 0 655.35 ECU_ADDRESS 0x24016206 /end MEASUREMENT
/begin MEASUREMENT DEBUGOUT_Release_BRK_press "" UBYTE NO_COMPU_METHOD 1 100 0 1 ECU_ADDRESS 0x2401618c /end MEASUREMENT
/begin MEASUREMENT DEBUGOUT_Release_Criticality_Stable "" UBYTE NO_COMPU_METHOD 1 100 0 1 ECU_ADDRESS 0x2401618b /end MEASUREMENT
/begin MEASUREMENT DEBUGOUT_Release_Gier_BRK_stabil "" UBYTE NO_COMPU_METHOD 1 100 0 1 ECU_ADDRESS 0x2401618a /end MEASUREMENT
/begin MEASUREMENT DEBUGOUT_Release_Gierbeschl_stabil "" UBYTE NO_COMPU_METHOD 1 100 0 1 ECU_ADDRESS 0x24016189 /end MEASUREMENT
/begin MEASUREMENT DEBUGOUT_Release_Gierbeschleunigung "" UWORD EQ_LSB_0_01 1 100 0 655.35 ECU_ADDRESS 0x2401620c /end MEASUREMENT
/begin MEASUREMENT DEBUGOUT_Release_Gierrate_set "" UBYTE NO_COMPU_METHOD 1 100 0 1 ECU_ADDRESS 0x24016188 /end MEASUREMENT
/begin MEASUREMENT DEBUGOUT_Release_Gierrate_stabil "" UBYTE NO_COMPU_METHOD 1 100 0 1 ECU_ADDRESS 0x24016187 /end MEASUREMENT
/begin MEASUREMENT DEBUGOUT_Release_Kugel_stabil "" UBYTE NO_COMPU_METHOD 1 100 0 1 ECU_ADDRESS 0x24016186 /end MEASUREMENT
/begin MEASUREMENT DEBUGOUT_Release_Rating_Accel_Det_value "" SBYTE EQ_LSB_0_1_d 1 100 -12.8 12.700000000000001 ECU_ADDRESS 0x24016184 /end MEASUREMENT
/begin MEASUREMENT DEBUGOUT_Release_Rating_Critical_value "" SBYTE EQ_LSB_0_1_d 1 100 -12.8 12.700000000000001 ECU_ADDRESS 0x24016183 /end MEASUREMENT
/begin MEASUREMENT DEBUGOUT_Release_Rating_Kugel_value "" SBYTE EQ_LSB_0_1_d 1 100 -12.8 12.700000000000001 ECU_ADDRESS 0x24016182 /end MEASUREMENT
/begin MEASUREMENT DEBUGOUT_Release_Rating_Psi_dot_value "" SBYTE EQ_LSB_0_1_d 1 100 -12.8 12.700000000000001 ECU_ADDRESS 0x24016181 /end MEASUREMENT
/begin MEASUREMENT DEBUGOUT_Release_Rating_V_B_value "" SBYTE EQ_LSB_0_1_d 1 100 -12.8 12.700000000000001 ECU_ADDRESS 0x24016180 /end MEASUREMENT
/begin MEASUREMENT DEBUGOUT_Release_Stable "" UBYTE NO_COMPU_METHOD 1 100 0 1 ECU_ADDRESS 0x2401617f /end MEASUREMENT
/begin MEASUREMENT DEBUGOUT_Release_Sum "" SBYTE EQ_LSB_0_1_d 1 100 -12.8 12.700000000000001 ECU_ADDRESS 0x2401617d /end MEASUREMENT
/begin MEASUREMENT DEBUGOUT_Release_task_Crit_Index "" UWORD EQ_LSB_0_1 1 100 0 6553.5 ECU_ADDRESS 0x24016204 /end MEASUREMENT
/begin MEASUREMENT DEBUGOUT_Release_task_ESP_Bremsdruck "" SWORD EQ_LSB_0_5 1 100 -16384 16383.5 ECU_ADDRESS 0x24016202 /end MEASUREMENT
/begin MEASUREMENT DEBUGOUT_Release_task_ESP_v_Signal "" UWORD EQ_LSB_0_01 1 100 0 655.35 ECU_ADDRESS 0x24016200 /end MEASUREMENT
/begin MEASUREMENT DEBUGOUT_Release_task_Fapedrowe "" UBYTE EQ_LSB_0_4 1 100 0 102 ECU_ADDRESS 0x24016179 /end MEASUREMENT
/begin MEASUREMENT DEBUGOUT_Release_task_SARA_AX "" SWORD EQ_LSB_0_1 1 100 -3276.8 3276.7000000000003 ECU_ADDRESS 0x240161fe /end MEASUREMENT
/begin MEASUREMENT DEBUGOUT_Release_task_SARA_AY "" SWORD EQ_LSB_0_1 1 100 -3276.8 3276.7000000000003 ECU_ADDRESS 0x240161fc /end MEASUREMENT
/begin MEASUREMENT DEBUGOUT_Release_task_SARA_Omega_Z "" SWORD EQ_LSB_0_01 1 100 -327.68 327.67 ECU_ADDRESS 0x240161fa /end MEASUREMENT
/begin MEASUREMENT DEBUGOUT_Release_V_BRK_BRK_thresh "" UBYTE NO_COMPU_METHOD 1 100 0 1 ECU_ADDRESS 0x2401617c /end MEASUREMENT
/begin MEASUREMENT DEBUGOUT_Release_V_BRK_stable "" UBYTE NO_COMPU_METHOD 1 100 0 1 ECU_ADDRESS 0x2401617b /end MEASUREMENT
/begin MEASUREMENT DEBUGOUT_Release_V_BRK_v_thresh "" UBYTE NO_COMPU_METHOD 1 100 0 1 ECU_ADDRESS 0x2401617a /end MEASUREMENT
/begin MEASUREMENT DEBUGOUT_residual_ay_angeglichen "" SWORD EQ_LSB_0_1 1 100 -3276.8 3276.7000000000003 ECU_ADDRESS 0x240161e2 /end MEASUREMENT
/begin MEASUREMENT DEBUGOUT_residual_ay_calc "" SWORD EQ_LSB_0_1 1 100 -3276.8 3276.7000000000003 ECU_ADDRESS 0x240161e0 /end MEASUREMENT
/begin MEASUREMENT DEBUGOUT_residual_ay_diff "" SWORD EQ_LSB_0_1 1 100 -3276.8 3276.7000000000003 ECU_ADDRESS 0x240161de /end MEASUREMENT
/begin MEASUREMENT DEBUGOUT_residual_psi_dot_angeglichen "" SWORD EQ_LSB_0_01 1 100 -327.68 327.67 ECU_ADDRESS 0x240161dc /end MEASUREMENT
/begin MEASUREMENT DEBUGOUT_residual_psi_dot_calc "" SWORD EQ_LSB_0_01 1 100 -327.68 327.67 ECU_ADDRESS 0x240161da /end MEASUREMENT
/begin MEASUREMENT DEBUGOUT_residual_psi_dot_diff "" SWORD EQ_LSB_0_01 1 100 -327.68 327.67 ECU_ADDRESS 0x240161d8 /end MEASUREMENT
/begin MEASUREMENT EBLT_ACR_Ext_ActivationRequest_FR_b "" UBYTE NO_COMPU_METHOD 1 100 0 255 ECU_ADDRESS 0x24026dcf /end MEASUREMENT
/begin MEASUREMENT EBLT_ACR_ExtActivationRequest_FL_b "" UBYTE NO_COMPU_METHOD 1 100 0 255 ECU_ADDRESS 0x24026de3 /end MEASUREMENT
/begin MEASUREMENT EBLT_ACR_ExtActivationRequest_RL1_b "" UBYTE NO_COMPU_METHOD 1 100 0 255 ECU_ADDRESS 0x24026de4 /end MEASUREMENT
/begin MEASUREMENT EBLT_ACR_ExtActivationRequest_RR1_b "" UBYTE NO_COMPU_METHOD 1 100 0 255 ECU_ADDRESS 0x24026ded /end MEASUREMENT
/begin MEASUREMENT EBLT_DynBeltTask_FL_Enable_b "" UBYTE NO_COMPU_METHOD 1 100 0 255 ECU_ADDRESS 0x24026db2 /end MEASUREMENT
/begin MEASUREMENT EBLT_DynBeltTask_FR_Enable_b "" UBYTE NO_COMPU_METHOD 1 100 0 255 ECU_ADDRESS 0x24026da5 /end MEASUREMENT
/begin MEASUREMENT EBLT_DynBeltTask_RL1_Enable_b "" UBYTE NO_COMPU_METHOD 1 100 0 255 ECU_ADDRESS 0x24026dda /end MEASUREMENT
/begin MEASUREMENT EBLT_DynBeltTask_RR1_Enable_b "" UBYTE NO_COMPU_METHOD 1 100 0 255 ECU_ADDRESS 0x24026dee /end MEASUREMENT
/begin MEASUREMENT EBLT_VehObsTask_Dr_Enable_b "" UBYTE NO_COMPU_METHOD 1 100 0 255 ECU_ADDRESS 0x24026deb /end MEASUREMENT
/begin MEASUREMENT ISB_Prioritization_FL_Debug_ISB_Colour "" UBYTE NO_COMPU_METHOD 1 100 0 255 ECU_ADDRESS 0x2402729c /end MEASUREMENT
/begin MEASUREMENT ISB_Prioritization_FR_Debug_ISB_Colour "" UBYTE NO_COMPU_METHOD 1 100 0 255 ECU_ADDRESS 0x240271d8 /end MEASUREMENT
/begin MEASUREMENT ISB_Prioritization_RL1_Debug_ISB_Colour "" UBYTE NO_COMPU_METHOD 1 100 0 255 ECU_ADDRESS 0x2402721c /end MEASUREMENT
/begin MEASUREMENT ISB_Prioritization_RL2_Debug_ISB_Colour "" UBYTE NO_COMPU_METHOD 1 100 0 255 ECU_ADDRESS 0x2402716c /end MEASUREMENT
/begin MEASUREMENT ISB_Prioritization_RR1_Debug_ISB_Colour "" UBYTE NO_COMPU_METHOD 1 100 0 255 ECU_ADDRESS 0x24027197 /end MEASUREMENT
/begin MEASUREMENT panther_can1_in.asw_in_can1_0x20_rx_status "CAN1 Receive Status" UBYTE NO_COMPU_METHOD 1 100 0 1 ECU_ADDRESS 0x24026f95 SYMBOL_LINK "panther_can1_in" 49 /end MEASUREMENT
/begin MEASUREMENT panther_can1_in.asw_in_can1_0x30_rx_status "CAN1 Receive Status" UBYTE NO_COMPU_METHOD 1 100 0 1 ECU_ADDRESS 0x24026f79 SYMBOL_LINK "panther_can1_in" 21 /end MEASUREMENT
/begin MEASUREMENT panther_can1_in.asw_in_can1_0x40_rx_status "CAN1 Receive Status" UBYTE NO_COMPU_METHOD 1 100 0 1 ECU_ADDRESS 0x24026f64 SYMBOL_LINK "panther_can1_in" 0 /end MEASUREMENT
/begin MEASUREMENT panther_can2_in.asw_in_can2_0x180_ABL_FL_ActivationLevelStatus "CAN2 receive signal 2" UBYTE NO_COMPU_METHOD 1 100 0 255 ECU_ADDRESS 0x2402702d SYMBOL_LINK "panther_can2_in" 69 /end MEASUREMENT
/begin MEASUREMENT panther_can2_in.asw_in_can2_0x180_ABL_FL_ActivationPhase "CAN2 receive signal 3" UBYTE NO_COMPU_METHOD 1 100 0 255 ECU_ADDRESS 0x2402702e SYMBOL_LINK "panther_can2_in" 70 /end MEASUREMENT
/begin MEASUREMENT panther_can2_in.asw_in_can2_0x180_ABL_FL_S0SensorStatus_bool "CAN2 receive signal 1" UBYTE NO_COMPU_METHOD 1 100 0 1 ECU_ADDRESS 0x2402702c SYMBOL_LINK "panther_can2_in" 68 /end MEASUREMENT
/begin MEASUREMENT panther_can2_in.asw_in_can2_0x180_rx_status "CAN2 Receive Status" UBYTE NO_COMPU_METHOD 1 100 0 1 ECU_ADDRESS 0x2402702b SYMBOL_LINK "panther_can2_in" 67 /end MEASUREMENT
/begin MEASUREMENT panther_can2_in.asw_in_can2_0x181_ABL_FR_ActivationLevelStatus "CAN2 receive signal 2" UBYTE NO_COMPU_METHOD 1 100 0 255 ECU_ADDRESS 0x24027029 SYMBOL_LINK "panther_can2_in" 65 /end MEASUREMENT
/begin MEASUREMENT panther_can2_in.asw_in_can2_0x181_ABL_FR_ActivationPhase "CAN2 receive signal 3" UBYTE NO_COMPU_METHOD 1 100 0 255 ECU_ADDRESS 0x2402702a SYMBOL_LINK "panther_can2_in" 66 /end MEASUREMENT
/begin MEASUREMENT panther_can2_in.asw_in_can2_0x181_ABL_FR_S0SensorStatus_bool "CAN2 receive signal 1" UBYTE NO_COMPU_METHOD 1 100 0 1 ECU_ADDRESS 0x24027028 SYMBOL_LINK "panther_can2_in" 64 /end MEASUREMENT
/begin MEASUREMENT panther_can2_in.asw_in_can2_0x181_rx_status "CAN2 Receive Status" UBYTE NO_COMPU_METHOD 1 100 0 1 ECU_ADDRESS 0x24027027 SYMBOL_LINK "panther_can2_in" 63 /end MEASUREMENT
/begin MEASUREMENT panther_can2_in.asw_in_can2_0x182_ABL_RL1_ActivationLevelStatus "CAN2 receive signal 2" UBYTE NO_COMPU_METHOD 1 100 0 255 ECU_ADDRESS 0x24027025 SYMBOL_LINK "panther_can2_in" 61 /end MEASUREMENT
/begin MEASUREMENT panther_can2_in.asw_in_can2_0x182_ABL_RL1_ActivationPhase "CAN2 receive signal 3" UBYTE NO_COMPU_METHOD 1 100 0 255 ECU_ADDRESS 0x24027026 SYMBOL_LINK "panther_can2_in" 62 /end MEASUREMENT
/begin MEASUREMENT panther_can2_in.asw_in_can2_0x182_ABL_RL1_S0SensorStatus_bool "CAN2 receive signal 1" UBYTE NO_COMPU_METHOD 1 100 0 1 ECU_ADDRESS 0x24027024 SYMBOL_LINK "panther_can2_in" 60 /end MEASUREMENT
/begin MEASUREMENT panther_can2_in.asw_in_can2_0x182_rx_status "CAN2 Receive Status" UBYTE NO_COMPU_METHOD 1 100 0 1 ECU_ADDRESS 0x24027023 SYMBOL_LINK "panther_can2_in" 59 /end MEASUREMENT
/begin MEASUREMENT panther_can2_in.asw_in_can2_0x183_ABL_RL2_ActivationLevelStatus "CAN2 receive signal 2" UBYTE NO_COMPU_METHOD 1 100 0 255 ECU_ADDRESS 0x24027021 SYMBOL_LINK "panther_can2_in" 57 /end MEASUREMENT
/begin MEASUREMENT panther_can2_in.asw_in_can2_0x183_ABL_RL2_ActivationPhase "CAN2 receive signal 3" UBYTE NO_COMPU_METHOD 1 100 0 255 ECU_ADDRESS 0x24027022 SYMBOL_LINK "panther_can2_in" 58 /end MEASUREMENT
/begin MEASUREMENT panther_can2_in.asw_in_can2_0x183_ABL_RL2_S0SensorStatus_bool "CAN2 receive signal 1" UBYTE NO_COMPU_METHOD 1 100 0 1 ECU_ADDRESS 0x24027020 SYMBOL_LINK "panther_can2_in" 56 /end MEASUREMENT
/begin MEASUREMENT panther_can2_in.asw_in_can2_0x183_rx_status "CAN2 Receive Status" UBYTE NO_COMPU_METHOD 1 100 0 1 ECU_ADDRESS 0x2402701f SYMBOL_LINK "panther_can2_in" 55 /end MEASUREMENT
/begin MEASUREMENT panther_can2_in.asw_in_can2_0x184_ABL_RR1_ActivationLevelStatus "CAN2 receive signal 2" UBYTE NO_COMPU_METHOD 1 100 0 255 ECU_ADDRESS 0x2402701d SYMBOL_LINK "panther_can2_in" 53 /end MEASUREMENT
/begin MEASUREMENT panther_can2_in.asw_in_can2_0x184_ABL_RR1_ActivationPhase "CAN2 receive signal 3" UBYTE NO_COMPU_METHOD 1 100 0 255 ECU_ADDRESS 0x2402701e SYMBOL_LINK "panther_can2_in" 54 /end MEASUREMENT
/begin MEASUREMENT panther_can2_in.asw_in_can2_0x184_ABL_RR1_S0SensorStatus_bool "CAN2 receive signal 1" UBYTE NO_COMPU_METHOD 1 100 0 1 ECU_ADDRESS 0x2402701c SYMBOL_LINK "panther_can2_in" 52 /end MEASUREMENT
/begin MEASUREMENT panther_can2_in.asw_in_can2_0x184_rx_status "CAN2 Receive Status" UBYTE NO_COMPU_METHOD 1 100 0 1 ECU_ADDRESS 0x2402701b SYMBOL_LINK "panther_can2_in" 51 /end MEASUREMENT
/begin MEASUREMENT panther_can2_in.asw_in_can2_0x188_ACR_FL_SpoolFasterClutch "CAN2 receive signal 3" UBYTE NO_COMPU_METHOD 1 100 0 255 ECU_ADDRESS 0x2402701a SYMBOL_LINK "panther_can2_in" 50 /end MEASUREMENT
/begin MEASUREMENT panther_can2_in.asw_in_can2_0x188_rx_status "CAN2 Receive Status" UBYTE NO_COMPU_METHOD 1 100 0 1 ECU_ADDRESS 0x24027017 SYMBOL_LINK "panther_can2_in" 47 /end MEASUREMENT
/begin MEASUREMENT panther_can2_in.asw_in_can2_0x189_ACR_FR_SpoolFasterClutch "CAN2 receive signal 3" UBYTE NO_COMPU_METHOD 1 100 0 255 ECU_ADDRESS 0x24027016 SYMBOL_LINK "panther_can2_in" 46 /end MEASUREMENT
/begin MEASUREMENT panther_can2_in.asw_in_can2_0x189_rx_status "CAN2 Receive Status" UBYTE NO_COMPU_METHOD 1 100 0 1 ECU_ADDRESS 0x24027013 SYMBOL_LINK "panther_can2_in" 43 /end MEASUREMENT
/begin MEASUREMENT panther_can2_in.asw_in_can2_0x18A_ACR_RL1_SpoolFasterClutch "CAN2 receive signal 3" UBYTE NO_COMPU_METHOD 1 100 0 255 ECU_ADDRESS 0x24027012 SYMBOL_LINK "panther_can2_in" 42 /end MEASUREMENT
/begin MEASUREMENT panther_can2_in.asw_in_can2_0x18A_rx_status "CAN2 Receive Status" UBYTE NO_COMPU_METHOD 1 100 0 1 ECU_ADDRESS 0x2402700f SYMBOL_LINK "panther_can2_in" 39 /end MEASUREMENT
/begin MEASUREMENT panther_can2_in.asw_in_can2_0x18B_ACR_RL2_SpoolFasterClutch "CAN2 receive signal 3" UBYTE NO_COMPU_METHOD 1 100 0 255 ECU_ADDRESS 0x2402700e SYMBOL_LINK "panther_can2_in" 38 /end MEASUREMENT
/begin MEASUREMENT panther_can2_in.asw_in_can2_0x18B_rx_status "CAN2 Receive Status" UBYTE NO_COMPU_METHOD 1 100 0 1 ECU_ADDRESS 0x2402700b SYMBOL_LINK "panther_can2_in" 35 /end MEASUREMENT
/begin MEASUREMENT panther_can2_in.asw_in_can2_0x18C_ACR_RR1_SpoolFasterClutch "CAN2 receive signal 3" UBYTE NO_COMPU_METHOD 1 100 0 255 ECU_ADDRESS 0x2402700a SYMBOL_LINK "panther_can2_in" 34 /end MEASUREMENT
/begin MEASUREMENT panther_can2_in.asw_in_can2_0x18C_rx_status "CAN2 Receive Status" UBYTE NO_COMPU_METHOD 1 100 0 1 ECU_ADDRESS 0x24027007 SYMBOL_LINK "panther_can2_in" 31 /end MEASUREMENT
/begin MEASUREMENT panther_can2_in.asw_in_can2_0x190_rx_status "CAN2 Receive Status" UBYTE NO_COMPU_METHOD 1 100 0 1 ECU_ADDRESS 0x24027001 SYMBOL_LINK "panther_can2_in" 25 /end MEASUREMENT
/begin MEASUREMENT panther_can2_in.asw_in_can2_0x190_WMS_FL_SensorStatus "CAN2 receive signal 3" UBYTE NO_COMPU_METHOD 1 100 0 7 ECU_ADDRESS 0x24027035 SYMBOL_LINK "panther_can2_in" 77 /end MEASUREMENT
/begin MEASUREMENT panther_can2_in.asw_in_can2_0x191_rx_status "CAN2 Receive Status" UBYTE NO_COMPU_METHOD 1 100 0 1 ECU_ADDRESS 0x24026ffb SYMBOL_LINK "panther_can2_in" 19 /end MEASUREMENT
/begin MEASUREMENT panther_can2_in.asw_in_can2_0x192_rx_status "CAN2 Receive Status" UBYTE NO_COMPU_METHOD 1 100 0 1 ECU_ADDRESS 0x24026ff5 SYMBOL_LINK "panther_can2_in" 13 /end MEASUREMENT
/begin MEASUREMENT panther_can2_in.asw_in_can2_0x193_rx_status "CAN2 Receive Status" UBYTE NO_COMPU_METHOD 1 100 0 1 ECU_ADDRESS 0x24026fef SYMBOL_LINK "panther_can2_in" 7 /end MEASUREMENT
/begin MEASUREMENT panther_can2_in.asw_in_can2_0x194_rx_status "CAN2 Receive Status" UBYTE NO_COMPU_METHOD 1 100 0 1 ECU_ADDRESS 0x24026fe8 SYMBOL_LINK "panther_can2_in" 0 /end MEASUREMENT
/begin MEASUREMENT panther_can2_in.asw_in_can2_0x199_rx_status "CAN2 Receive Status" UBYTE NO_COMPU_METHOD 1 100 0 1 ECU_ADDRESS 0x2402702f SYMBOL_LINK "panther_can2_in" 71 /end MEASUREMENT
/begin MEASUREMENT panther_can2_in.asw_in_can2_0xC1_rx_status "CAN2 Receive Status" UBYTE NO_COMPU_METHOD 1 100 0 1 ECU_ADDRESS 0x24027036 SYMBOL_LINK "panther_can2_in" 78 /end MEASUREMENT
/begin MEASUREMENT panther_can2_in.asw_in_can2_0xC2_rx_status "CAN2 Receive Status" UBYTE NO_COMPU_METHOD 1 100 0 1 ECU_ADDRESS 0x2402703f SYMBOL_LINK "panther_can2_in" 87 /end MEASUREMENT
/begin MEASUREMENT panther_can2_in.asw_in_can2_0xC3_rx_status "CAN2 Receive Status" UBYTE NO_COMPU_METHOD 1 100 0 1 ECU_ADDRESS 0x24027048 SYMBOL_LINK "panther_can2_in" 96 /end MEASUREMENT
/begin MEASUREMENT panther_can2_in.asw_in_can2_0xC4_rx_status "CAN2 Receive Status" UBYTE NO_COMPU_METHOD 1 100 0 1 ECU_ADDRESS 0x24027051 SYMBOL_LINK "panther_can2_in" 105 /end MEASUREMENT
/begin MEASUREMENT panther_can2_out.asw_out_can2_0x81_HMI_SILG_ActivationRequest "CAN2 transmit signal 1" UBYTE NO_COMPU_METHOD 1 100 0 3 ECU_ADDRESS 0x24026fe7 SYMBOL_LINK "panther_can2_out" 63 /end MEASUREMENT
/begin MEASUREMENT panther_can2_out.asw_out_can2_0x81_tx_status "CAN2 Transmit Status" UBYTE NO_COMPU_METHOD 1 100 0 1 ECU_ADDRESS 0x24026fe6 SYMBOL_LINK "panther_can2_out" 62 /end MEASUREMENT
/begin MEASUREMENT panther_can3_in.asw_in_can3_0x150_Algo_Status_RR "CAN3 receive signal 9" UBYTE NO_COMPU_METHOD 1 100 0 1 ECU_ADDRESS 0x24026f51 SYMBOL_LINK "panther_can3_in" 9 /end MEASUREMENT
/begin MEASUREMENT panther_can3_in.asw_in_can3_0x150_Invalid_Input_Sensor "CAN3 receive signal 16" UBYTE NO_COMPU_METHOD 1 100 0 1 ECU_ADDRESS 0x24026f58 SYMBOL_LINK "panther_can3_in" 16 /end MEASUREMENT
/begin MEASUREMENT panther_can3_in.asw_in_can3_0x150_Invalid_Input_Sensor_and_Vehicle "CAN3 receive signal 17" UBYTE NO_COMPU_METHOD 1 100 0 1 ECU_ADDRESS 0x24026f59 SYMBOL_LINK "panther_can3_in" 17 /end MEASUREMENT
/begin MEASUREMENT panther_can3_in.asw_in_can3_0x150_Invalid_Input_Vehicle "CAN3 receive signal 18" UBYTE NO_COMPU_METHOD 1 100 0 1 ECU_ADDRESS 0x24026f5a SYMBOL_LINK "panther_can3_in" 18 /end MEASUREMENT
/begin MEASUREMENT panther_can3_in.asw_in_can3_0x150_Lock_Status_RR "CAN3 receive signal 6" UBYTE NO_COMPU_METHOD 1 100 0 1 ECU_ADDRESS 0x24026f4e SYMBOL_LINK "panther_can3_in" 6 /end MEASUREMENT
/begin MEASUREMENT panther_can3_in.asw_in_can3_0x150_Locking_Cause_HG_Ball_Disp "CAN3 receive signal 13" UBYTE NO_COMPU_METHOD 1 100 0 1 ECU_ADDRESS 0x24026f55 SYMBOL_LINK "panther_can3_in" 13 /end MEASUREMENT
/begin MEASUREMENT panther_can3_in.asw_in_can3_0x150_Locking_Cause_HG_Ball_Velocity "CAN3 receive signal 12" UBYTE NO_COMPU_METHOD 1 100 0 1 ECU_ADDRESS 0x24026f54 SYMBOL_LINK "panther_can3_in" 12 /end MEASUREMENT
/begin MEASUREMENT panther_can3_in.asw_in_can3_0x150_Locking_Cause_LG_Ball_Disp "CAN3 receive signal 3" UBYTE NO_COMPU_METHOD 1 100 0 1 ECU_ADDRESS 0x24026f4b SYMBOL_LINK "panther_can3_in" 3 /end MEASUREMENT
/begin MEASUREMENT panther_can3_in.asw_in_can3_0x150_Locking_Cause_LG_Ball_Velocity "CAN3 receive signal 11" UBYTE NO_COMPU_METHOD 1 100 0 1 ECU_ADDRESS 0x24026f53 SYMBOL_LINK "panther_can3_in" 11 /end MEASUREMENT
/begin MEASUREMENT panther_can3_in.asw_in_can3_0x150_Locking_Cause_Prio_Ext_Lock "CAN3 receive signal 10" UBYTE NO_COMPU_METHOD 1 100 0 1 ECU_ADDRESS 0x24026f52 SYMBOL_LINK "panther_can3_in" 10 /end MEASUREMENT
/begin MEASUREMENT panther_can3_in.asw_in_can3_0x150_Locking_Cause_Saturation_lock "CAN3 receive signal 15" UBYTE NO_COMPU_METHOD 1 100 0 1 ECU_ADDRESS 0x24026f57 SYMBOL_LINK "panther_can3_in" 15 /end MEASUREMENT
/begin MEASUREMENT panther_can3_in.asw_in_can3_0x150_Locking_Cause_Z_Axis_Lock "CAN3 receive signal 14" SBYTE NO_COMPU_METHOD 1 100 0 0 ECU_ADDRESS 0x24026f56 SYMBOL_LINK "panther_can3_in" 14 /end MEASUREMENT
/begin MEASUREMENT panther_can3_in.asw_in_can3_0x150_Normalmode "CAN3 receive signal 19" UBYTE NO_COMPU_METHOD 1 100 0 1 ECU_ADDRESS 0x24026f5b SYMBOL_LINK "panther_can3_in" 19 /end MEASUREMENT
/begin MEASUREMENT panther_can3_in.asw_in_can3_0x150_rx_status "CAN3 Receive Status" UBYTE NO_COMPU_METHOD 1 100 0 1 ECU_ADDRESS 0x24026f48 SYMBOL_LINK "panther_can3_in" 0 /end MEASUREMENT
/begin MEASUREMENT panther_can3_in.asw_in_can3_0x160_ECU_Status_Act_4 "CAN3 receive signal 4" SBYTE NO_COMPU_METHOD 1 100 0 8 ECU_ADDRESS 0x24026f60 SYMBOL_LINK "panther_can3_in" 24 /end MEASUREMENT
/begin MEASUREMENT panther_can3_in.asw_in_can3_0x160_rx_status "CAN3 Receive Status" UBYTE NO_COMPU_METHOD 1 100 0 1 ECU_ADDRESS 0x24026f5c SYMBOL_LINK "panther_can3_in" 20 /end MEASUREMENT
/begin MEASUREMENT panther_can3_out.asw_out_can3_0x100_Ext_Trigger_RR "CAN3 transmit signal 10" SBYTE NO_COMPU_METHOD 1 100 0 0 ECU_ADDRESS 0x24026e06 SYMBOL_LINK "panther_can3_out" 10 /end MEASUREMENT
/begin MEASUREMENT panther_can6_in.asw_in_can6_0x81_rx_status "CAN6 Receive Status" UBYTE NO_COMPU_METHOD 1 100 0 1 ECU_ADDRESS 0x24026e9b SYMBOL_LINK "panther_can6_in" 131 /end MEASUREMENT
/begin MEASUREMENT panther_can6_in.asw_in_can6_0xB3_OMS_FL_OccupantGender "CAN6 receive signal 9" UBYTE NO_COMPU_METHOD 1 100 0 3 ECU_ADDRESS 0x24026e73 SYMBOL_LINK "panther_can6_in" 91 /end MEASUREMENT
/begin MEASUREMENT panther_can6_in.asw_in_can6_0xB3_OMS_FL_SeatbeltMisuse_bool "CAN6 receive signal 8" UBYTE NO_COMPU_METHOD 1 100 0 1 ECU_ADDRESS 0x24026e72 SYMBOL_LINK "panther_can6_in" 90 /end MEASUREMENT
/begin MEASUREMENT panther_can6_in.asw_in_can6_0xB4_OMS_FR_ChildSeatDetected_bool "CAN6 receive signal 7" UBYTE NO_COMPU_METHOD 1 100 0 1 ECU_ADDRESS 0x24026e64 SYMBOL_LINK "panther_can6_in" 76 /end MEASUREMENT
/begin MEASUREMENT panther_can6_in.asw_in_can6_0xB4_OMS_FR_OccupantGender "CAN6 receive signal 9" UBYTE NO_COMPU_METHOD 1 100 0 3 ECU_ADDRESS 0x24026e66 SYMBOL_LINK "panther_can6_in" 78 /end MEASUREMENT
/begin MEASUREMENT panther_can6_in.asw_in_can6_0xB4_OMS_FR_SeatbeltMisuse_bool "CAN6 receive signal 8" UBYTE NO_COMPU_METHOD 1 100 0 1 ECU_ADDRESS 0x24026e65 SYMBOL_LINK "panther_can6_in" 77 /end MEASUREMENT
/begin MEASUREMENT panther_can6_in.asw_in_can6_0xB5_OMS_RL1_ChildSeatDetected_bool "CAN6 receive signal 3" UBYTE NO_COMPU_METHOD 1 100 0 1 ECU_ADDRESS 0x24026e92 SYMBOL_LINK "panther_can6_in" 122 /end MEASUREMENT
/begin MEASUREMENT panther_can6_in.asw_in_can6_0xB5_OMS_RL1_OccupantGender "CAN6 receive signal 4" UBYTE NO_COMPU_METHOD 1 100 0 3 ECU_ADDRESS 0x24026e93 SYMBOL_LINK "panther_can6_in" 123 /end MEASUREMENT
/begin MEASUREMENT panther_can6_in.asw_in_can6_0xB5_OMS_RL1_SeatbeltMisuse_bool "CAN6 receive signal 10" UBYTE NO_COMPU_METHOD 1 100 0 1 ECU_ADDRESS 0x24026e99 SYMBOL_LINK "panther_can6_in" 129 /end MEASUREMENT
/begin MEASUREMENT panther_can6_in.asw_in_can6_0xB6_OMS_RL2_ChildSeatDetected_bool "CAN6 receive signal 1" UBYTE NO_COMPU_METHOD 1 100 0 1 ECU_ADDRESS 0x24026e76 SYMBOL_LINK "panther_can6_in" 94 /end MEASUREMENT
/begin MEASUREMENT panther_can6_in.asw_in_can6_0xB6_OMS_RL2_OccupantGender "CAN6 receive signal 3" UBYTE NO_COMPU_METHOD 1 100 0 3 ECU_ADDRESS 0x24026e78 SYMBOL_LINK "panther_can6_in" 96 /end MEASUREMENT
/begin MEASUREMENT panther_can6_in.asw_in_can6_0xB6_OMS_RL2_SeatbeltMisuse_bool "CAN6 receive signal 10" UBYTE NO_COMPU_METHOD 1 100 0 1 ECU_ADDRESS 0x24026e80 SYMBOL_LINK "panther_can6_in" 104 /end MEASUREMENT
/begin MEASUREMENT panther_can6_in.asw_in_can6_0xB7_OMS_RR1_ChildSeatDetected_bool "CAN6 receive signal 1" UBYTE NO_COMPU_METHOD 1 100 0 1 ECU_ADDRESS 0x24026e82 SYMBOL_LINK "panther_can6_in" 106 /end MEASUREMENT
/begin MEASUREMENT panther_can6_in.asw_in_can6_0xB7_OMS_RR1_OccupantGender "CAN6 receive signal 3" UBYTE NO_COMPU_METHOD 1 100 0 3 ECU_ADDRESS 0x24026e84 SYMBOL_LINK "panther_can6_in" 108 /end MEASUREMENT
/begin MEASUREMENT panther_can6_in.asw_in_can6_0xB7_OMS_RR1_SeatbeltMisuse_bool "CAN6 receive signal 10" UBYTE NO_COMPU_METHOD 1 100 0 1 ECU_ADDRESS 0x24026e8c SYMBOL_LINK "panther_can6_in" 116 /end MEASUREMENT
/begin MEASUREMENT panther_can6_out.asw_out_can6_0x190_WMS_FL_SensorStatus "CAN6 transmit signal 3" UBYTE NO_COMPU_METHOD 1 100 0 7 ECU_ADDRESS 0x24026f10 SYMBOL_LINK "panther_can6_out" 112 /end MEASUREMENT
/begin MEASUREMENT panther_can6_out.asw_out_can6_0x198_ELK_FL_ActuatorStatus "CAN6 transmit signal 6" UBYTE NO_COMPU_METHOD 1 100 0 3 ECU_ADDRESS 0x24026f35 SYMBOL_LINK "panther_can6_out" 149 /end MEASUREMENT
/begin MEASUREMENT panther_can6_out.asw_out_can6_0x198_ELK_FR_ActuatorStatus "CAN6 transmit signal 7" UBYTE NO_COMPU_METHOD 1 100 0 3 ECU_ADDRESS 0x24026f36 SYMBOL_LINK "panther_can6_out" 150 /end MEASUREMENT
/begin MEASUREMENT panther_can6_out.asw_out_can6_0x200_COM_Status_PumaFLCan "CAN6 transmit signal 1" UBYTE NO_COMPU_METHOD 1 100 0 1 ECU_ADDRESS 0x24026f3b SYMBOL_LINK "panther_can6_out" 155 /end MEASUREMENT
/begin MEASUREMENT panther_can6_out.asw_out_can6_0xBD_SPS_FR_FootRestPosition "CAN6 transmit signal 4" UWORD NO_COMPU_METHOD 1 100 0 4095 ECU_ADDRESS 0x24026eea SYMBOL_LINK "panther_can6_out" 74 /end MEASUREMENT
/begin MEASUREMENT panther_can6_out.asw_out_can6_0xBD_SPS_FR_HeadRestPosition "CAN6 transmit signal 5" UWORD NO_COMPU_METHOD 1 100 0 4095 ECU_ADDRESS 0x24026eec SYMBOL_LINK "panther_can6_out" 76 /end MEASUREMENT
/begin MEASUREMENT panther_can6_out.asw_out_can6_0xBD_SPS_FR_SeatBackRestPosition "CAN6 transmit signal 3" UWORD NO_COMPU_METHOD 1 100 0 4095 ECU_ADDRESS 0x24026ee8 SYMBOL_LINK "panther_can6_out" 72 /end MEASUREMENT
/begin MEASUREMENT panther_can6_out.asw_out_can6_0xBD_SPS_FR_SeatDirectionX "CAN6 transmit signal 1" UWORD NO_COMPU_METHOD 1 100 0 4095 ECU_ADDRESS 0x24026ee4 SYMBOL_LINK "panther_can6_out" 68 /end MEASUREMENT
/begin MEASUREMENT panther_can6_out.asw_out_can6_0xBD_SPS_FR_SeatDirectionZ "CAN6 transmit signal 2" UWORD NO_COMPU_METHOD 1 100 0 4095 ECU_ADDRESS 0x24026ee6 SYMBOL_LINK "panther_can6_out" 70 /end MEASUREMENT
/begin MEASUREMENT panther_can6_out.asw_out_can6_0xBD_tx_status "CAN6 Transmit Status" UBYTE NO_COMPU_METHOD 1 100 0 1 ECU_ADDRESS 0x24026ee3 SYMBOL_LINK "panther_can6_out" 67 /end MEASUREMENT
/begin MEASUREMENT panther_can6_out.asw_out_can6_0xBE_SPS_FR_FootRestPosition "CAN6 transmit signal 4" UWORD NO_COMPU_METHOD 1 100 0 4095 ECU_ADDRESS 0x24026ef6 SYMBOL_LINK "panther_can6_out" 86 /end MEASUREMENT
/begin MEASUREMENT panther_can6_out.asw_out_can6_0xBE_SPS_FR_HeadRestPosition "CAN6 transmit signal 5" UWORD NO_COMPU_METHOD 1 100 0 4095 ECU_ADDRESS 0x24026ef8 SYMBOL_LINK "panther_can6_out" 88 /end MEASUREMENT
/begin MEASUREMENT panther_can6_out.asw_out_can6_0xBE_SPS_FR_SeatBackRestPosition "CAN6 transmit signal 3" UWORD NO_COMPU_METHOD 1 100 0 4095 ECU_ADDRESS 0x24026ef4 SYMBOL_LINK "panther_can6_out" 84 /end MEASUREMENT
/begin MEASUREMENT panther_can6_out.asw_out_can6_0xBE_SPS_FR_SeatDirectionX "CAN6 transmit signal 1" UWORD NO_COMPU_METHOD 1 100 0 4095 ECU_ADDRESS 0x24026ef0 SYMBOL_LINK "panther_can6_out" 80 /end MEASUREMENT
/begin MEASUREMENT panther_can6_out.asw_out_can6_0xBE_SPS_FR_SeatDirectionZ "CAN6 transmit signal 2" UWORD NO_COMPU_METHOD 1 100 0 4095 ECU_ADDRESS 0x24026ef2 SYMBOL_LINK "panther_can6_out" 82 /end MEASUREMENT
/begin MEASUREMENT panther_can6_out.asw_out_can6_0xBE_tx_status "CAN6 Transmit Status" UBYTE NO_COMPU_METHOD 1 100 0 1 ECU_ADDRESS 0x24026eee SYMBOL_LINK "panther_can6_out" 78 /end MEASUREMENT
/begin MEASUREMENT panther_can6_out.asw_out_can6_0xBF_SPS_FR_FootRestPosition "CAN6 transmit signal 4" UWORD NO_COMPU_METHOD 1 100 0 4095 ECU_ADDRESS 0x24026f02 SYMBOL_LINK "panther_can6_out" 98 /end MEASUREMENT
/begin MEASUREMENT panther_can6_out.asw_out_can6_0xBF_SPS_FR_HeadRestPosition "CAN6 transmit signal 5" UWORD NO_COMPU_METHOD 1 100 0 4095 ECU_ADDRESS 0x24026f04 SYMBOL_LINK "panther_can6_out" 100 /end MEASUREMENT
/begin MEASUREMENT panther_can6_out.asw_out_can6_0xBF_SPS_FR_SeatBackRestPosition "CAN6 transmit signal 3" UWORD NO_COMPU_METHOD 1 100 0 4095 ECU_ADDRESS 0x24026f00 SYMBOL_LINK "panther_can6_out" 96 /end MEASUREMENT
/begin MEASUREMENT panther_can6_out.asw_out_can6_0xBF_SPS_FR_SeatDirectionX "CAN6 transmit signal 1" UWORD NO_COMPU_METHOD 1 100 0 4095 ECU_ADDRESS 0x24026efc SYMBOL_LINK "panther_can6_out" 92 /end MEASUREMENT
/begin MEASUREMENT panther_can6_out.asw_out_can6_0xBF_SPS_FR_SeatDirectionZ "CAN6 transmit signal 2" UWORD NO_COMPU_METHOD 1 100 0 4095 ECU_ADDRESS 0x24026efe SYMBOL_LINK "panther_can6_out" 94 /end MEASUREMENT
/begin MEASUREMENT panther_can6_out.asw_out_can6_0xBF_tx_status "CAN6 Transmit Status" UBYTE NO_COMPU_METHOD 1 100 0 1 ECU_ADDRESS 0x24026efa SYMBOL_LINK "panther_can6_out" 90 /end MEASUREMENT
/begin MEASUREMENT panther_can6_out.asw_out_can6_0xC1_tx_status "CAN6 Transmit Status" UBYTE NO_COMPU_METHOD 1 100 0 1 ECU_ADDRESS 0x24026f11 SYMBOL_LINK "panther_can6_out" 113 /end MEASUREMENT
/begin MEASUREMENT panther_memory_in.asw_in_memory_read_valid_bool "Memory read valid flag" UBYTE NO_COMPU_METHOD 1 100 0 1 ECU_ADDRESS 0x2401621c SYMBOL_LINK "panther_memory_in" 0 /end MEASUREMENT
/begin MEASUREMENT panther_memory_in.asw_in_memory_write_ready_bool "Memory write signals ready flag" UBYTE NO_COMPU_METHOD 1 100 0 1 ECU_ADDRESS 0x2401621d SYMBOL_LINK "panther_memory_in" 1 /end MEASUREMENT
/begin MEASUREMENT SM_BuckleSignal_FL_on "1 - buckled   0 - unbuckled" UBYTE NO_COMPU_METHOD 1 100 0 1 ECU_ADDRESS 0x24026da0 /end MEASUREMENT
/begin MEASUREMENT SM_BuckleSignal_FR_on "1 - buckled   0 -  unbuckled" UBYTE NO_COMPU_METHOD 1 100 0 1 ECU_ADDRESS 0x24026d98 /end MEASUREMENT
/begin MEASUREMENT SM_BuckleSignal_RL_on "1 - buckled   0 - unbuckled" UBYTE NO_COMPU_METHOD 1 100 0 1 ECU_ADDRESS 0x24026d89 /end MEASUREMENT
/begin MEASUREMENT SM_BuckleSignal_RR_on "1 - buckled   0 - unbuckled" UBYTE NO_COMPU_METHOD 1 100 0 1 ECU_ADDRESS 0x24026db8 /end MEASUREMENT
/begin MEASUREMENT SVSMA_EBL1_EBLT_BrakeTask_FL_Enable "" UBYTE NO_COMPU_METHOD 1 100 0 255 ECU_ADDRESS 0x24026d8f /end MEASUREMENT
/begin MEASUREMENT SVSMA_EBL1_EBLT_BrakeTask_FR_Enable "" UBYTE NO_COMPU_METHOD 1 100 0 255 ECU_ADDRESS 0x24026df3 /end MEASUREMENT
/begin MEASUREMENT SVSMA_EBL1_EBLT_BrakeTask_RL1_Enable "" UBYTE NO_COMPU_METHOD 1 100 0 255 ECU_ADDRESS 0x24026da3 /end MEASUREMENT
/begin MEASUREMENT SVSMA_EBL1_EBLT_BrakeTask_RL2_Enable "" UBYTE NO_COMPU_METHOD 1 100 0 255 ECU_ADDRESS 0x24026dc5 /end MEASUREMENT
/begin MEASUREMENT SVSMA_EBL1_EBLT_BrakeTask_RR1_Enable "" UBYTE NO_COMPU_METHOD 1 100 0 255 ECU_ADDRESS 0x24026d97 /end MEASUREMENT
/begin MEASUREMENT SVSMA_EBL1_EBLT_CritDrivTask_FL_Enable "" UBYTE NO_COMPU_METHOD 1 100 0 255 ECU_ADDRESS 0x24026def /end MEASUREMENT
/begin MEASUREMENT SVSMA_EBL1_EBLT_CritDrivTask_FR_Enable "" UBYTE NO_COMPU_METHOD 1 100 0 255 ECU_ADDRESS 0x24026df2 /end MEASUREMENT
/begin MEASUREMENT SVSMA_EBL1_EBLT_CritDrivTask_RL1_Enable "" UBYTE NO_COMPU_METHOD 1 100 0 255 ECU_ADDRESS 0x24026db9 /end MEASUREMENT
/begin MEASUREMENT SVSMA_EBL1_EBLT_CritDrivTask_RL2_Enable "" UBYTE NO_COMPU_METHOD 1 100 0 255 ECU_ADDRESS 0x24026d91 /end MEASUREMENT
/begin MEASUREMENT SVSMA_EBL1_EBLT_CritDrivTask_RR1_Enable "" UBYTE NO_COMPU_METHOD 1 100 0 255 ECU_ADDRESS 0x24026dd4 /end MEASUREMENT
/begin MEASUREMENT SVSMA_EBL1_EBLT_DA_FL_Enable "" UWORD NO_COMPU_METHOD 1 100 0 65535 ECU_ADDRESS 0x24026dca /end MEASUREMENT
/begin MEASUREMENT SVSMA_EBL1_EBLT_DA_FR_Enable "" UWORD NO_COMPU_METHOD 1 100 0 65535 ECU_ADDRESS 0x24026daa /end MEASUREMENT
/begin MEASUREMENT SVSMA_EBL1_EBLT_DA_RL1_Enable "" UWORD NO_COMPU_METHOD 1 100 0 65535 ECU_ADDRESS 0x24026dd8 /end MEASUREMENT
/begin MEASUREMENT SVSMA_EBL1_EBLT_DA_RL2_Enable "" UWORD NO_COMPU_METHOD 1 100 0 65535 ECU_ADDRESS 0x24026dd2 /end MEASUREMENT
/begin MEASUREMENT SVSMA_EBL1_EBLT_DA_RR1_Enable "" UWORD NO_COMPU_METHOD 1 100 0 65535 ECU_ADDRESS 0x24026d9e /end MEASUREMENT
/begin MEASUREMENT SVSMA_EBL1_EBLT_ReleaseTask_FL_Enable "" UBYTE NO_COMPU_METHOD 1 100 0 255 ECU_ADDRESS 0x24026da6 /end MEASUREMENT
/begin MEASUREMENT SVSMA_EBL1_EBLT_ReleaseTask_FR_Enable "" UBYTE NO_COMPU_METHOD 1 100 0 255 ECU_ADDRESS 0x24026d83 /end MEASUREMENT
/begin MEASUREMENT SVSMA_EBL1_EBLT_ReleaseTask_RL1_Enable "" UBYTE NO_COMPU_METHOD 1 100 0 255 ECU_ADDRESS 0x24026dc3 /end MEASUREMENT
/begin MEASUREMENT SVSMA_EBL1_EBLT_ReleaseTask_RL2_Enable "" UBYTE NO_COMPU_METHOD 1 100 0 255 ECU_ADDRESS 0x24026d8b /end MEASUREMENT
/begin MEASUREMENT SVSMA_EBL1_EBLT_ReleaseTask_RR1_Enable "" UBYTE NO_COMPU_METHOD 1 100 0 255 ECU_ADDRESS 0x24026dae /end MEASUREMENT
/begin MEASUREMENT SVSMA_EBL1_EBLT_SLR_FL_Enable "" UBYTE NO_COMPU_METHOD 1 100 0 255 ECU_ADDRESS 0x24026da8 /end MEASUREMENT
/begin MEASUREMENT SVSMA_EBL1_EBLT_SLR_FR_Enable "" UBYTE NO_COMPU_METHOD 1 100 0 255 ECU_ADDRESS 0x24026da2 /end MEASUREMENT
/begin MEASUREMENT SVSMA_EBL1_EBLT_SLR_RL1_Enable "" UBYTE NO_COMPU_METHOD 1 100 0 255 ECU_ADDRESS 0x24026dce /end MEASUREMENT
/begin MEASUREMENT SVSMA_EBL1_EBLT_SLR_RL2_Enable "" UBYTE NO_COMPU_METHOD 1 100 0 255 ECU_ADDRESS 0x24026dbb /end MEASUREMENT
/begin MEASUREMENT SVSMA_EBL1_EBLT_SLR_RR1_Enable "" UBYTE NO_COMPU_METHOD 1 100 0 255 ECU_ADDRESS 0x24026de9 /end MEASUREMENT
/begin MEASUREMENT SVSMA_HPW5_Relational_Operator1 "" UBYTE NO_COMPU_METHOD 1 100 0 1 ECU_ADDRESS 0x24027115 /end MEASUREMENT
/begin MEASUREMENT SVSMA_HPW5_Relational_Operator2 "" UBYTE NO_COMPU_METHOD 1 100 0 1 ECU_ADDRESS 0x24027114 /end MEASUREMENT
/begin MEASUREMENT SVSMA_PRIO1_EBLT_BrakeTask_FL_Enable "" UBYTE NO_COMPU_METHOD 1 100 0 255 ECU_ADDRESS 0x24026dc8 /end MEASUREMENT
/begin MEASUREMENT SVSMA_PRIO1_EBLT_BrakeTask_FR_Enable "" UBYTE NO_COMPU_METHOD 1 100 0 255 ECU_ADDRESS 0x24026dc4 /end MEASUREMENT
/begin MEASUREMENT SVSMA_PRIO1_EBLT_BrakeTask_RL1_Enable "" UBYTE NO_COMPU_METHOD 1 100 0 255 ECU_ADDRESS 0x24026d90 /end MEASUREMENT
/begin MEASUREMENT SVSMA_PRIO1_EBLT_BrakeTask_RL2_Enable "" UBYTE NO_COMPU_METHOD 1 100 0 255 ECU_ADDRESS 0x24026ddf /end MEASUREMENT
/begin MEASUREMENT SVSMA_PRIO1_EBLT_BrakeTask_RR1_Enable "" UBYTE NO_COMPU_METHOD 1 100 0 255 ECU_ADDRESS 0x24026dba /end MEASUREMENT
/begin MEASUREMENT SVSMA_PRIO1_EBLT_CritDrivTask_FL_Enable "" UBYTE NO_COMPU_METHOD 1 100 0 255 ECU_ADDRESS 0x24026d8c /end MEASUREMENT
/begin MEASUREMENT SVSMA_PRIO1_EBLT_CritDrivTask_FR_Enable "" UBYTE NO_COMPU_METHOD 1 100 0 255 ECU_ADDRESS 0x24026da1 /end MEASUREMENT
/begin MEASUREMENT SVSMA_PRIO1_EBLT_CritDrivTask_RL1_Enable "" UBYTE NO_COMPU_METHOD 1 100 0 255 ECU_ADDRESS 0x24026dcd /end MEASUREMENT
/begin MEASUREMENT SVSMA_PRIO1_EBLT_CritDrivTask_RL2_Enable "" UBYTE NO_COMPU_METHOD 1 100 0 255 ECU_ADDRESS 0x24026dc1 /end MEASUREMENT
/begin MEASUREMENT SVSMA_PRIO1_EBLT_CritDrivTask_RR1_Enable "" UBYTE NO_COMPU_METHOD 1 100 0 255 ECU_ADDRESS 0x24026d84 /end MEASUREMENT
/begin MEASUREMENT SVSMA_PRIO1_EBLT_DA_FL_Enable "" UWORD NO_COMPU_METHOD 1 100 0 65535 ECU_ADDRESS 0x24026d86 /end MEASUREMENT
/begin MEASUREMENT SVSMA_PRIO1_EBLT_DA_FR_Enable "" UWORD NO_COMPU_METHOD 1 100 0 65535 ECU_ADDRESS 0x24026d92 /end MEASUREMENT
/begin MEASUREMENT SVSMA_PRIO1_EBLT_DA_RL1_Enable "" UWORD NO_COMPU_METHOD 1 100 0 65535 ECU_ADDRESS 0x24026dac /end MEASUREMENT
/begin MEASUREMENT SVSMA_PRIO1_EBLT_DA_RL2_Enable "" UWORD NO_COMPU_METHOD 1 100 0 65535 ECU_ADDRESS 0x24026ddc /end MEASUREMENT
/begin MEASUREMENT SVSMA_PRIO1_EBLT_DA_RR1_Enable "" UWORD NO_COMPU_METHOD 1 100 0 65535 ECU_ADDRESS 0x24026df0 /end MEASUREMENT
/begin MEASUREMENT SVSMA_PRIO1_EBLT_ReleaseTask_FL_Enable "" UBYTE NO_COMPU_METHOD 1 100 0 255 ECU_ADDRESS 0x24026d88 /end MEASUREMENT
/begin MEASUREMENT SVSMA_PRIO1_EBLT_ReleaseTask_FR_Enable "" UBYTE NO_COMPU_METHOD 1 100 0 255 ECU_ADDRESS 0x24026dde /end MEASUREMENT
/begin MEASUREMENT SVSMA_PRIO1_EBLT_ReleaseTask_RL1_Enable "" UBYTE NO_COMPU_METHOD 1 100 0 255 ECU_ADDRESS 0x24026d8a /end MEASUREMENT
/begin MEASUREMENT SVSMA_PRIO1_EBLT_ReleaseTask_RL2_Enable "" UBYTE NO_COMPU_METHOD 1 100 0 255 ECU_ADDRESS 0x24026db6 /end MEASUREMENT
/begin MEASUREMENT SVSMA_PRIO1_EBLT_ReleaseTask_RR1_Enable "" UBYTE NO_COMPU_METHOD 1 100 0 255 ECU_ADDRESS 0x24026dd5 /end MEASUREMENT
/begin MEASUREMENT SVSMA_PRIO1_EBLT_SLR_FL_Enable "" UBYTE NO_COMPU_METHOD 1 100 0 255 ECU_ADDRESS 0x24026dc0 /end MEASUREMENT
/begin MEASUREMENT SVSMA_PRIO1_EBLT_SLR_FR_Enable "" UBYTE NO_COMPU_METHOD 1 100 0 255 ECU_ADDRESS 0x24026db3 /end MEASUREMENT
/begin MEASUREMENT SVSMA_PRIO1_EBLT_SLR_RL1_Enable "" UBYTE NO_COMPU_METHOD 1 100 0 255 ECU_ADDRESS 0x24026d96 /end MEASUREMENT
/begin MEASUREMENT SVSMA_PRIO1_EBLT_SLR_RL2_Enable "" UBYTE NO_COMPU_METHOD 1 100 0 255 ECU_ADDRESS 0x24026dcc /end MEASUREMENT
/begin MEASUREMENT SVSMA_PRIO1_EBLT_SLR_RR1_Enable "" UBYTE NO_COMPU_METHOD 1 100 0 255 ECU_ADDRESS 0x24026df4 /end MEASUREMENT
/begin MEASUREMENT VS_BRK_bitfield "Brake bitfield:\nBit 0: Rapid Emergency Braking (REB) detected.\nBit 1: Progressive Emergency Braking (PEB) detected.\nBit 2: Emergency Panic Braking (EPB) detected.\nBit 3: High Vehicle Deceleration (HVD) detected.\nBit 4: Ice Braking (IB) detected.\nBit 5: Hydraulic Braking Assistent (HBA) detected.\nBit 6-7: Reserved." UBYTE NO_COMPU_METHOD 1 100 0 255 ECU_ADDRESS 0x24026de5 /end MEASUREMENT
/begin MEASUREMENT VS_CDT_bitfield_b "Critical Driving Bitfield.Bit 0: Precrash detected.Bit 1: Dynamic Support 1 detected.Bit 2: Dynamic Support 2 detected.Bit 3: ESP Off detected. ." UBYTE NO_COMPU_METHOD 1 100 0 255 ECU_ADDRESS 0x24026de2 /end MEASUREMENT
/begin MEASUREMENT VS_CDT_CriticalityIndex_w "Criticality Index based on one track model." UWORD EQ_LSB_0_1 1 100 0 6553.5 ECU_ADDRESS 0x2402705a /end MEASUREMENT
/begin MEASUREMENT VS_DA_bitfield_b "Haptic Warning Bitfield.Bit 0: Lane Change detected.Bit 1: Door Open detected.Bit 2: High Speed Detected ." UWORD NO_COMPU_METHOD 1 100 0 65535 ECU_ADDRESS 0x24026dc6 /end MEASUREMENT
/begin MEASUREMENT VS_EBLT_VehObsTask_Dr_2Row_Enable_b "" UBYTE NO_COMPU_METHOD 1 100 0 255 ECU_ADDRESS 0x24026de8 /end MEASUREMENT
/begin MEASUREMENT VS_EBLT_VehObsTask_Pa_2Row_Enable_b "" UBYTE NO_COMPU_METHOD 1 100 0 255 ECU_ADDRESS 0x24026d8d /end MEASUREMENT
/begin MEASUREMENT VS_EBLT_VehObsTask_Pa_Enable_b "" UBYTE NO_COMPU_METHOD 1 100 0 255 ECU_ADDRESS 0x24026dbd /end MEASUREMENT
/begin MEASUREMENT VS_EBLT_VehObsWarningTask_Dr_Enable_b "" UBYTE NO_COMPU_METHOD 1 100 0 255 ECU_ADDRESS 0x24026dea /end MEASUREMENT
/begin MEASUREMENT VS_EBLT_VehObsWarningTask_Pa_Enable_b "" UBYTE NO_COMPU_METHOD 1 100 0 255 ECU_ADDRESS 0x24026d99 /end MEASUREMENT
/begin MEASUREMENT VS_RLS_Ball_Stable_f "Kugel Stable: vectorial acceleration less than threshold.1 Stabel.0 Instable." UBYTE NO_COMPU_METHOD 1 100 0 1 ECU_ADDRESS 0x24026df5 /end MEASUREMENT
/begin MEASUREMENT VS_RLS_Rating_Stable_f "rated vehicle stable.1 Stabel. 0 Instable." UBYTE NO_COMPU_METHOD 1 100 0 1 ECU_ADDRESS 0x24026dbe /end MEASUREMENT
/begin MEASUREMENT VS_RLST_bitfield_b "Release Task Bitfield.Bit 0: Rating Stable (inverted).Bit 1: Kugel Stable (inverted).Bit 2: Release Stable." UBYTE NO_COMPU_METHOD 1 100 0 255 ECU_ADDRESS 0x24026dbc /end MEASUREMENT
/begin MEASUREMENT VS_SLR_Dr_2Row_bitfield "" UBYTE NO_COMPU_METHOD 1 100 0 255 ECU_ADDRESS 0x24026df6 /end MEASUREMENT
/begin MEASUREMENT VS_SLR_Dr_bitfield "" UBYTE NO_COMPU_METHOD 1 100 0 255 ECU_ADDRESS 0x24026da4 /end MEASUREMENT
/begin MEASUREMENT VS_SLR_Pa_2Row_bitfield "" UBYTE NO_COMPU_METHOD 1 100 0 255 ECU_ADDRESS 0x24026dec /end MEASUREMENT
/begin MEASUREMENT VS_SLR_Pa_bitfield "" UBYTE NO_COMPU_METHOD 1 100 0 255 ECU_ADDRESS 0x24026d82 /end MEASUREMENT
/begin COMPU_METHOD EQ_LSB_0_01 "" LINEAR "%6.2" "" COEFFS_LINEAR 0.01 0 /end COMPU_METHOD
/begin COMPU_METHOD EQ_LSB_0_01_j "" LINEAR "%4.2" "" COEFFS_LINEAR 0.01 0 /end COMPU_METHOD
/begin COMPU_METHOD EQ_LSB_0_01_k "" LINEAR "%6.2" "s" COEFFS_LINEAR 0.01 0 /end COMPU_METHOD
/begin COMPU_METHOD EQ_LSB_0_1 "" LINEAR "%6.1" "" COEFFS_LINEAR 0.1 0 /end COMPU_METHOD
/begin COMPU_METHOD EQ_LSB_0_1_d "" LINEAR "%4.1" "" COEFFS_LINEAR 0.1 0 /end COMPU_METHOD
/begin COMPU_METHOD EQ_LSB_0_1_h "" LINEAR "%4.1" "mps2" COEFFS_LINEAR 0.1 0 /end COMPU_METHOD
/begin COMPU_METHOD EQ_LSB_0_4 "" LINEAR "%5.1" "" COEFFS_LINEAR 0.4 0 /end COMPU_METHOD
/begin COMPU_METHOD EQ_LSB_0_4_c "" LINEAR "%7.1" "" COEFFS_LINEAR 0.4 0 /end COMPU_METHOD
/begin COMPU_METHOD EQ_LSB_0_5 "" LINEAR "%7.1" "" COEFFS_LINEAR 0.5 0 /end COMPU_METHOD
/begin COMPU_METHOD EQ_LSB_1 "" LINEAR "%3.0" "10ms" COEFFS_LINEAR 1 0 /end COMPU_METHOD
/begin COMPU_METHOD EQ_LSB_1_e "" LINEAR "%3.0" "percentp10ms" COEFFS_LINEAR 1 0 /end COMPU_METHOD
/begin COMPU_METHOD EQ_LSB_1_f "" LINEAR "%3.0" "bar" COEFFS_LINEAR 1 0 /end COMPU_METHOD
/begin COMPU_METHOD EQ_LSB_1_g "" LINEAR "%3.0" "barp20ms" COEFFS_LINEAR 1 0 /end COMPU_METHOD
/begin COMPU_METHOD EQ_LSB_10 "" LINEAR "%4.0" "ms" COEFFS_LINEAR 10 0 /end COMPU_METHOD
/begin COMPU_METHOD SMA_FNC_AcceleratorPedal "" LINEAR "%5.1" "percent" COEFFS_LINEAR 0.4 0 /end COMPU_METHOD
/begin COMPU_METHOD SMA_FNC_BrakePressure "" LINEAR "%7.1" "bar" COEFFS_LINEAR 0.5 0 /end COMPU_METHOD
/begin COMPU_METHOD SMA_FNC_CarSpeed "" LINEAR "%6.2" "kmh" COEFFS_LINEAR 0.01 0 /end COMPU_METHOD
/begin COMPU_METHOD SMA_FNC_DirectWheelAngle "" LINEAR "%7.3" "deg" COEFFS_LINEAR 0.005 0 /end COMPU_METHOD
/begin COMPU_METHOD SMA_FNC_LateralAccel_Y "" LINEAR "%6.1" "mps2" COEFFS_LINEAR 0.1 0 /end COMPU_METHOD
/begin COMPU_METHOD SMA_FNC_LongitudinalAccel_X "" LINEAR "%6.1" "mps2" COEFFS_LINEAR 0.1 0 /end COMPU_METHOD
/begin FUNCTION SVSMA_HPW3__VSMA_BSD_Blind_Spot_detection "" /begin DEF_CHARACTERISTIC SVSMA_HPW3_BSD_Left_Enable SVSMA_HPW3_BSD_Right_Enable /end DEF_CHARACTERISTIC
 /begin LOC_MEASUREMENT BSD_Left BSD_Right ALI_BSD_Left_Request ALI_BSD_Right_Request /end LOC_MEASUREMENT
/end FUNCTION
/begin FUNCTION SVSMA_HPW4__VSMA_HSW_HighSpeedWarning "" /begin DEF_CHARACTERISTIC HSW_Enable PARAM_VS_HPW_HSpeed_Threshold_kmh /end DEF_CHARACTERISTIC /begin LOC_MEASUREMENT ALI_CarSpeed_kmh /end LOC_MEASUREMENT /end FUNCTION
/begin FUNCTION SVSMA_HPW5__VSMA_LDW_LaneChangeDetectionWarning "" /begin DEF_CHARACTERISTIC SVSMA_HPW5_ALDPW_Enable /end DEF_CHARACTERISTIC
 /begin LOC_MEASUREMENT SVSMA_HPW5_Relational_Operator1 SVSMA_HPW5_Relational_Operator2 ALI_Active_LDP_Assist_Request /end LOC_MEASUREMENT
/end FUNCTION
/begin FUNCTION SVSMA_HPW6__VSMA_ODWD_OpenedDoorWhileDriving "" /begin DEF_CHARACTERISTIC PARAM_VS_ODWD_Speed_kmh /end DEF_CHARACTERISTIC
 /begin LOC_MEASUREMENT ALI_CarSpeed_kmh ALI_FLDoors_Open ALI_FRDoors_Open ALI_RLDoors_Open ALI_RRDoors_Open /end LOC_MEASUREMENT
/end FUNCTION
/begin FUNCTION VSMA_BRK ""
 /begin DEF_CHARACTERISTIC EPBD_Enable HVDD_Enable IBD_Enable PEB_Enable REB_Enable PARAM_VS_BRK_ACC_BRK_switch_time_ms PARAM_VS_BRK_ACC_pos_grad_max_percs PARAM_VS_BRK_ACC_BRK_switch_press_bar PARAM_VS_BRK_ACC_BRK_switch_grad_bars PARAM_VS_BRK_BRK_EPBD_Del_msec_1 PARAM_VS_BRK_EPB_Delay_ms PARAM_VS_BRK_HVDD_BRK_ax_max_ms2 PARAM_VS_BRK_HVDD_BRK_press_max_bar PARAM_VS_BRK_IBD_BRK_accel_delay_ms PARAM_VS_BRK_IBD_BRK_ax_max_ms2 PARAM_VS_BRK_IBD_BRK_press_max_bar PARAM_VS_BRK_IBD_BRK_signal_delay_ms PARAM_VS_BRK_BRK_delay_2_ms PARAM_VS_BRK_BRK_grad_max_2_bars PARAM_VS_BRK_BRK_press_max_2_bar PARAM_VS_BRK_PEB_Eva_Delay_ms PARAM_VS_BRK_BRK_grad_max_bars PARAM_VS_BRK_BRK_ax_filter /end DEF_CHARACTERISTIC
 /begin LOC_MEASUREMENT DEBUGOUT_brake_task_brk_press_grad DEBUGOUT_brake_task_Fapedrowe DEBUGOUT_brake_task_SARA_AX DEBUGOUT_brake_task_brk_press DEBUGOUT_EPBD_set DEBUGOUT_EPBD_Fapedrowe_grad DEBUGOUT_EPBD_Fapedrowe_grad_sign DEBUGOUT_EPBD_Fapedrowe_grad_thresh DEBUGOUT_EPBD_brk_press_thresh DEBUGOUT_EPBD_brk_press_grad_thresh DEBUGOUT_EPBD_brk_press_react_set_true DEBUGOUT_HVDD_SARA_AX_thresh DEBUGOUT_HVDD_brk_press_thresh DEBUGOUT_HVDD_set DEBUGOUT_IBD_SARA_AX_thresh DEBUGOUT_IBD_brk_press_thresh DEBUGOUT_IBD_set DEBUGOUT_PEB_brk_press_grad_thresh DEBUGOUT_PEB_brk_press_thresh DEBUGOUT_PEB_set DEBUGOUT_REB_set DEBUGOUT_brake_task_SARA_AX_invert /end LOC_MEASUREMENT
 /begin IN_MEASUREMENT ALI_AcceleratorPedal_perc ALI_BrakePressure_bar ALI_LongitudinalAccel_X_ms2 /end IN_MEASUREMENT
 /begin OUT_MEASUREMENT VS_BRK_bitfield /end OUT_MEASUREMENT
 /begin SUB_FUNCTION ALRTL_DelayRequest_8_10.Instance1 ALRTL_DelayRequest_8_10.Instance2 ALRTL_DelayRequest_8_10.Instance3 ALRTL_HoldRRequest_8_10.Instance1 ALRTL_HoldRRequest_8_10.Instance2 /end SUB_FUNCTION
/end FUNCTION
/begin FUNCTION VSMA_CRD ""
 /begin DEF_CHARACTERISTIC Oversteer_low_Enable Understeer_low_Enable Oversteer_high_Enable Understeer_high_Enable Oversteer_ESPOff_Enable Understeer_ESPOff_Enable newPath104_Enable PARAM_VS_CDT_DSUO_Enable PARAM_VS_CDT_instabil_ueber_steuern_2 PARAM_VS_CDT_instabil_unter_steuern_2 PARAM_VS_CDT_PCUO_Enable PARAM_VS_CDT_instabil_ueber_steuern_1 PARAM_VS_CDT_instabil_unter_steuern_1 PARAM_VS_CDT_ESPOffUO_Enable PARAM_VS_CDT_instabil_ESP_BRK_min_bar PARAM_VS_CDT_instabil_ESP_off_ueber_3 PARAM_VS_CDT_instabil_ESP_off_unter_3 PARAM_VS_CDT_CDR_01_Enable PARAM_VS_CDT_C_D_gier_filter PARAM_VS_CDT_C_D_ay_filter PARAM_VS_CDT_ay_diff_verstaerk_ueber PARAM_VS_CDT_ay_diff_verstaerk_unter PARAM_VS_CDT_gier_diff_verstaerk_ueber PARAM_VS_CDT_gier_diff_verstaerk_unter PARAM_VS_CDT_gier_ueber_unter_hyster PARAM_VS_CDT_ay_angleich PARAM_VS_CDT_gier_angleich PARAM_VS_CDT_lenkfilter_ay_esm PARAM_VS_CDT_lenkfilter_gier_esm PARAM_VS_CDT_wheel_base_mm PARAM_VS_CDT_charak_v_a_y PARAM_VS_CDT_charak_v_psi_dot /end DEF_CHARACTERISTIC
 /begin LOC_MEASUREMENT CAN1_CDTin_Direct_WheelAngle_deg DD_SVSMA_CRD3_1 DD_SVSMA_CRD3_2 DD_SVSMA_CRD4_1 DD_SVSMA_CRD4_2 DEBUGOUT_C_I_Dyn_Supp_crit_thresh_over DEBUGOUT_C_I_Dyn_Supp_crit_thresh_under DEBUGOUT_Dyn_Supp_Oversteer_request DEBUGOUT_Dyn_Supp_Understeer_request DEBUGOUT_C_I_Precrash_crit_thresh_over DEBUGOUT_C_I_Precrash_crit_thresh_under DEBUGOUT_C_I_Dyn_Supp_BRK_threshold DEBUGOUT_C_I_Dyn_Supp_ESP_BRK DEBUGOUT_C_I_ESPOff_thresh_over DEBUGOUT_C_I_ESPOff_thresh_under DEBUGOUT_ESPOff_Oversteer_request DEBUGOUT_ESPOff_Understeer_request DEBUGOUT_Instab_Fahr_ESP_Bremsdruck DEBUGOUT_Instab_Fahr_ESP_Tastung_passiv DEBUGOUT_Instab_Fahr_ESP_v_Signal DEBUGOUT_Instab_Fahr_SARA_AY DEBUGOUT_Instab_Fahr_SARA_Omega_Z DEBUGOUT_crit_index_over_ay_diff DEBUGOUT_crit_index_over_psi_dot_diff DEBUGOUT_crit_index_under_ay_diff DEBUGOUT_crit_index_under_psi_dot_diff DEBUGOUT_criticality_index_oversteer DEBUGOUT_criticality_index_sum DEBUGOUT_criticality_index_understeer DEBUGOUT_over_under_s_r_ff_set DEBUGOUT_over_under_set DEBUGOUT_residual_ay_angeglichen DEBUGOUT_residual_ay_calc DEBUGOUT_residual_ay_diff DEBUGOUT_residual_psi_dot_angeglichen DEBUGOUT_residual_psi_dot_calc DEBUGOUT_residual_psi_dot_diff /end LOC_MEASUREMENT
 /begin IN_MEASUREMENT ALI_BrakePressure_bar ALI_CarSpeed_kmh ALI_ESP_Deactivated ALI_LateralAccel_Y_ms2 ALI_YawRate_Z_degs CAN1_CDTin_Direct_WheelAngle_deg /end IN_MEASUREMENT
 /begin OUT_MEASUREMENT VS_CDT_bitfield_b VS_CDT_CriticalityIndex_w /end OUT_MEASUREMENT
 /begin SUB_FUNCTION SVSMA_CRD7_Path104 /end SUB_FUNCTION
/end FUNCTION
/begin FUNCTION VSMA_EBL ""
 /begin DEF_CHARACTERISTIC DEBUGIN_EBLT_ReleaseRequest_FL DEBUGIN_EBLT_ReleaseRequest_FL_Enabled DEBUGIN_EBLT_ReleaseRequest_FR DEBUGIN_EBLT_ReleaseRequest_FR_Enabled DEBUGIN_EBLT_ReleaseRequest_RL1 DEBUGIN_EBLT_ReleaseRequest_RL1_Enabled DEBUGIN_EBLT_ReleaseRequest_RL2 DEBUGIN_EBLT_ReleaseRequest_RL2_Enabled DEBUGIN_EBLT_ReleaseRequest_RR1 DEBUGIN_EBLT_ReleaseRequest_RR1_Enabled PARAM_EBLT_VehObs_Task_FL_Enable PARAM_VS_EBLT_VehObsWarn_Task_Dr_Enable PARAM_VS_EBLT_VehObsWarn_Task_Pa_Enable PARAM_VS_EBLT_VehObs_Task_Pa_Enable PARAM_VS_EBLT_VehObs_Task_Dr2Row_Enable PARAM_VS_EBLT_VehObs_Task_Pa2Row_Enable PARAM_ABL_Acti_DemoTablet_enable_FL PARAM_ABL_Acti_DemoTablet_enable_FR PARAM_ABL_Acti_DemoTablet_enable_RL1 PARAM_ABL_Acti_DemoTablet_enable_RL2 PARAM_ABL_Acti_DemoTablet_enable_RR1 PARAM_ACR_Acti_DemoTablet_enable_FL PARAM_ACR_Acti_DemoTablet_enable_FR PARAM_ACR_Acti_DemoTablet_enable_RL1 PARAM_ACR_Acti_DemoTablet_enable_RL2 PARAM_ACR_Acti_DemoTablet_enable_RR1 PARAM_EBLT_min_Geschw_kmh PARAM_EBLT_BP_Task_FL_Enable PARAM_EBLT_BP_Task_FR_Enable PARAM_EBLT_BRK_Task_FL_Enable_b PARAM_EBLT_BRK_Task_FR_Enable_b PARAM_EBLT_BRK_Task_RL1_Enable_b PARAM_EBLT_BRK_Task_RL2_Enable_b PARAM_EBLT_BRK_Task_RR1_Enable_b PARAM_EBLT_CD_Task_FL_Enable_b PARAM_EBLT_CD_Task_FR_Enable_b PARAM_EBLT_CD_Task_RL1_Enable_b PARAM_EBLT_CD_Task_RL2_Enable_b PARAM_EBLT_CD_Task_RR1_Enable_b PARAM_EBLT_DA_Task_FL_Enable PARAM_EBLT_DA_Task_FR_Enable PARAM_EBLT_DA_Task_RL1_Enable PARAM_EBLT_DA_Task_RL2_Enable PARAM_EBLT_DA_Task_RR1_Enable PARAM_EBLT_DB_Task_FL_Enable_b PARAM_EBLT_DB_Task_FR_Enable_b PARAM_EBLT_DB_Task_RL1_Enable_b PARAM_EBLT_DB_Task_RL2_Enable_b PARAM_EBLT_DB_Task_RR1_Enable_b PARAM_EBLT_Release_Task_FL_Enable_b PARAM_EBLT_Release_Task_FR_Enable_b PARAM_EBLT_Release_Task_RL1_Enable_b PARAM_EBLT_Release_Task_RL2_Enable_b PARAM_EBLT_Release_Task_RR1_Enable_b PARAM_EBLT_SLR_Task_FL_Enable PARAM_EBLT_SLR_Task_FR_Enable /end DEF_CHARACTERISTIC
 /begin LOC_MEASUREMENT DEBUGOUT_EBL_Out_VehObs_Dr_b Debug_OOP_Status_FL Debug_OOP_Status_FR DEBUGOUT_EBL_In_ABL_Request_FR_b DEBUGOUT_EBL_In_ABL_Request_RL1_b DEBUGOUT_EBL_In_ABL_Request_RL2_b DEBUGOUT_EBL_In_ABL_Request_RR1_b DEBUGOUT_EBL_In_ACR_Request_FR_b DEBUGOUT_EBL_In_ACR_Request_RL1_b DEBUGOUT_EBL_In_ACR_Request_RL2_b DEBUGOUT_EBL_In_ACR_Request_RR1_b DEBUGOUT_EBL_Out_DA_FL_b DEBUGOUT_EBL_Out_DA_FR_b DEBUGOUT_EBL_Out_DA_RL1_b DEBUGOUT_EBL_Out_DA_RL2_b DEBUGOUT_EBL_Out_DA_RR1_b DEBUGOUT_EBL_Out_DB_FL_b DEBUGOUT_EBL_Out_DB_FR_b DEBUGOUT_EBL_Out_DB_RL1_b DEBUGOUT_EBL_Out_DB_RL2_b DEBUGOUT_EBL_Out_DB_RR1_b DEBUGOUT_EBL_Out_VehObs_Dr_2Row_b DEBUGOUT_EBL_Out_VehObs_Pa_b DEBUGOUT_EBL_Out_VehObs_Pa_2Row_b DEBUGOUT_EBL_DG_Sum_CD_RL1_b DEBUGOUT_EBL_DG_Sum_CD_RL2_b DEBUGOUT_EBL_DG_Sum_CD_RR1_b DEBUGOUT_EBL_DG_Sum_DB_FL_b DEBUGOUT_EBL_DG_Sum_DB_FR_b DEBUGOUT_EBL_DG_Sum_DB_RL1_b DEBUGOUT_EBL_DG_Sum_DB_RL2_b DEBUGOUT_EBL_DG_Sum_DB_RR1_b DEBUGOUT_EBL_DG_Sum_VehObsWarn_Dr_b DEBUGOUT_EBL_DG_Sum_VehObsWarn_Pa_b DEBUGOUT_EBL_DG_Sum_VehObs_Dr_b DEBUGOUT_EBL_DG_Sum_VehObs_Pa_b DEBUGOUT_EBL_DG_Sum_VehObs_RL_b DEBUGOUT_EBL_DG_Sum_VehObs_RR_b DEBUGOUT_EBL_In_ABL_Request_FL_b DEBUGOUT_EBL_In_ACR_Request_FL_b DEBUGOUT_EBL_In_BP_FL_b DEBUGOUT_EBL_In_BP_FR_b DEBUGOUT_EBL_In_BRK_b DEBUGOUT_EBL_In_CD_b DEBUGOUT_EBL_In_DA_b DEBUGOUT_EBL_In_DB_b DEBUGOUT_EBL_In_MinSpd_b DEBUGOUT_EBL_In_MoDir_b DEBUGOUT_EBL_In_REL_b DEBUGOUT_EBL_In_SLR_FL_b DEBUGOUT_EBL_In_SLR_FR_b DEBUGOUT_EBL_In_SLR_RL1_b DEBUGOUT_EBL_In_SLR_RL2_b DEBUGOUT_EBL_In_SLR_RR1_b DEBUGOUT_EBL_Out_BRK_FL_b DEBUGOUT_EBL_Out_BRK_FR_b DEBUGOUT_EBL_Out_BRK_RL1_b DEBUGOUT_EBL_Out_BRK_RL2_b DEBUGOUT_EBL_Out_BRK_RR1_b DEBUGOUT_EBL_Out_CD_FL_b DEBUGOUT_EBL_Out_CD_FR_b DEBUGOUT_EBL_Out_CD_RL1_b DEBUGOUT_EBL_Out_CD_RL2_b DEBUGOUT_EBL_Out_CD_RR1_b DEBUGOUT_EBL_Out_SLR_FL_b DEBUGOUT_EBL_Out_SLR_FR_b DEBUGOUT_EBL_Out_SLR_RL1_b DEBUGOUT_EBL_Out_SLR_RL2_b DEBUGOUT_EBL_Out_SLR_RR1_b DebugOut_MinSpeed_01_f DEBUGOUT_EBL_DG_Sum_BRK_FL_b DEBUGOUT_EBL_DG_Sum_BRK_FR_b DEBUGOUT_EBL_DG_Sum_CD_FL_b DEBUGOUT_EBL_DG_Sum_CD_FR_b DEBUGOUT_EBL_DG_Sum_REL_FL_b DEBUGOUT_EBL_DG_Sum_REL_FR_b DEBUGOUT_EBL_DG_Sum_REL_RL1_b DEBUGOUT_EBL_DG_Sum_REL_RL2_b DEBUGOUT_EBL_DG_Sum_REL_RR1_b /end LOC_MEASUREMENT
 /begin IN_MEASUREMENT DEBUGOUT_HMI_ELK_RL1_LockingRequest DEBUGOUT_HMI_ELK_RL2_LockingRequest DEBUGOUT_HMI_ELK_RR1_LockingRequest VS_RLST_bitfield_b /end IN_MEASUREMENT
 /begin OUT_MEASUREMENT EBLT_ACR_ExtActivationRequest_FL_b EBLT_ACR_Ext_ActivationRequest_FR_b EBLT_ACR_ExtActivationRequest_RL1_b EBLT_ACR_ExtActivationRequest_RR1_b SVSMA_EBL1_EBLT_BrakeTask_FL_Enable SVSMA_EBL1_EBLT_BrakeTask_FR_Enable SVSMA_EBL1_EBLT_BrakeTask_RL1_Enable SVSMA_EBL1_EBLT_BrakeTask_RL2_Enable SVSMA_EBL1_EBLT_BrakeTask_RR1_Enable SVSMA_EBL1_EBLT_CritDrivTask_FL_Enable SVSMA_EBL1_EBLT_CritDrivTask_FR_Enable SVSMA_EBL1_EBLT_CritDrivTask_RL1_Enable SVSMA_EBL1_EBLT_CritDrivTask_RL2_Enable SVSMA_EBL1_EBLT_CritDrivTask_RR1_Enable SVSMA_EBL1_EBLT_DA_FL_Enable SVSMA_EBL1_EBLT_DA_FR_Enable SVSMA_EBL1_EBLT_DA_RL1_Enable SVSMA_EBL1_EBLT_DA_RL2_Enable SVSMA_EBL1_EBLT_DA_RR1_Enable EBLT_DynBeltTask_FL_Enable_b EBLT_DynBeltTask_FR_Enable_b EBLT_DynBeltTask_RL1_Enable_b EBLT_DynBeltTask_RR1_Enable_b SVSMA_EBL1_EBLT_ReleaseTask_FL_Enable SVSMA_EBL1_EBLT_ReleaseTask_FR_Enable SVSMA_EBL1_EBLT_ReleaseTask_RL1_Enable SVSMA_EBL1_EBLT_ReleaseTask_RL2_Enable SVSMA_EBL1_EBLT_ReleaseTask_RR1_Enable SVSMA_EBL1_EBLT_SLR_FL_Enable SVSMA_EBL1_EBLT_SLR_FR_Enable SVSMA_EBL1_EBLT_SLR_RL1_Enable SVSMA_EBL1_EBLT_SLR_RL2_Enable SVSMA_EBL1_EBLT_SLR_RR1_Enable EBLT_VehObsTask_Dr_Enable_b VS_EBLT_VehObsTask_Pa_Enable_b VS_EBLT_VehObsTask_Dr_2Row_Enable_b VS_EBLT_VehObsTask_Pa_2Row_Enable_b VS_EBLT_VehObsWarningTask_Dr_Enable_b VS_EBLT_VehObsWarningTask_Pa_Enable_b /end OUT_MEASUREMENT
/end FUNCTION
/begin FUNCTION VSMA_HPW ""
 /begin LOC_MEASUREMENT ADHOW_L1_set ADHOW_L2_set ADHOW_L3_set ALI_AutonDrivHandover_Req ALI_WarnBlinking_active /end LOC_MEASUREMENT
 /begin IN_MEASUREMENT ALI_AutonDrivHandover_Req ALI_WarnBlinking_active ALI_CarSpeed_kmh ALI_AEB_Brk_Request ALI_Active_LDP_Assist_Request ALI_BSD_Left_Request ALI_BSD_Right_Request ALI_FLDoors_Open ALI_FRDoors_Open ALI_RLDoors_Open ALI_RRDoors_Open /end IN_MEASUREMENT
 /begin OUT_MEASUREMENT VS_DA_bitfield_b /end OUT_MEASUREMENT
 /begin SUB_FUNCTION SVSMA_HPW2__VSMA_AEB_Autonomous_Emergency_Braking SVSMA_HPW3__VSMA_BSD_Blind_Spot_detection SVSMA_HPW5__VSMA_LDW_LaneChangeDetectionWarning ALRTL_MinHoldRequest_8_10.Instance1 SVSMA_HPW4__VSMA_HSW_HighSpeedWarning SVSMA_HPW6__VSMA_ODWD_OpenedDoorWhileDriving /end SUB_FUNCTION
/end FUNCTION
/begin FUNCTION VSMA_PRIO ""
 /begin DEF_CHARACTERISTIC ACR_ABL_Prioritization_FL_DD_SVSMA_PRIO9_PARAM_ACB_PRI_ActLevel_Deact ACR_ABL_Prioritization_FL_PARAM_ACR_PRI_ActLevel_Deact_XX ACR_ABL_Prioritization_FL_Parameter_OccupantClass ACR_ABL_Prioritization_FL_Parameter_OccupantClass_enable ACR_ABL_Prioritization_FL_PARAM_VS_PRI_ActLvl_Del_msec_1 ACR_ABL_Prioritization_FL_PARAM_VS_PRI_ActLvl_Del_msec_2 ACR_ABL_Prioritization_FR_DD_SVSMA_PRIO65_PARAM_ACB_PRI_ActLevel_Deact ACR_ABL_Prioritization_FR_PARAM_ACR_PRI_ActLevel_Deact_XX ACR_ABL_Prioritization_FR_Parameter_OccupantClass ACR_ABL_Prioritization_FR_Parameter_OccupantClass_enable ACR_ABL_Prioritization_FR_PARAM_VS_PRI_ActLvl_Del_msec_1 ACR_ABL_Prioritization_FR_PARAM_VS_PRI_ActLvl_Del_msec_2 ACR_ABL_Prioritization_RL1_DD_SVSMA_PRIO121_PARAM_ACB_PRI_ActLevel_Deact ACR_ABL_Prioritization_RL1_PARAM_ACR_PRI_ActLevel_Deact_XX ACR_ABL_Prioritization_RL1_Parameter_OccupantClass ACR_ABL_Prioritization_RL1_Parameter_OccupantClass_enable ACR_ABL_Prioritization_RL1_PARAM_VS_PRI_ActLvl_Del_msec_1 ACR_ABL_Prioritization_RL1_PARAM_VS_PRI_ActLvl_Del_msec_2 ACR_ABL_Prioritization_RL2_DD_SVSMA_PRIO177_PARAM_ACB_PRI_ActLevel_Deact ACR_ABL_Prioritization_RL2_PARAM_ACR_PRI_ActLevel_Deact_XX ACR_ABL_Prioritization_RL2_Parameter_OccupantClass ACR_ABL_Prioritization_RL2_Parameter_OccupantClass_enable ACR_ABL_Prioritization_RL2_PARAM_VS_PRI_ActLvl_Del_msec_1 ACR_ABL_Prioritization_RL2_PARAM_VS_PRI_ActLvl_Del_msec_2 ACR_ABL_Prioritization_RR1_DD_SVSMA_PRIO233_PARAM_ACB_PRI_ActLevel_Deact ACR_ABL_Prioritization_RR1_PARAM_ACR_PRI_ActLevel_Deact_XX ACR_ABL_Prioritization_RR1_Parameter_OccupantClass ACR_ABL_Prioritization_RR1_Parameter_OccupantClass_enable ACR_ABL_Prioritization_RR1_PARAM_VS_PRI_ActLvl_Del_msec_1 ACR_ABL_Prioritization_RR1_PARAM_VS_PRI_ActLvl_Del_msec_2 ISB_PARAM_Colour_Green ISB_PARAM_Colour_Orange ISB_PARAM_Colour_Red ISB_PARAM_Colour_White ISB_PARAM_Colour_Yellow ISB_PARAM_Colour_ZFblue /end DEF_CHARACTERISTIC
 /begin LOC_MEASUREMENT ACR_ABL_Prioritization_FL_Debug_SLR_out ACR_ABL_Prioritization_FL_Debug_ExtAct_Retract1 ACR_ABL_Prioritization_FL_Debug_ExtAct_SLR ACR_ABL_Prioritization_FL_VS_Abort_Retract_Buckle ACR_ABL_Prioritization_FL_VS_Abort_Retract_ISwStat ACR_ABL_Prioritization_FL_Debug_ACR_ActivationLevel ACR_ABL_Prioritization_FL_DD_SVSMA_PRIO7_DEBUGOUT_PRI_DG_Out_Release ACR_ABL_Prioritization_FL_DD_SVSMA_PRIO7_DEBUGOUT_PRI_In_BRK ACR_ABL_Prioritization_FL_DD_SVSMA_PRIO7_DEBUGOUT_PRI_In_Bkl ACR_ABL_Prioritization_FL_DD_SVSMA_PRIO7_DEBUGOUT_PRI_In_CD ACR_ABL_Prioritization_FL_DD_SVSMA_PRIO7_DEBUGOUT_PRI_In_DA ACR_ABL_Prioritization_FL_DD_SVSMA_PRIO7_DEBUGOUT_PRI_In_DB ACR_ABL_Prioritization_FL_DD_SVSMA_PRIO7_DEBUGOUT_PRI_In_REL ACR_ABL_Prioritization_FL_DD_SVSMA_PRIO7_DEBUGOUT_PRI_In_SLR ACR_ABL_Prioritization_FL_DD_SVSMA_PRIO7_DEBUGOUT_PRI_In_VehObs ACR_ABL_Prioritization_FL_DD_SVSMA_PRIO7_DEBUGOUT_PRI_In_VehObsWarning ACR_ABL_Prioritization_FL_Debug_PRI_OccupantWeight ACR_ABL_Prioritization_FL_Debug_PRI_WeightClass ACR_ABL_Prioritization_FL_DD_SVSMA_PRIO50_DEBUGOUT_PRI_Out_ABL_Retract ACR_ABL_Prioritization_FL_DEBUGOUT_PRI_Out_ACR_Retract ISB_Prioritization_FL_Debug_ISB_Colour ACR_ABL_Prioritization_FR_Debug_SLR_out ACR_ABL_Prioritization_FR_Debug_ExtAct_Retract1 ACR_ABL_Prioritization_FR_Debug_ExtAct_SLR ACR_ABL_Prioritization_FR_VS_Abort_Retract_Buckle ACR_ABL_Prioritization_FR_VS_Abort_Retract_ISwStat ACR_ABL_Prioritization_FR_Debug_ACR_ActivationLevel ACR_ABL_Prioritization_FR_DD_SVSMA_PRIO63_DEBUGOUT_PRI_DG_Out_Release ACR_ABL_Prioritization_FR_DD_SVSMA_PRIO63_DEBUGOUT_PRI_In_BRK ACR_ABL_Prioritization_FR_DD_SVSMA_PRIO63_DEBUGOUT_PRI_In_Bkl ACR_ABL_Prioritization_FR_DD_SVSMA_PRIO63_DEBUGOUT_PRI_In_CD ACR_ABL_Prioritization_FR_DD_SVSMA_PRIO63_DEBUGOUT_PRI_In_DA ACR_ABL_Prioritization_FR_DD_SVSMA_PRIO63_DEBUGOUT_PRI_In_DB ACR_ABL_Prioritization_FR_DD_SVSMA_PRIO63_DEBUGOUT_PRI_In_REL ACR_ABL_Prioritization_FR_DD_SVSMA_PRIO63_DEBUGOUT_PRI_In_SLR ACR_ABL_Prioritization_FR_DD_SVSMA_PRIO63_DEBUGOUT_PRI_In_VehObs ACR_ABL_Prioritization_FR_DD_SVSMA_PRIO63_DEBUGOUT_PRI_In_VehObsWarning ACR_ABL_Prioritization_FR_Debug_PRI_OccupantWeight ACR_ABL_Prioritization_FR_Debug_PRI_WeightClass ACR_ABL_Prioritization_FR_DD_SVSMA_PRIO106_DEBUGOUT_PRI_Out_ABL_Retract ACR_ABL_Prioritization_FR_DEBUGOUT_PRI_Out_ACR_Retract ISB_Prioritization_FR_Debug_ISB_Colour ACR_ABL_Prioritization_RL1_Debug_SLR_out ACR_ABL_Prioritization_RL1_Debug_ExtAct_Retract1 ACR_ABL_Prioritization_RL1_Debug_ExtAct_SLR ACR_ABL_Prioritization_RL1_VS_Abort_Retract_Buckle ACR_ABL_Prioritization_RL1_VS_Abort_Retract_ISwStat ACR_ABL_Prioritization_RL1_Debug_ACR_ActivationLevel ACR_ABL_Prioritization_RL1_DD_SVSMA_PRIO119_DEBUGOUT_PRI_DG_Out_Release ACR_ABL_Prioritization_RL1_DD_SVSMA_PRIO119_DEBUGOUT_PRI_In_BRK ACR_ABL_Prioritization_RL1_DD_SVSMA_PRIO119_DEBUGOUT_PRI_In_Bkl ACR_ABL_Prioritization_RL1_DD_SVSMA_PRIO119_DEBUGOUT_PRI_In_CD ACR_ABL_Prioritization_RL1_DD_SVSMA_PRIO119_DEBUGOUT_PRI_In_DA ACR_ABL_Prioritization_RL1_DD_SVSMA_PRIO119_DEBUGOUT_PRI_In_DB ACR_ABL_Prioritization_RL1_DD_SVSMA_PRIO119_DEBUGOUT_PRI_In_REL ACR_ABL_Prioritization_RL1_DD_SVSMA_PRIO119_DEBUGOUT_PRI_In_SLR ACR_ABL_Prioritization_RL1_DD_SVSMA_PRIO119_DEBUGOUT_PRI_In_VehObs ACR_ABL_Prioritization_RL1_DD_SVSMA_PRIO119_DEBUGOUT_PRI_In_VehObsWarning ACR_ABL_Prioritization_RL1_Debug_PRI_OccupantWeight ACR_ABL_Prioritization_RL1_Debug_PRI_WeightClass ACR_ABL_Prioritization_RL1_DD_SVSMA_PRIO162_DEBUGOUT_PRI_Out_ABL_Retract ACR_ABL_Prioritization_RL1_DEBUGOUT_PRI_Out_ACR_Retract ISB_Prioritization_RL1_Debug_ISB_Colour ACR_ABL_Prioritization_RL2_Debug_SLR_out ACR_ABL_Prioritization_RL2_Debug_ExtAct_Retract1 ACR_ABL_Prioritization_RL2_Debug_ExtAct_SLR ACR_ABL_Prioritization_RL2_VS_Abort_Retract_Buckle ACR_ABL_Prioritization_RL2_VS_Abort_Retract_ISwStat ACR_ABL_Prioritization_RL2_Debug_ACR_ActivationLevel ACR_ABL_Prioritization_RL2_DD_SVSMA_PRIO175_DEBUGOUT_PRI_DG_Out_Release ACR_ABL_Prioritization_RL2_DD_SVSMA_PRIO175_DEBUGOUT_PRI_In_BRK ACR_ABL_Prioritization_RL2_DD_SVSMA_PRIO175_DEBUGOUT_PRI_In_Bkl ACR_ABL_Prioritization_RL2_DD_SVSMA_PRIO175_DEBUGOUT_PRI_In_CD ACR_ABL_Prioritization_RL2_DD_SVSMA_PRIO175_DEBUGOUT_PRI_In_DA ACR_ABL_Prioritization_RL2_DD_SVSMA_PRIO175_DEBUGOUT_PRI_In_DB ACR_ABL_Prioritization_RL2_DD_SVSMA_PRIO175_DEBUGOUT_PRI_In_REL ACR_ABL_Prioritization_RL2_DD_SVSMA_PRIO175_DEBUGOUT_PRI_In_SLR ACR_ABL_Prioritization_RL2_DD_SVSMA_PRIO175_DEBUGOUT_PRI_In_VehObs ACR_ABL_Prioritization_RL2_DD_SVSMA_PRIO175_DEBUGOUT_PRI_In_VehObsWarning ACR_ABL_Prioritization_RL2_Debug_PRI_OccupantWeight ACR_ABL_Prioritization_RL2_Debug_PRI_WeightClass ACR_ABL_Prioritization_RL2_DD_SVSMA_PRIO218_DEBUGOUT_PRI_Out_ABL_Retract ACR_ABL_Prioritization_RL2_DEBUGOUT_PRI_Out_ACR_Retract ISB_Prioritization_RL2_Debug_ISB_Colour ACR_ABL_Prioritization_RR1_Debug_SLR_out ACR_ABL_Prioritization_RR1_Debug_ExtAct_Retract1 ACR_ABL_Prioritization_RR1_Debug_ExtAct_SLR ACR_ABL_Prioritization_RR1_VS_Abort_Retract_Buckle ACR_ABL_Prioritization_RR1_VS_Abort_Retract_ISwStat ACR_ABL_Prioritization_RR1_Debug_ACR_ActivationLevel ACR_ABL_Prioritization_RR1_DD_SVSMA_PRIO231_DEBUGOUT_PRI_DG_Out_Release ACR_ABL_Prioritization_RR1_DD_SVSMA_PRIO231_DEBUGOUT_PRI_In_BRK ACR_ABL_Prioritization_RR1_DD_SVSMA_PRIO231_DEBUGOUT_PRI_In_Bkl ACR_ABL_Prioritization_RR1_DD_SVSMA_PRIO231_DEBUGOUT_PRI_In_CD ACR_ABL_Prioritization_RR1_DD_SVSMA_PRIO231_DEBUGOUT_PRI_In_DA ACR_ABL_Prioritization_RR1_DD_SVSMA_PRIO231_DEBUGOUT_PRI_In_DB ACR_ABL_Prioritization_RR1_DD_SVSMA_PRIO231_DEBUGOUT_PRI_In_REL ACR_ABL_Prioritization_RR1_DD_SVSMA_PRIO231_DEBUGOUT_PRI_In_SLR ACR_ABL_Prioritization_RR1_DD_SVSMA_PRIO231_DEBUGOUT_PRI_In_VehObs ACR_ABL_Prioritization_RR1_DD_SVSMA_PRIO231_DEBUGOUT_PRI_In_VehObsWarning ACR_ABL_Prioritization_RR1_Debug_PRI_OccupantWeight ACR_ABL_Prioritization_RR1_Debug_PRI_WeightClass ACR_ABL_Prioritization_RR1_DD_SVSMA_PRIO274_DEBUGOUT_PRI_Out_ABL_Retract ACR_ABL_Prioritization_RR1_DEBUGOUT_PRI_Out_ACR_Retract ISB_Prioritization_RR1_Debug_ISB_Colour EBLT_ACR_ExtActivationRequest_FL_b EBLT_ACR_Ext_ActivationRequest_FR_b EBLT_ACR_ExtActivationRequest_RL1_b EBLT_ACR_ExtActivationRequest_RR1_b EBLT_DynBeltTask_FL_Enable_b EBLT_DynBeltTask_FR_Enable_b EBLT_DynBeltTask_RL1_Enable_b EBLT_DynBeltTask_RR1_Enable_b EBLT_VehObsTask_Dr_Enable_b VS_EBLT_VehObsTask_Pa_Enable_b VS_EBLT_VehObsTask_Dr_2Row_Enable_b VS_EBLT_VehObsTask_Pa_2Row_Enable_b VS_EBLT_VehObsWarningTask_Dr_Enable_b VS_EBLT_VehObsWarningTask_Pa_Enable_b SVSMA_PRIO1_EBLT_BrakeTask_FL_Enable SVSMA_PRIO1_EBLT_BrakeTask_FR_Enable SVSMA_PRIO1_EBLT_BrakeTask_RL1_Enable SVSMA_PRIO1_EBLT_BrakeTask_RL2_Enable SVSMA_PRIO1_EBLT_BrakeTask_RR1_Enable SVSMA_PRIO1_EBLT_CritDrivTask_FL_Enable SVSMA_PRIO1_EBLT_CritDrivTask_FR_Enable SVSMA_PRIO1_EBLT_CritDrivTask_RL1_Enable SVSMA_PRIO1_EBLT_CritDrivTask_RL2_Enable SVSMA_PRIO1_EBLT_CritDrivTask_RR1_Enable SVSMA_PRIO1_EBLT_DA_FL_Enable SVSMA_PRIO1_EBLT_DA_FR_Enable SVSMA_PRIO1_EBLT_DA_RL1_Enable SVSMA_PRIO1_EBLT_DA_RL2_Enable SVSMA_PRIO1_EBLT_DA_RR1_Enable SVSMA_PRIO1_EBLT_ReleaseTask_FL_Enable SVSMA_PRIO1_EBLT_ReleaseTask_FR_Enable SVSMA_PRIO1_EBLT_ReleaseTask_RL1_Enable SVSMA_PRIO1_EBLT_ReleaseTask_RL2_Enable SVSMA_PRIO1_EBLT_ReleaseTask_RR1_Enable SVSMA_PRIO1_EBLT_SLR_FL_Enable SVSMA_PRIO1_EBLT_SLR_FR_Enable SVSMA_PRIO1_EBLT_SLR_RL1_Enable SVSMA_PRIO1_EBLT_SLR_RL2_Enable SVSMA_PRIO1_EBLT_SLR_RR1_Enable /end LOC_MEASUREMENT
 /begin IN_MEASUREMENT EBLT_ACR_ExtActivationRequest_FL_b EBLT_ACR_Ext_ActivationRequest_FR_b EBLT_ACR_ExtActivationRequest_RL1_b EBLT_ACR_ExtActivationRequest_RR1_b EBLT_DynBeltTask_FL_Enable_b EBLT_DynBeltTask_FR_Enable_b EBLT_DynBeltTask_RL1_Enable_b EBLT_DynBeltTask_RR1_Enable_b EBLT_VehObsTask_Dr_Enable_b VS_EBLT_VehObsTask_Pa_Enable_b VS_EBLT_VehObsTask_Dr_2Row_Enable_b VS_EBLT_VehObsTask_Pa_2Row_Enable_b VS_EBLT_VehObsWarningTask_Dr_Enable_b VS_EBLT_VehObsWarningTask_Pa_Enable_b SVSMA_PRIO1_EBLT_BrakeTask_FL_Enable SVSMA_PRIO1_EBLT_BrakeTask_FR_Enable SVSMA_PRIO1_EBLT_BrakeTask_RL1_Enable SVSMA_PRIO1_EBLT_BrakeTask_RL2_Enable SVSMA_PRIO1_EBLT_BrakeTask_RR1_Enable SVSMA_PRIO1_EBLT_CritDrivTask_FL_Enable SVSMA_PRIO1_EBLT_CritDrivTask_FR_Enable SVSMA_PRIO1_EBLT_CritDrivTask_RL1_Enable SVSMA_PRIO1_EBLT_CritDrivTask_RL2_Enable SVSMA_PRIO1_EBLT_CritDrivTask_RR1_Enable SVSMA_PRIO1_EBLT_DA_FL_Enable SVSMA_PRIO1_EBLT_DA_FR_Enable SVSMA_PRIO1_EBLT_DA_RL1_Enable SVSMA_PRIO1_EBLT_DA_RL2_Enable SVSMA_PRIO1_EBLT_DA_RR1_Enable SVSMA_PRIO1_EBLT_ReleaseTask_FL_Enable SVSMA_PRIO1_EBLT_ReleaseTask_FR_Enable SVSMA_PRIO1_EBLT_ReleaseTask_RL1_Enable SVSMA_PRIO1_EBLT_ReleaseTask_RL2_Enable SVSMA_PRIO1_EBLT_ReleaseTask_RR1_Enable SVSMA_PRIO1_EBLT_SLR_FL_Enable SVSMA_PRIO1_EBLT_SLR_FR_Enable SVSMA_PRIO1_EBLT_SLR_RL1_Enable SVSMA_PRIO1_EBLT_SLR_RL2_Enable SVSMA_PRIO1_EBLT_SLR_RR1_Enable /end IN_MEASUREMENT
 /begin SUB_FUNCTION CVSMA_PRIO1_ActivationLevel_WeightClass_related CVSMA_PRIO4_ActivationLevel_WeightClass_related CVSMA_PRIO7_ActivationLevel_WeightClass_related CVSMA_PRIO10_ActivationLevel_WeightClass_related CVSMA_PRIO13_ActivationLevel_WeightClass_related /end SUB_FUNCTION
/end FUNCTION
/begin FUNCTION VSMA_RLS ""
 /begin DEF_CHARACTERISTIC PARAM_VS_REL_BRK_press_max_Gier_deg PARAM_VS_REL_Gierbeschleunigung_max_2_degs PARAM_VS_REL_Gierrate_max_2_degs PARAM_VS_REL_Gierrate_max_degs PARAM_VS_REL_Kugel_Filter PARAM_VS_REL_Kugel_Qualitime_msec PARAM_VS_REL_Kugel_max PARAM_VS_REL_Brake_press_max_bar PARAM_VS_REL_V_BRK_Thr_kmh_1 PARAM_VS_REL_release_fahrped_roh_perc PARAM_VS_REL_release_acceleration_ms2 PARAM_VS_REL_release_criticality PARAM_VS_REL_release_gier_filter /end DEF_CHARACTERISTIC
 /begin LOC_MEASUREMENT DEBUGOUT_Release_Accel_Detect_stable VS_RLS_Ball_Stable_f DEBUGOUT_Release_BRK_press DEBUGOUT_Release_Gier_BRK_stabil DEBUGOUT_Release_Gierbeschl_stabil DEBUGOUT_Release_Gierbeschleunigung DEBUGOUT_Release_Gierrate_set DEBUGOUT_Release_Gierrate_stabil DEBUGOUT_Release_Stable DEBUGOUT_Release_Kugel_stabil DEBUGOUT_Release_ax_ay DEBUGOUT_Release_ax_ay_filtered DEBUGOUT_Release_ax_ay_positive DEBUGOUT_Release_V_BRK_BRK_thresh DEBUGOUT_Release_V_BRK_stable DEBUGOUT_Release_V_BRK_v_thresh DEBUGOUT_Release_Accel_thresh_set DEBUGOUT_Release_Criticality_Stable DEBUGOUT_Release_task_Crit_Index DEBUGOUT_Release_task_ESP_Bremsdruck DEBUGOUT_Release_task_ESP_v_Signal DEBUGOUT_Release_task_Fapedrowe DEBUGOUT_Release_task_SARA_AX DEBUGOUT_Release_task_SARA_AY DEBUGOUT_Release_task_SARA_Omega_Z DEBUGOUT_Release_Rating_Accel_Det_value DEBUGOUT_Release_Rating_Critical_value DEBUGOUT_Release_Rating_Kugel_value DEBUGOUT_Release_Rating_Psi_dot_value DEBUGOUT_Release_Rating_V_B_value DEBUGOUT_Release_Sum /end LOC_MEASUREMENT
 /begin IN_MEASUREMENT ALI_AcceleratorPedal_perc ALI_BrakePressure_bar ALI_LongitudinalAccel_X_ms2 ALI_CarSpeed_kmh ALI_LateralAccel_Y_ms2 ALI_YawRate_Z_degs VS_CDT_CriticalityIndex_w /end IN_MEASUREMENT
 /begin OUT_MEASUREMENT VS_RLS_Ball_Stable_f VS_RLS_Rating_Stable_f /end OUT_MEASUREMENT
/end FUNCTION
/begin FUNCTION VSMA_SLR ""
 /begin DEF_CHARACTERISTIC SVSMA_SLR15_SLR1_FL_Enable SVSMA_SLR15_SLR1_RL1_Enable SVSMA_SLR15_SLR1_RL2_Enable SVSMA_SLR15_SLR2_FR_Enable SVSMA_SLR15_SLR2_RR1_Enable SVSMA_SLR16_SLR2_FL_Enable SVSMA_SLR16_SLR2_FR_Enable SVSMA_SLR16_SLR2_RL1_Enable SVSMA_SLR16_SLR2_RL2_Enable SVSMA_SLR16_SLR2_RR1_Enable PARAM_VS_SLR_BKL_Approved_1 PARAM_VS_SLR_CarSpeed_Thr1_kmh PARAM_VS_SLR_Del_1 PARAM_VS_SLR_CarSpeed_Thr2_kmh PARAM_VS_SLR_AX_THR_ms2 PARAM_VS_SLR_AccelPad_Thr_perc /end DEF_CHARACTERISTIC
 /begin LOC_MEASUREMENT BKU_DG_VehicleStart_f ALI_AcceleratorPedal_perc ALI_LongitudinalAccel_X_ms2 ALI_CarSpeed_kmh SM_BuckleSignal_FL_on SM_BuckleSignal_FR_on SM_BuckleSignal_RL_on SM_BuckleSignal_RR_on /end LOC_MEASUREMENT
 /begin IN_MEASUREMENT ALI_AcceleratorPedal_perc ALI_LongitudinalAccel_X_ms2 ALI_CarSpeed_kmh ALI_ReverseGearIndicator SM_BuckleSignal_FL_on SM_BuckleSignal_FR_on SM_BuckleSignal_RL_on SM_BuckleSignal_RR_on /end IN_MEASUREMENT
 /begin OUT_MEASUREMENT VS_SLR_Dr_bitfield VS_SLR_Pa_bitfield VS_SLR_Dr_2Row_bitfield VS_SLR_Pa_2Row_bitfield /end OUT_MEASUREMENT
/end FUNCTION
/begin RECORD_LAYOUT SBYTE_COL_DIRECT FNC_VALUES 1 SBYTE COLUMN_DIR DIRECT /end RECORD_LAYOUT
/begin RECORD_LAYOUT SWORD_COL_DIRECT FNC_VALUES 1 SWORD COLUMN_DIR DIRECT /end RECORD_LAYOUT
/begin RECORD_LAYOUT UBYTE_COL_DIRECT FNC_VALUES 1 UBYTE COLUMN_DIR DIRECT /end RECORD_LAYOUT
/begin RECORD_LAYOUT UWORD_COL_DIRECT FNC_VALUES 1 UWORD COLUMN_DIR DIRECT /end RECORD_LAYOUT
/end MODULE
/end PROJECT
