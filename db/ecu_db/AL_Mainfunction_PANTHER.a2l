/************************************************************************
* DESCRIPTION
* PANTHER ASAP2-file for calibration and measurement access via XCP.
* FILENAME
* ASAP2 file name: AL_Mainfunction_PANTHER.a2l
* AUTHOR
* Automatically generated by PANTHER RTI (TargetLink build)
* adcos GmbH
************************************************************************/
ASAP2_VERSION 1 61
/begin PROJECT AL_Mainfunction_PANTHER ""
/begin HEADER "ASAP2 File for PANTHER" /* Comment */ VERSION "2026-08-21 20:40:07" PROJECT_NO PRJ1 /end HEADER
/begin MODULE PANTHER "Prototyping unit for modelbased application"
/* Monitoring Variables for OS (Operating System) */
/begin MOD_PAR "Memory layout and access" VERSION "panther" SUPPLIER "adcos GmbH" CUSTOMER "" ECU "PANTHER" CPU_TYPE "ARM Cortex-M7"
 /begin MEMORY_SEGMENT BootloaderCode "Bootloader Code" CODE FLASH INTERN 0x08000000 0x00020000 -1 -1 -1 -1 -1
  /begin IF_DATA XCP
   /begin SEGMENT 0x00 0x00 0x00 0x00 0x00 /end SEGMENT
  /end IF_DATA
 /end MEMORY_SEGMENT
 /begin MEMORY_SEGMENT AppCode "Application Code" CODE FLASH INTERN 0x08020000 0x00065580 -1 -1 -1 -1 -1
  /begin IF_DATA XCP
   /begin SEGMENT 0x01 0x00 0x00 0x00 0x00 /end SEGMENT
  /end IF_DATA
 /end MEMORY_SEGMENT
 /begin MEMORY_SEGMENT AppCodeEndSequence "AppCodeEndSequence" CODE FLASH INTERN 0x081DFFE0 0x00000020 -1 -1 -1 -1 -1
  /begin IF_DATA XCP
   /begin SEGMENT 0x02 0x00 0x00 0x00 0x00 /end SEGMENT
  /end IF_DATA
 /end MEMORY_SEGMENT
 /begin MEMORY_SEGMENT DataROM "DataROM" DATA FLASH INTERN 0x08020300 0x000174c0 -1 -1 -1 -1 -1
  /begin IF_DATA XCP
   /begin SEGMENT 0x03 0x00 0x00 0x00 0x00 /begin ADDRESS_MAPPING 0x08020300 /* mapped address */ 0x24000000 0x000174c0 /end ADDRESS_MAPPING /end SEGMENT
  /end IF_DATA
 /end MEMORY_SEGMENT
 /begin MEMORY_SEGMENT DataRAM "DataRAM" DATA RAM INTERN 0x24000000 0x0002b198 -1 -1 -1 -1 -1
  /begin IF_DATA XCP
   /begin SEGMENT 0x04 0x01 0x00 0x00 0x00
    /begin PAGE /* page number */ 0x00 ECU_ACCESS_DONT_CARE XCP_READ_ACCESS_DONT_CARE XCP_WRITE_ACCESS_DONT_CARE /* segment that initialises this page: */ INIT_SEGMENT 0x03 /end PAGE
   /end SEGMENT
  /end IF_DATA
 /end MEMORY_SEGMENT
/end MOD_PAR
/begin MOD_COMMON "" ALIGNMENT_BYTE 1 ALIGNMENT_WORD 2 ALIGNMENT_LONG 4 ALIGNMENT_FLOAT32_IEEE 4 ALIGNMENT_FLOAT64_IEEE 8 BYTE_ORDER MSB_LAST DEPOSIT ABSOLUTE /end MOD_COMMON
/begin IF_DATA XCP
 /begin PROTOCOL_LAYER 0x0100 /* Driver_Version */ 0x07D0 /* Timeout1 */ 0x00C8 /* Timeout2 */ 0x0000 /* Timeout3 */ 0x0000 /* Timeout4 */ 0x0000 /* Timeout5 */ 0x0000 /* Timeout6 */ 0x0000 /* Timeout7 */ 0xFF /* XCP_MAX_CTO */ 0x00FF /* XCP_MAX_DTO */ BYTE_ORDER_MSB_LAST /* XCP_BYTE_ORDER */ ADDRESS_GRANULARITY_BYTE /* ADDRESS_GRANULARITY */ OPTIONAL_CMD SET_MTA /* OptionalCMD_SET_MTA */ OPTIONAL_CMD UPLOAD /* OptionalCMD_UPLOAD */ OPTIONAL_CMD SHORT_UPLOAD /* OptionalCMD_SHORT_UPLOAD */ OPTIONAL_CMD DOWNLOAD /* OptionalCMD_DOWNLOAD */ OPTIONAL_CMD ALLOC_ODT_ENTRY /* OptionalCMD_ALLOC_ODT_ENTRY */ OPTIONAL_CMD ALLOC_ODT /* OptionalCMD_ALLOC_ODT */ OPTIONAL_CMD ALLOC_DAQ /* OptionalCMD_ALLOC_DAQ */ OPTIONAL_CMD FREE_DAQ /* OptionalCMD_FREE_DAQ */ OPTIONAL_CMD GET_DAQ_EVENT_INFO /* OptionalCMD_GET_DAQ_EVENT_INFO */ OPTIONAL_CMD GET_DAQ_RESOLUTION_INFO /* OptionalCMD_GET_DAQ_RESOLUTION_INFO */ OPTIONAL_CMD GET_DAQ_PROCESSOR_INFO /* OptionalCMD_GET_DAQ_PROCESSOR_INFO */ OPTIONAL_CMD GET_DAQ_CLOCK /* OptionalCMD_GET_DAQ_CLOCK */ OPTIONAL_CMD START_STOP_SYNCH /* OptionalCMD_START_STOP_SYNCH */ OPTIONAL_CMD START_STOP_DAQ_LIST /* OptionalCMD_START_STOP_DAQ_LIST */ OPTIONAL_CMD GET_DAQ_LIST_MODE /* OptionalCMD_GET_DAQ_LIST_MODE */ OPTIONAL_CMD SET_DAQ_LIST_MODE /* OptionalCMD_SET_DAQ_LIST_MODE */ OPTIONAL_CMD WRITE_DAQ /* OptionalCMD_WRITE_DAQ */ OPTIONAL_CMD SET_DAQ_PTR /* OptionalCMD_SET_DAQ_PTR */ OPTIONAL_CMD GET_COMM_MODE_INFO /* OptionalCMD_GET_COMM_MODE_INFO */ /end PROTOCOL_LAYER
 /begin DAQ DYNAMIC /* DAQ_MODE */ 0 4 /* MAX_EVENT_CHANNEL */ 0 /* MIN_DAQ */ OPTIMISATION_TYPE_DEFAULT /* OPTIMISATION_TYPE */ ADDRESS_EXTENSION_FREE /* ADDRESS_EXTENSION_FREE */ IDENTIFICATION_FIELD_TYPE_ABSOLUTE /* IDENTIFICATION_FIELD_TYPE */ GRANULARITY_ODT_ENTRY_SIZE_DAQ_DWORD /* GRANULARITY_ODT_DAQ */ 0xFE /* MAX_ODT_SIZE_DAQ */ OVERLOAD_INDICATION_PID /* OVERLOAD_INDICATION_PID */ PRESCALER_SUPPORTED /* PRECALER_SUPPORTED_MODE */
  /begin STIM GRANULARITY_ODT_ENTRY_SIZE_STIM_BYTE /* GRANULARITY_ODT_ENTRY_SIZE_STIM_BYTE */ 0xFE /* STIM_PROPERTY */ /end STIM
  /begin TIMESTAMP_SUPPORTED 0x0001 /* TIMESTAMP_TICKS */ SIZE_DWORD /* TIMESTAMP_SIZE */ UNIT_10US /* TIMESTAMP_UNIT */ /end TIMESTAMP_SUPPORTED
  /begin EVENT "10ms" "10ms" 0x0000 DAQ 0x05 0x64 0x05 0x00 /end EVENT
  /begin EVENT "1ms" "1ms" 0x0001 DAQ 0x05 0x0A 0x05 0x00 /end EVENT
  /begin EVENT "200us" "200us" 0x0002 DAQ 0x05 0x02 0x05 0x00 /end EVENT
  /begin EVENT "50us" "50us" 0x0003 DAQ 0x01 0x05 0x04 /* XCP_TIMESTAMP_UNIT_10US */ 0x00 /end EVENT
  /begin EVENT "20us" "20us" 0x0004 DAQ 0x01 0x02 0x04 /* XCP_TIMESTAMP_UNIT_10US */ 0x00 /end EVENT
 /end DAQ
 /begin PAG 0x06 /* MAX_SEGMENTS */ /end PAG
 /begin PGM PGM_MODE_ABSOLUTE /* PGM_MODE_ABSOLUTE */ 0x13 /* MAX_SECTORS */ 0x00 /* MAX_CTO_PGM */ /begin SECTOR "Sector1 Bank1" 0x0 0x08020000 0x20000 0x0 0x1 0x0 /end SECTOR /begin SECTOR "Sector2 Bank1" 0x1 0x08040000 0x20000 0x2 0x3 0x0 /end SECTOR /begin SECTOR "Sector3 Bank1" 0x2 0x08060000 0x20000 0x4 0x5 0x0 /end SECTOR /begin SECTOR "Sector4 Bank1" 0x3 0x08080000 0x20000 0x6 0x7 0x0 /end SECTOR /begin SECTOR "Sector5 Bank1" 0x4 0x080A0000 0x20000 0x8 0x9 0x0 /end SECTOR /begin SECTOR "Sector6 Bank1" 0x5 0x080C0000 0x20000 0xA 0xB 0x0 /end SECTOR /begin SECTOR "Sector7 Bank1" 0x6 0x080E0000 0x20000 0xC 0xD 0x0 /end SECTOR /begin SECTOR "Sector0 Bank2" 0x7 0x08100000 0x20000 0xE 0xF 0x0 /end SECTOR /begin SECTOR "Sector1 Bank2" 0x8 0x08120000 0x20000 0x10 0x11 0x0 /end SECTOR /begin SECTOR "Sector2 Bank2" 0x9 0x08140000 0x20000 0x12 0x13 0x0 /end SECTOR /begin SECTOR "Sector3 Bank2" 0xA 0x08160000 0x20000 0x14 0x15 0x0 /end SECTOR /begin SECTOR "Sector4 Bank2" 0xB 0x08180000 0x20000 0x16 0x17 0x0 /end SECTOR /begin SECTOR "Sector5 Bank2" 0xC 0x081A0000 0x20000 0x18 0x19 0x0 /end SECTOR /begin SECTOR "Sector6 Bank2" 0xD 0x081C0000 0x20000 0x1A 0x1B 0x0 /end SECTOR /begin SECTOR "Sector7 Bank2" 0xE 0x081E0000 0x20000 0x1C 0x1D 0x0 /end SECTOR
  /begin SECTOR "FPGA Firmware Part1" 0xF 0x00000000 0x500000 0x1E 0x1F 0x0 /end SECTOR
  /begin SECTOR "FPGA Firmware Part2" 0x10 0x00500000 0x500000 0x20 0x21 0x0 /end SECTOR
  /begin SECTOR "External Flash Part1" 0x11 0x00A00000 0x300000 0x22 0x23 0x0 /end SECTOR
  /begin SECTOR "External Flash Part2" 0x12 0x00D00000 0x300000 0x24 0x25 0x0 /end SECTOR
 /end PGM
 /begin XCP_ON_UDP_IP 0x0100 /* XCP_DRIVER_VERSION */ 0x9C40 /* UDP_PORT */ ADDRESS "192.168.1.100" /* IP_ADDRESS */ /end XCP_ON_UDP_IP
/end IF_DATA
/begin CHARACTERISTIC ADAS_Retract_definition_point "" VALUE 0x2400000a UBYTE_COL_DIRECT 0 EQ_LSB_0_05 0 12.75 /end CHARACTERISTIC
/begin MEASUREMENT Abs_Value0 "" UWORD NO_COMPU_METHOD 1 100 0 65535 ECU_ADDRESS 0x24025bd8 /end MEASUREMENT
/begin MEASUREMENT Abs_Value1 "" UWORD NO_COMPU_METHOD 1 100 0 65535 ECU_ADDRESS 0x24025bd6 /end MEASUREMENT
/begin MEASUREMENT ADAS_2_ay_Limit "" SWORD EQ_LSB_0_002 1 100 -65.536 65.534 ECU_ADDRESS 0x24025be4 /end MEASUREMENT
/begin MEASUREMENT ADAS_ay_Limit "" UBYTE NO_COMPU_METHOD 1 100 0 1 ECU_ADDRESS 0x24025bc0 /end MEASUREMENT
/begin MEASUREMENT ADAS_AY_Requested "" UBYTE NO_COMPU_METHOD 1 100 0 1 ECU_ADDRESS 0x24000013 /end MEASUREMENT
/begin MEASUREMENT ADAS_exp_lateralAcceleration "" SWORD EQ_LSB_0_005 1 100 -163.84 163.835 ECU_ADDRESS 0x24026ba0 /end MEASUREMENT
/begin MEASUREMENT ADAS_Posn_Offset_FallingEdge "" SWORD NO_COMPU_METHOD 1 100 -32768 32767 ECU_ADDRESS 0x24026b96 /end MEASUREMENT
/begin MEASUREMENT ADAS_VehSpd_ms "" SWORD EQ_LSB_0_002 1 100 -65.536 65.534 ECU_ADDRESS 0x24026b98 /end MEASUREMENT
/begin MEASUREMENT ALI_BrakePressCalc "" UWORD EQ_LSB_0_01 1 100 0 655.35 ECU_ADDRESS 0x24026c6c /end MEASUREMENT
/begin MEASUREMENT ALI_YawRate_Z_degs "Yaw Rate" SWORD SMA_FNC_YawRate_Z 1 100 -327.68 327.67 ECU_ADDRESS 0x24026d9c /end MEASUREMENT
/begin MEASUREMENT Array_ADAS_Curv_Offset "" SWORD NO_COMPU_METHOD 1 100 -32768 32767 ECU_ADDRESS 0x240253e0 ARRAY_SIZE 1000 /end MEASUREMENT
/begin MEASUREMENT Array_ADAS_Curv_PathIdx "" SWORD NO_COMPU_METHOD 1 100 -32768 32767 ECU_ADDRESS 0x24025be8 ARRAY_SIZE 1000 /end MEASUREMENT
/begin MEASUREMENT Array_ADAS_Curv_Value "" SWORD NO_COMPU_METHOD 1 100 -32768 32767 ECU_ADDRESS 0x240263bc ARRAY_SIZE 1000 /end MEASUREMENT
/begin MEASUREMENT Array_ADAS_Stub_FuncRoadClass "" UBYTE NO_COMPU_METHOD 1 100 0 255 ECU_ADDRESS 0x24024bd0 ARRAY_SIZE 255 /end MEASUREMENT
/begin MEASUREMENT Array_ADAS_Stub_FuncRoadClass_1 "" UBYTE NO_COMPU_METHOD 1 100 0 255 ECU_ADDRESS 0x2402399c ARRAY_SIZE 255 /end MEASUREMENT
/begin MEASUREMENT Array_ADAS_Stub_FuncRoadClass_2 "" UBYTE NO_COMPU_METHOD 1 100 0 255 ECU_ADDRESS 0x24023a9c ARRAY_SIZE 255 /end MEASUREMENT
/begin MEASUREMENT Array_ADAS_Stub_Offset "" UWORD NO_COMPU_METHOD 1 100 0 65535 ECU_ADDRESS 0x240240b4 ARRAY_SIZE 255 /end MEASUREMENT
/begin MEASUREMENT Array_ADAS_Stub_PartRoute "" UBYTE NO_COMPU_METHOD 1 100 0 255 ECU_ADDRESS 0x240246c0 ARRAY_SIZE 255 /end MEASUREMENT
/begin MEASUREMENT Array_ADAS_Stub_PartRoute_1 "" UBYTE NO_COMPU_METHOD 1 100 0 255 ECU_ADDRESS 0x24023ca4 ARRAY_SIZE 255 /end MEASUREMENT
/begin MEASUREMENT Array_ADAS_Stub_PartRoute_2 "" UBYTE NO_COMPU_METHOD 1 100 0 255 ECU_ADDRESS 0x24023ba4 ARRAY_SIZE 255 /end MEASUREMENT
/begin MEASUREMENT Array_ADAS_Stub_PathIdx "" UBYTE NO_COMPU_METHOD 1 100 0 255 ECU_ADDRESS 0x240247c4 ARRAY_SIZE 255 /end MEASUREMENT
/begin MEASUREMENT Array_ADAS_Stub_SubPathIdx "" UBYTE NO_COMPU_METHOD 1 100 0 255 ECU_ADDRESS 0x240245bc ARRAY_SIZE 255 /end MEASUREMENT
/begin MEASUREMENT Array_ADAS_Stub_SubPathIdx_1 "" UBYTE NO_COMPU_METHOD 1 100 0 255 ECU_ADDRESS 0x240242bc ARRAY_SIZE 255 /end MEASUREMENT
/begin MEASUREMENT Array_ADAS_Stub_SubPathIdx_2 "" UBYTE NO_COMPU_METHOD 1 100 0 255 ECU_ADDRESS 0x240244bc ARRAY_SIZE 255 /end MEASUREMENT
/begin MEASUREMENT Array_ADAS_Stub_TurnAngle "" UWORD EQ_LSB_0_006 1 100 0 393.21000000000004 ECU_ADDRESS 0x24023da4 ARRAY_SIZE 255 /end MEASUREMENT
/begin MEASUREMENT Array_ADAS_Stub_TurnAngle_1 "" UWORD EQ_LSB_0_006 1 100 0 393.21000000000004 ECU_ADDRESS 0x240250d8 ARRAY_SIZE 255 /end MEASUREMENT
/begin MEASUREMENT Array_ADAS_Stub_TurnAngle_2 "" UWORD EQ_LSB_0_006 1 100 0 393.21000000000004 ECU_ADDRESS 0x24024cd4 ARRAY_SIZE 255 /end MEASUREMENT
/begin MEASUREMENT Array_ADAS_Stub_WayForm "" UBYTE NO_COMPU_METHOD 1 100 0 255 ECU_ADDRESS 0x240248c8 ARRAY_SIZE 255 /end MEASUREMENT
/begin MEASUREMENT Array_ADAS_Stub_WayForm_1 "" UBYTE NO_COMPU_METHOD 1 100 0 255 ECU_ADDRESS 0x24024fd8 ARRAY_SIZE 255 /end MEASUREMENT
/begin MEASUREMENT Array_ADAS_Stub_WayForm_2 "" UBYTE NO_COMPU_METHOD 1 100 0 255 ECU_ADDRESS 0x240252d8 ARRAY_SIZE 255 /end MEASUREMENT
/begin MEASUREMENT Array_Seg_ADAS_Seg_AreaBuildUp "" UBYTE NO_COMPU_METHOD 1 100 0 255 ECU_ADDRESS 0x240243bc ARRAY_SIZE 255 /end MEASUREMENT
/begin MEASUREMENT Array_Seg_ADAS_Seg_NumOfLaneDrvDir "" UBYTE NO_COMPU_METHOD 1 100 0 255 ECU_ADDRESS 0x24024ed8 ARRAY_SIZE 255 /end MEASUREMENT
/begin MEASUREMENT Array_Seg_ADAS_Seg_Offset "" UWORD NO_COMPU_METHOD 1 100 0 65535 ECU_ADDRESS 0x240249d0 ARRAY_SIZE 255 /end MEASUREMENT
/begin MEASUREMENT Array_Seg_ADAS_Seg_PathIdx "" UBYTE NO_COMPU_METHOD 1 100 0 255 ECU_ADDRESS 0x24023fa4 ARRAY_SIZE 255 /end MEASUREMENT
/begin MEASUREMENT check_ACR_Activation_ALO_CAN2_FL "" UBYTE NO_COMPU_METHOD 1 100 0 255 ECU_ADDRESS 0x24026bee /end MEASUREMENT
/begin MEASUREMENT check_ACR_Activation_ALO_CAN2_RL2 "" UBYTE NO_COMPU_METHOD 1 100 0 255 ECU_ADDRESS 0x24026c1c /end MEASUREMENT
/begin MEASUREMENT Curv_index_read_out "" SWORD NO_COMPU_METHOD 1 100 -32768 32767 ECU_ADDRESS 0x24025bca /end MEASUREMENT
/begin MEASUREMENT Curv_Offset_1_out "" SWORD NO_COMPU_METHOD 1 100 -32768 32767 ECU_ADDRESS 0x240263ba /end MEASUREMENT
/begin MEASUREMENT Curv_Offset_2_out "" SWORD NO_COMPU_METHOD 1 100 -32768 32767 ECU_ADDRESS 0x24025bc2 /end MEASUREMENT
/begin MEASUREMENT Curv_remind_Initial_index "" SWORD NO_COMPU_METHOD 1 100 -32768 32767 ECU_ADDRESS 0x24025bdc /end MEASUREMENT
/begin MEASUREMENT Curv_Value_1_out "" SWORD NO_COMPU_METHOD 1 100 -32768 32767 ECU_ADDRESS 0x24026b90 /end MEASUREMENT
/begin MEASUREMENT Curv_Value_2_out "" SWORD NO_COMPU_METHOD 1 100 -32768 32767 ECU_ADDRESS 0x24025bb4 /end MEASUREMENT
/begin MEASUREMENT Curvature_interpolated "" SWORD EQ_LSB_1em05 1 100 -0.32768 0.32767 ECU_ADDRESS 0x24025bc6 /end MEASUREMENT
/begin MEASUREMENT Debug_ADAS_Seg_Retr "" UBYTE NO_COMPU_METHOD 1 100 0 255 ECU_ADDRESS 0x24024ccf /end MEASUREMENT
/begin MEASUREMENT Debug_ALI_CountryCode "" UBYTE NO_COMPU_METHOD 1 100 0 255 ECU_ADDRESS 0x24026c0c /end MEASUREMENT
/begin MEASUREMENT Debug_ALI_ISw_Stat "" UBYTE NO_COMPU_METHOD 1 100 0 255 ECU_ADDRESS 0x24026d60 /end MEASUREMENT
/begin MEASUREMENT Debug_curvature_value0 "" SWORD EQ_LSB_1em05 1 100 -0.32768 0.32767 ECU_ADDRESS 0x24025bce /end MEASUREMENT
/begin MEASUREMENT Debug_curvature_value1 "" SWORD EQ_LSB_1em05 1 100 -0.32768 0.32767 ECU_ADDRESS 0x24025bcc /end MEASUREMENT
/begin MEASUREMENT Debug_E_classVersion "" UBYTE NO_COMPU_METHOD 1 100 0 255 ECU_ADDRESS 0x24026c7e /end MEASUREMENT
/begin MEASUREMENT Debug_Offset_1 "" SWORD NO_COMPU_METHOD 1 100 -32768 32767 ECU_ADDRESS 0x24026b9a /end MEASUREMENT
/begin MEASUREMENT Debug_Offset_2 "" SWORD NO_COMPU_METHOD 1 100 -32768 32767 ECU_ADDRESS 0x24026b9e /end MEASUREMENT
/begin MEASUREMENT Debug_PathChange_Control "" SWORD NO_COMPU_METHOD 1 100 -32768 32767 ECU_ADDRESS 0x24025bd4 /end MEASUREMENT
/begin MEASUREMENT Debug_transmission8km "" SWORD NO_COMPU_METHOD 1 100 -32768 32767 ECU_ADDRESS 0x24025bda /end MEASUREMENT
/begin MEASUREMENT Debug_VehAccel_X "" SWORD EQ_LSB_0_02 1 100 -655.36 655.34 ECU_ADDRESS 0x24026c8c /end MEASUREMENT
/begin MEASUREMENT Debug_VehAccel_Y "" SWORD EQ_LSB_0_02 1 100 -655.36 655.34 ECU_ADDRESS 0x24026c92 /end MEASUREMENT
/begin MEASUREMENT DebugOut_ADAS_Seg_Offset_pre "" UWORD NO_COMPU_METHOD 1 100 0 65535 ECU_ADDRESS 0x240242b8 /end MEASUREMENT
/begin MEASUREMENT DebugOut_ADAS_Seg_PathIdx_pre "" UBYTE NO_COMPU_METHOD 1 100 0 255 ECU_ADDRESS 0x240249c7 /end MEASUREMENT
/begin MEASUREMENT DEBUGOUT_ALI_ESP_deactivated "" UBYTE NO_COMPU_METHOD 1 100 0 1 ECU_ADDRESS 0x24026c86 /end MEASUREMENT
/begin MEASUREMENT DEBUGOUT_ALI_OffroadSport_activated "" UBYTE NO_COMPU_METHOD 1 100 0 1 ECU_ADDRESS 0x24026cf8 /end MEASUREMENT
/begin MEASUREMENT DEBUGOUT_ALO_COM_Status_PumaFLCan "" SWORD NO_COMPU_METHOD 1 100 -32768 32767 ECU_ADDRESS 0x24000164 /end MEASUREMENT
/begin MEASUREMENT DEBUGOUT_ALO_COM_Status_PumaFRCan "" SWORD NO_COMPU_METHOD 1 100 -32768 32767 ECU_ADDRESS 0x2400015e /end MEASUREMENT
/begin MEASUREMENT DEBUGOUT_ALO_COM_Status_PumaRL1Can "" SWORD NO_COMPU_METHOD 1 100 -32768 32767 ECU_ADDRESS 0x24000158 /end MEASUREMENT
/begin MEASUREMENT DEBUGOUT_ALO_COM_Status_PumaRL2Can "" SWORD NO_COMPU_METHOD 1 100 -32768 32767 ECU_ADDRESS 0x24000152 /end MEASUREMENT
/begin MEASUREMENT DEBUGOUT_ALO_COM_Status_PumaRR1Can "" SWORD NO_COMPU_METHOD 1 100 -32768 32767 ECU_ADDRESS 0x2400014c /end MEASUREMENT
/begin MEASUREMENT DEBUGOUT_ALO_HB_State_FR "" SWORD NO_COMPU_METHOD 1 100 -32768 32767 ECU_ADDRESS 0x24000146 /end MEASUREMENT
/begin MEASUREMENT DEBUGOUT_ALO_HB_State_RL1 "" SWORD NO_COMPU_METHOD 1 100 -32768 32767 ECU_ADDRESS 0x24000140 /end MEASUREMENT
/begin MEASUREMENT DEBUGOUT_ALO_HB_State_RL2 "" SWORD NO_COMPU_METHOD 1 100 -32768 32767 ECU_ADDRESS 0x2400013a /end MEASUREMENT
/begin MEASUREMENT DEBUGOUT_ALO_HB_State_RR1 "" SWORD NO_COMPU_METHOD 1 100 -32768 32767 ECU_ADDRESS 0x24000134 /end MEASUREMENT
/begin MEASUREMENT DEBUGOUT_ELK_Algo_Status_RL1 "" SWORD NO_COMPU_METHOD 1 100 -32768 32767 ECU_ADDRESS 0x240001ae /end MEASUREMENT
/begin MEASUREMENT DEBUGOUT_ELK_Algo_Status_RL2 "" SWORD NO_COMPU_METHOD 1 100 -32768 32767 ECU_ADDRESS 0x240001b4 /end MEASUREMENT
/begin MEASUREMENT DEBUGOUT_ELK_Algo_Status_RR1 "" SWORD NO_COMPU_METHOD 1 100 -32768 32767 ECU_ADDRESS 0x240001ba /end MEASUREMENT
/begin MEASUREMENT DEBUGOUT_ELK_ECU_Status_RL1 "" SWORD NO_COMPU_METHOD 1 100 -32768 32767 ECU_ADDRESS 0x240001c0 /end MEASUREMENT
/begin MEASUREMENT DEBUGOUT_ELK_ECU_Status_RL2 "" SWORD NO_COMPU_METHOD 1 100 -32768 32767 ECU_ADDRESS 0x240001c6 /end MEASUREMENT
/begin MEASUREMENT DEBUGOUT_ELK_ECU_Status_RR1 "" SWORD NO_COMPU_METHOD 1 100 -32768 32767 ECU_ADDRESS 0x240001cc /end MEASUREMENT
/begin MEASUREMENT DEBUGOUT_ELK_Lock_Status_RL1 "" SWORD NO_COMPU_METHOD 1 100 -32768 32767 ECU_ADDRESS 0x2400019c /end MEASUREMENT
/begin MEASUREMENT DEBUGOUT_ELK_Lock_Status_RL2 "" SWORD NO_COMPU_METHOD 1 100 -32768 32767 ECU_ADDRESS 0x240001a2 /end MEASUREMENT
/begin MEASUREMENT DEBUGOUT_ELK_Lock_Status_RR1 "" SWORD NO_COMPU_METHOD 1 100 -32768 32767 ECU_ADDRESS 0x240001a8 /end MEASUREMENT
/begin MEASUREMENT DEBUGOUT_HMI_ABL_FL_RetractRequest "" SWORD NO_COMPU_METHOD 1 100 -32768 32767 ECU_ADDRESS 0x240001fc /end MEASUREMENT
/begin MEASUREMENT DEBUGOUT_HMI_ABL_FR_RetractRequest "" SWORD NO_COMPU_METHOD 1 100 -32768 32767 ECU_ADDRESS 0x24000202 /end MEASUREMENT
/begin MEASUREMENT DEBUGOUT_HMI_ABL_RL1_RetractRequest "" SWORD NO_COMPU_METHOD 1 100 -32768 32767 ECU_ADDRESS 0x24000208 /end MEASUREMENT
/begin MEASUREMENT DEBUGOUT_HMI_ABL_RL2_RetractRequest "" SWORD NO_COMPU_METHOD 1 100 -32768 32767 ECU_ADDRESS 0x2400020e /end MEASUREMENT
/begin MEASUREMENT DEBUGOUT_HMI_ABL_RR1_RetractRequest "" SWORD NO_COMPU_METHOD 1 100 -32768 32767 ECU_ADDRESS 0x24000214 /end MEASUREMENT
/begin MEASUREMENT DEBUGOUT_HMI_ABL_Rx_Status "" SWORD NO_COMPU_METHOD 1 100 -32768 32767 ECU_ADDRESS 0x240001f6 /end MEASUREMENT
/begin MEASUREMENT DEBUGOUT_HMI_ACR_FL_RetractRequest "" SWORD NO_COMPU_METHOD 1 100 -32768 32767 ECU_ADDRESS 0x240001d8 /end MEASUREMENT
/begin MEASUREMENT DEBUGOUT_HMI_ACR_FR_RetractRequest "" SWORD NO_COMPU_METHOD 1 100 -32768 32767 ECU_ADDRESS 0x240001de /end MEASUREMENT
/begin MEASUREMENT DEBUGOUT_HMI_ACR_RL1_RetractRequest "" SWORD NO_COMPU_METHOD 1 100 -32768 32767 ECU_ADDRESS 0x240001e4 /end MEASUREMENT
/begin MEASUREMENT DEBUGOUT_HMI_ACR_RL2_RetractRequest "" SWORD NO_COMPU_METHOD 1 100 -32768 32767 ECU_ADDRESS 0x240001ea /end MEASUREMENT
/begin MEASUREMENT DEBUGOUT_HMI_ACR_RR1_RetractRequest "" SWORD NO_COMPU_METHOD 1 100 -32768 32767 ECU_ADDRESS 0x240001f0 /end MEASUREMENT
/begin MEASUREMENT DEBUGOUT_HMI_ACR_Rx_Status "" SWORD NO_COMPU_METHOD 1 100 -32768 32767 ECU_ADDRESS 0x240001d2 /end MEASUREMENT
/begin MEASUREMENT DEBUGOUT_HMI_ELK_FL_LockingRequest "" SWORD NO_COMPU_METHOD 1 100 -32768 32767 ECU_ADDRESS 0x2400022c /end MEASUREMENT
/begin MEASUREMENT DEBUGOUT_HMI_ELK_FR_LockingRequest "" SWORD NO_COMPU_METHOD 1 100 -32768 32767 ECU_ADDRESS 0x24000220 /end MEASUREMENT
/begin MEASUREMENT DEBUGOUT_HMI_ELK_ResetErrorFlags "" SWORD NO_COMPU_METHOD 1 100 -32768 32767 ECU_ADDRESS 0x2400023e /end MEASUREMENT
/begin MEASUREMENT DEBUGOUT_HMI_ELK_RL1_LockingRequest "" SWORD NO_COMPU_METHOD 1 100 -32768 32767 ECU_ADDRESS 0x24000226 /end MEASUREMENT
/begin MEASUREMENT DEBUGOUT_HMI_ELK_RL2_LockingRequest "" SWORD NO_COMPU_METHOD 1 100 -32768 32767 ECU_ADDRESS 0x24000232 /end MEASUREMENT
/begin MEASUREMENT DEBUGOUT_HMI_ELK_RR1_LockingRequest "" SWORD NO_COMPU_METHOD 1 100 -32768 32767 ECU_ADDRESS 0x24000238 /end MEASUREMENT
/begin MEASUREMENT DEBUGOUT_HMI_ELK_Rx_Status "" SWORD NO_COMPU_METHOD 1 100 -32768 32767 ECU_ADDRESS 0x2400021a /end MEASUREMENT
/begin MEASUREMENT DEBUGOUT_HMI_ISB_FL_AddressByte0_byte "" SWORD NO_COMPU_METHOD 1 100 -32768 32767 ECU_ADDRESS 0x24000274 /end MEASUREMENT
/begin MEASUREMENT DEBUGOUT_HMI_ISB_FL_AddressByte1_byte "" SWORD NO_COMPU_METHOD 1 100 -32768 32767 ECU_ADDRESS 0x2400027a /end MEASUREMENT
/begin MEASUREMENT DEBUGOUT_HMI_ISB_FL_ColorBlue_byte "" SWORD NO_COMPU_METHOD 1 100 -32768 32767 ECU_ADDRESS 0x24000250 /end MEASUREMENT
/begin MEASUREMENT DEBUGOUT_HMI_ISB_FL_ColorGreen_byte "" SWORD NO_COMPU_METHOD 1 100 -32768 32767 ECU_ADDRESS 0x2400024a /end MEASUREMENT
/begin MEASUREMENT DEBUGOUT_HMI_ISB_FL_ColorRed_byte "" SWORD NO_COMPU_METHOD 1 100 -32768 32767 ECU_ADDRESS 0x24000256 /end MEASUREMENT
/begin MEASUREMENT DEBUGOUT_HMI_ISB_FL_GroupOrModule_bool "" SWORD NO_COMPU_METHOD 1 100 -32768 32767 ECU_ADDRESS 0x2400026e /end MEASUREMENT
/begin MEASUREMENT DEBUGOUT_HMI_ISB_FL_Intensity_perc "" SWORD NO_COMPU_METHOD 1 100 -32768 32767 ECU_ADDRESS 0x2400025c /end MEASUREMENT
/begin MEASUREMENT DEBUGOUT_HMI_ISB_FL_Normalization_bool "" SWORD NO_COMPU_METHOD 1 100 -32768 32767 ECU_ADDRESS 0x24000262 /end MEASUREMENT
/begin MEASUREMENT DEBUGOUT_HMI_ISB_FL_Rx_Status "" SWORD NO_COMPU_METHOD 1 100 -32768 32767 ECU_ADDRESS 0x24000244 /end MEASUREMENT
/begin MEASUREMENT DEBUGOUT_HMI_ISB_FL_Transitionspeed_nibble "" SWORD NO_COMPU_METHOD 1 100 -32768 32767 ECU_ADDRESS 0x24000268 /end MEASUREMENT
/begin MEASUREMENT DEBUGOUT_HMI_ISB_FR_AddressByte0 "" SWORD NO_COMPU_METHOD 1 100 -32768 32767 ECU_ADDRESS 0x240002b0 /end MEASUREMENT
/begin MEASUREMENT DEBUGOUT_HMI_ISB_FR_AddressByte1 "" SWORD NO_COMPU_METHOD 1 100 -32768 32767 ECU_ADDRESS 0x240002b6 /end MEASUREMENT
/begin MEASUREMENT DEBUGOUT_HMI_ISB_FR_ColorBlue "" SWORD NO_COMPU_METHOD 1 100 -32768 32767 ECU_ADDRESS 0x2400028c /end MEASUREMENT
/begin MEASUREMENT DEBUGOUT_HMI_ISB_FR_ColorGreen "" SWORD NO_COMPU_METHOD 1 100 -32768 32767 ECU_ADDRESS 0x24000286 /end MEASUREMENT
/begin MEASUREMENT DEBUGOUT_HMI_ISB_FR_ColorRed "" SWORD NO_COMPU_METHOD 1 100 -32768 32767 ECU_ADDRESS 0x24000292 /end MEASUREMENT
/begin MEASUREMENT DEBUGOUT_HMI_ISB_FR_GroupOrModule "" SWORD NO_COMPU_METHOD 1 100 -32768 32767 ECU_ADDRESS 0x240002aa /end MEASUREMENT
/begin MEASUREMENT DEBUGOUT_HMI_ISB_FR_Intensity_perc "" SWORD NO_COMPU_METHOD 1 100 -32768 32767 ECU_ADDRESS 0x24000298 /end MEASUREMENT
/begin MEASUREMENT DEBUGOUT_HMI_ISB_FR_Normalization "" SWORD NO_COMPU_METHOD 1 100 -32768 32767 ECU_ADDRESS 0x2400029e /end MEASUREMENT
/begin MEASUREMENT DEBUGOUT_HMI_ISB_FR_Rx_Status "" SWORD NO_COMPU_METHOD 1 100 -32768 32767 ECU_ADDRESS 0x24000280 /end MEASUREMENT
/begin MEASUREMENT DEBUGOUT_HMI_ISB_FR_Transitionspeed "" SWORD NO_COMPU_METHOD 1 100 -32768 32767 ECU_ADDRESS 0x240002a4 /end MEASUREMENT
/begin MEASUREMENT DEBUGOUT_HMI_ISB_RL1_AddressByte0 "" SWORD NO_COMPU_METHOD 1 100 -32768 32767 ECU_ADDRESS 0x240002ec /end MEASUREMENT
/begin MEASUREMENT DEBUGOUT_HMI_ISB_RL1_AddressByte1 "" SWORD NO_COMPU_METHOD 1 100 -32768 32767 ECU_ADDRESS 0x240002f2 /end MEASUREMENT
/begin MEASUREMENT DEBUGOUT_HMI_ISB_RL1_ColorBlue "" SWORD NO_COMPU_METHOD 1 100 -32768 32767 ECU_ADDRESS 0x240002c8 /end MEASUREMENT
/begin MEASUREMENT DEBUGOUT_HMI_ISB_RL1_ColorGreen "" SWORD NO_COMPU_METHOD 1 100 -32768 32767 ECU_ADDRESS 0x240002c2 /end MEASUREMENT
/begin MEASUREMENT DEBUGOUT_HMI_ISB_RL1_ColorRed "" SWORD NO_COMPU_METHOD 1 100 -32768 32767 ECU_ADDRESS 0x240002ce /end MEASUREMENT
/begin MEASUREMENT DEBUGOUT_HMI_ISB_RL1_GroupOrModule "" SWORD NO_COMPU_METHOD 1 100 -32768 32767 ECU_ADDRESS 0x240002e6 /end MEASUREMENT
/begin MEASUREMENT DEBUGOUT_HMI_ISB_RL1_Intensity "" SWORD NO_COMPU_METHOD 1 100 -32768 32767 ECU_ADDRESS 0x240002d4 /end MEASUREMENT
/begin MEASUREMENT DEBUGOUT_HMI_ISB_RL1_Normalization "" SWORD NO_COMPU_METHOD 1 100 -32768 32767 ECU_ADDRESS 0x240002da /end MEASUREMENT
/begin MEASUREMENT DEBUGOUT_HMI_ISB_RL1_Rx_Status "" SWORD NO_COMPU_METHOD 1 100 -32768 32767 ECU_ADDRESS 0x240002bc /end MEASUREMENT
/begin MEASUREMENT DEBUGOUT_HMI_ISB_RL1_Transitionspeed "" SWORD NO_COMPU_METHOD 1 100 -32768 32767 ECU_ADDRESS 0x240002e0 /end MEASUREMENT
/begin MEASUREMENT DEBUGOUT_HMI_ISB_RL2_AddressByte0 "" SWORD NO_COMPU_METHOD 1 100 -32768 32767 ECU_ADDRESS 0x24000328 /end MEASUREMENT
/begin MEASUREMENT DEBUGOUT_HMI_ISB_RL2_AddressByte1 "" SWORD NO_COMPU_METHOD 1 100 -32768 32767 ECU_ADDRESS 0x2400032e /end MEASUREMENT
/begin MEASUREMENT DEBUGOUT_HMI_ISB_RL2_ColorBlue "" SWORD NO_COMPU_METHOD 1 100 -32768 32767 ECU_ADDRESS 0x24000304 /end MEASUREMENT
/begin MEASUREMENT DEBUGOUT_HMI_ISB_RL2_ColorGreen "" SWORD NO_COMPU_METHOD 1 100 -32768 32767 ECU_ADDRESS 0x240002fe /end MEASUREMENT
/begin MEASUREMENT DEBUGOUT_HMI_ISB_RL2_ColorRed "" SWORD NO_COMPU_METHOD 1 100 -32768 32767 ECU_ADDRESS 0x2400030a /end MEASUREMENT
/begin MEASUREMENT DEBUGOUT_HMI_ISB_RL2_GroupOrModule "" SWORD NO_COMPU_METHOD 1 100 -32768 32767 ECU_ADDRESS 0x24000322 /end MEASUREMENT
/begin MEASUREMENT DEBUGOUT_HMI_ISB_RL2_Intensity "" SWORD NO_COMPU_METHOD 1 100 -32768 32767 ECU_ADDRESS 0x24000310 /end MEASUREMENT
/begin MEASUREMENT DEBUGOUT_HMI_ISB_RL2_Normalization "" SWORD NO_COMPU_METHOD 1 100 -32768 32767 ECU_ADDRESS 0x24000316 /end MEASUREMENT
/begin MEASUREMENT DEBUGOUT_HMI_ISB_RL2_Rx_Status "" SWORD NO_COMPU_METHOD 1 100 -32768 32767 ECU_ADDRESS 0x240002f8 /end MEASUREMENT
/begin MEASUREMENT DEBUGOUT_HMI_ISB_RL2_Transitionspeed "" SWORD NO_COMPU_METHOD 1 100 -32768 32767 ECU_ADDRESS 0x2400031c /end MEASUREMENT
/begin MEASUREMENT DEBUGOUT_HMI_ISB_RR1_AddressByte0 "" SWORD NO_COMPU_METHOD 1 100 -32768 32767 ECU_ADDRESS 0x24000364 /end MEASUREMENT
/begin MEASUREMENT DEBUGOUT_HMI_ISB_RR1_AddressByte1 "" SWORD NO_COMPU_METHOD 1 100 -32768 32767 ECU_ADDRESS 0x2400036a /end MEASUREMENT
/begin MEASUREMENT DEBUGOUT_HMI_ISB_RR1_ColorBlue "" SWORD NO_COMPU_METHOD 1 100 -32768 32767 ECU_ADDRESS 0x24000340 /end MEASUREMENT
/begin MEASUREMENT DEBUGOUT_HMI_ISB_RR1_ColorGreen "" SWORD NO_COMPU_METHOD 1 100 -32768 32767 ECU_ADDRESS 0x2400033a /end MEASUREMENT
/begin MEASUREMENT DEBUGOUT_HMI_ISB_RR1_ColorRed "" SWORD NO_COMPU_METHOD 1 100 -32768 32767 ECU_ADDRESS 0x24000346 /end MEASUREMENT
/begin MEASUREMENT DEBUGOUT_HMI_ISB_RR1_GroupOrModule "" SWORD NO_COMPU_METHOD 1 100 -32768 32767 ECU_ADDRESS 0x2400035e /end MEASUREMENT
/begin MEASUREMENT DEBUGOUT_HMI_ISB_RR1_Intensity "" SWORD NO_COMPU_METHOD 1 100 -32768 32767 ECU_ADDRESS 0x2400034c /end MEASUREMENT
/begin MEASUREMENT DEBUGOUT_HMI_ISB_RR1_Normalization "" SWORD NO_COMPU_METHOD 1 100 -32768 32767 ECU_ADDRESS 0x24000352 /end MEASUREMENT
/begin MEASUREMENT DEBUGOUT_HMI_ISB_RR1_Rx_Status "" SWORD NO_COMPU_METHOD 1 100 -32768 32767 ECU_ADDRESS 0x24000334 /end MEASUREMENT
/begin MEASUREMENT DEBUGOUT_HMI_ISB_RR1_Transitionspeed "" SWORD NO_COMPU_METHOD 1 100 -32768 32767 ECU_ADDRESS 0x24000358 /end MEASUREMENT
/begin MEASUREMENT DEBUGOUT_HMI_SEAL_ActivationRequest "" SWORD NO_COMPU_METHOD 1 100 -32768 32767 ECU_ADDRESS 0x24000370 /end MEASUREMENT
/begin MEASUREMENT DEBUGOUT_OMS_FL_HandsOnWheel "" SWORD NO_COMPU_METHOD 1 100 -32768 32767 ECU_ADDRESS 0x24000394 /end MEASUREMENT
/begin MEASUREMENT DEBUGOUT_OMS_FL_OccupantClassification "" SWORD NO_COMPU_METHOD 1 100 -32768 32767 ECU_ADDRESS 0x2400039a /end MEASUREMENT
/begin MEASUREMENT DEBUGOUT_OMS_FL_OccupantHeightMean_cm "" SWORD NO_COMPU_METHOD 1 100 -32768 32767 ECU_ADDRESS 0x24000436 /end MEASUREMENT
/begin MEASUREMENT DEBUGOUT_OMS_FL_OccupantHeightStd_cm "" SWORD NO_COMPU_METHOD 1 100 -32768 32767 ECU_ADDRESS 0x24000430 /end MEASUREMENT
/begin MEASUREMENT DEBUGOUT_OMS_FL_OccupantPresence "" SWORD NO_COMPU_METHOD 1 100 -32768 32767 ECU_ADDRESS 0x240003b8 /end MEASUREMENT
/begin MEASUREMENT DEBUGOUT_OMS_FL_OccupantWeightMean_kg "" SWORD NO_COMPU_METHOD 1 100 -32768 32767 ECU_ADDRESS 0x240003fa /end MEASUREMENT
/begin MEASUREMENT DEBUGOUT_OMS_FL_OccupantWeightStd_kg "" SWORD NO_COMPU_METHOD 1 100 -32768 32767 ECU_ADDRESS 0x240003f4 /end MEASUREMENT
/begin MEASUREMENT DEBUGOUT_OMS_FL_OutOfPosition "" SWORD NO_COMPU_METHOD 1 100 -32768 32767 ECU_ADDRESS 0x240003d6 /end MEASUREMENT
/begin MEASUREMENT DEBUGOUT_OMS_FL_Rx_Status "" SWORD NO_COMPU_METHOD 1 100 -32768 32767 ECU_ADDRESS 0x24000376 /end MEASUREMENT
/begin MEASUREMENT DEBUGOUT_OMS_FR_OccupantClassification "" SWORD NO_COMPU_METHOD 1 100 -32768 32767 ECU_ADDRESS 0x240003a0 /end MEASUREMENT
/begin MEASUREMENT DEBUGOUT_OMS_FR_OccupantHeightMean_cm "" SWORD NO_COMPU_METHOD 1 100 -32768 32767 ECU_ADDRESS 0x24000442 /end MEASUREMENT
/begin MEASUREMENT DEBUGOUT_OMS_FR_OccupantHeightStd_cm "" SWORD NO_COMPU_METHOD 1 100 -32768 32767 ECU_ADDRESS 0x2400043c /end MEASUREMENT
/begin MEASUREMENT DEBUGOUT_OMS_FR_OccupantPresence "" SWORD NO_COMPU_METHOD 1 100 -32768 32767 ECU_ADDRESS 0x240003be /end MEASUREMENT
/begin MEASUREMENT DEBUGOUT_OMS_FR_OccupantWeightMean_kg "" SWORD NO_COMPU_METHOD 1 100 -32768 32767 ECU_ADDRESS 0x24000406 /end MEASUREMENT
/begin MEASUREMENT DEBUGOUT_OMS_FR_OccupantWeightStd_kg "" SWORD NO_COMPU_METHOD 1 100 -32768 32767 ECU_ADDRESS 0x24000400 /end MEASUREMENT
/begin MEASUREMENT DEBUGOUT_OMS_FR_OutOfPosition "" SWORD NO_COMPU_METHOD 1 100 -32768 32767 ECU_ADDRESS 0x240003dc /end MEASUREMENT
/begin MEASUREMENT DEBUGOUT_OMS_FR_Rx_Status "" SWORD NO_COMPU_METHOD 1 100 -32768 32767 ECU_ADDRESS 0x2400037c /end MEASUREMENT
/begin MEASUREMENT DEBUGOUT_OMS_RL1_OccupantClassification "" SWORD NO_COMPU_METHOD 1 100 -32768 32767 ECU_ADDRESS 0x240003a6 /end MEASUREMENT
/begin MEASUREMENT DEBUGOUT_OMS_RL1_OccupantHeightMean_cm "" SWORD NO_COMPU_METHOD 1 100 -32768 32767 ECU_ADDRESS 0x2400044e /end MEASUREMENT
/begin MEASUREMENT DEBUGOUT_OMS_RL1_OccupantHeightStd_cm "" SWORD NO_COMPU_METHOD 1 100 -32768 32767 ECU_ADDRESS 0x24000448 /end MEASUREMENT
/begin MEASUREMENT DEBUGOUT_OMS_RL1_OccupantPresence "" SWORD NO_COMPU_METHOD 1 100 -32768 32767 ECU_ADDRESS 0x240003c4 /end MEASUREMENT
/begin MEASUREMENT DEBUGOUT_OMS_RL1_OccupantWeightMean_kg "" SWORD NO_COMPU_METHOD 1 100 -32768 32767 ECU_ADDRESS 0x24000412 /end MEASUREMENT
/begin MEASUREMENT DEBUGOUT_OMS_RL1_OccupantWeightStd_kg "" SWORD NO_COMPU_METHOD 1 100 -32768 32767 ECU_ADDRESS 0x2400040c /end MEASUREMENT
/begin MEASUREMENT DEBUGOUT_OMS_RL1_OutOfPosition "" SWORD NO_COMPU_METHOD 1 100 -32768 32767 ECU_ADDRESS 0x240003e2 /end MEASUREMENT
/begin MEASUREMENT DEBUGOUT_OMS_RL1_Rx_Status "" SWORD NO_COMPU_METHOD 1 100 -32768 32767 ECU_ADDRESS 0x24000382 /end MEASUREMENT
/begin MEASUREMENT DEBUGOUT_OMS_RL2_OccupantClassification "" SWORD NO_COMPU_METHOD 1 100 -32768 32767 ECU_ADDRESS 0x240003ac /end MEASUREMENT
/begin MEASUREMENT DEBUGOUT_OMS_RL2_OccupantHeightMean_cm "" SWORD NO_COMPU_METHOD 1 100 -32768 32767 ECU_ADDRESS 0x2400045a /end MEASUREMENT
/begin MEASUREMENT DEBUGOUT_OMS_RL2_OccupantHeightStd_cm "" SWORD NO_COMPU_METHOD 1 100 -32768 32767 ECU_ADDRESS 0x24000454 /end MEASUREMENT
/begin MEASUREMENT DEBUGOUT_OMS_RL2_OccupantPresence "" SWORD NO_COMPU_METHOD 1 100 -32768 32767 ECU_ADDRESS 0x240003ca /end MEASUREMENT
/begin MEASUREMENT DEBUGOUT_OMS_RL2_OccupantWeightMean_kg "" SWORD NO_COMPU_METHOD 1 100 -32768 32767 ECU_ADDRESS 0x2400041e /end MEASUREMENT
/begin MEASUREMENT DEBUGOUT_OMS_RL2_OccupantWeightStd_kg "" SWORD NO_COMPU_METHOD 1 100 -32768 32767 ECU_ADDRESS 0x24000418 /end MEASUREMENT
/begin MEASUREMENT DEBUGOUT_OMS_RL2_OutOfPosition "" SWORD NO_COMPU_METHOD 1 100 -32768 32767 ECU_ADDRESS 0x240003e8 /end MEASUREMENT
/begin MEASUREMENT DEBUGOUT_OMS_RL2_Rx_Status "" SWORD NO_COMPU_METHOD 1 100 -32768 32767 ECU_ADDRESS 0x24000388 /end MEASUREMENT
/begin MEASUREMENT DEBUGOUT_OMS_RR1_OccupantClassification "" SWORD NO_COMPU_METHOD 1 100 -32768 32767 ECU_ADDRESS 0x240003b2 /end MEASUREMENT
/begin MEASUREMENT DEBUGOUT_OMS_RR1_OccupantHeightMean_cm "" SWORD NO_COMPU_METHOD 1 100 -32768 32767 ECU_ADDRESS 0x24000466 /end MEASUREMENT
/begin MEASUREMENT DEBUGOUT_OMS_RR1_OccupantHeightStd_cm "" SWORD NO_COMPU_METHOD 1 100 -32768 32767 ECU_ADDRESS 0x24000460 /end MEASUREMENT
/begin MEASUREMENT DEBUGOUT_OMS_RR1_OccupantPresence "" SWORD NO_COMPU_METHOD 1 100 -32768 32767 ECU_ADDRESS 0x240003d0 /end MEASUREMENT
/begin MEASUREMENT DEBUGOUT_OMS_RR1_OccupantWeightMean_kg "" SWORD NO_COMPU_METHOD 1 100 -32768 32767 ECU_ADDRESS 0x2400042a /end MEASUREMENT
/begin MEASUREMENT DEBUGOUT_OMS_RR1_OccupantWeightStd_kg "" SWORD NO_COMPU_METHOD 1 100 -32768 32767 ECU_ADDRESS 0x24000424 /end MEASUREMENT
/begin MEASUREMENT DEBUGOUT_OMS_RR1_OutOfPosition "" SWORD NO_COMPU_METHOD 1 100 -32768 32767 ECU_ADDRESS 0x240003ee /end MEASUREMENT
/begin MEASUREMENT DEBUGOUT_OMS_RR1_Rx_Status "" SWORD NO_COMPU_METHOD 1 100 -32768 32767 ECU_ADDRESS 0x2400038e /end MEASUREMENT
/begin MEASUREMENT DebugOut_Seg_actual_AreaBuildUp "" UBYTE NO_COMPU_METHOD 1 100 0 255 ECU_ADDRESS 0x24023ba2 /end MEASUREMENT
/begin MEASUREMENT DebugOut_Seg_actual_NumOfLaneDrvDir "" UBYTE NO_COMPU_METHOD 1 100 0 255 ECU_ADDRESS 0x24023da3 /end MEASUREMENT
/begin MEASUREMENT DebugOut_Seg_actual_Offset "" UWORD NO_COMPU_METHOD 1 100 0 65535 ECU_ADDRESS 0x24023b9c /end MEASUREMENT
/begin MEASUREMENT DebugOut_Seg_next_NumOfLaneDrvDir "" UBYTE NO_COMPU_METHOD 1 100 0 255 ECU_ADDRESS 0x240249cd /end MEASUREMENT
/begin MEASUREMENT DebugOut_Seg_next_Offset "" UWORD NO_COMPU_METHOD 1 100 0 65535 ECU_ADDRESS 0x240249ce /end MEASUREMENT
/begin MEASUREMENT DebugOut_Seg_next_PathIdx "" UBYTE NO_COMPU_METHOD 1 100 0 255 ECU_ADDRESS 0x240247c0 /end MEASUREMENT
/begin MEASUREMENT DebugOut_Seg_next1_NumOfLaneDrvDir "" UBYTE NO_COMPU_METHOD 1 100 0 255 ECU_ADDRESS 0x240240b0 /end MEASUREMENT
/begin MEASUREMENT DebugOut_Seg_next1_Offset "" UWORD NO_COMPU_METHOD 1 100 0 65535 ECU_ADDRESS 0x24023994 /end MEASUREMENT
/begin MEASUREMENT DebugOut_Seg_next2_Offset "" UWORD NO_COMPU_METHOD 1 100 0 65535 ECU_ADDRESS 0x24023b9e /end MEASUREMENT
/begin MEASUREMENT DebugOut_Seg_remind_initial_S_I_W "" UBYTE NO_COMPU_METHOD 1 100 0 255 ECU_ADDRESS 0x240240a8 /end MEASUREMENT
/begin MEASUREMENT DebugOut_Seg_SegIndexWriteOut "" UBYTE NO_COMPU_METHOD 1 100 0 255 ECU_ADDRESS 0x240247bf /end MEASUREMENT
/begin MEASUREMENT DebugOut_Seg_StateControl_read "" UBYTE NO_COMPU_METHOD 1 100 0 255 ECU_ADDRESS 0x240253d7 /end MEASUREMENT
/begin MEASUREMENT DebugOut_Seg_StateControl_write "" UBYTE NO_COMPU_METHOD 1 100 0 255 ECU_ADDRESS 0x240252d6 /end MEASUREMENT
/begin MEASUREMENT DebugOut_SegIndex_read "" UBYTE NO_COMPU_METHOD 1 100 0 255 ECU_ADDRESS 0x24024cd0 /end MEASUREMENT
/begin MEASUREMENT DebugOut_Stub_IndexRead "" UWORD NO_COMPU_METHOD 1 100 0 65535 ECU_ADDRESS 0x240240aa /end MEASUREMENT
/begin MEASUREMENT DebugOut_Stub_IndexWrite "" UBYTE NO_COMPU_METHOD 1 100 0 255 ECU_ADDRESS 0x240242b2 /end MEASUREMENT
/begin MEASUREMENT DebugOut_Stub_next_FuncroadClass "" UBYTE NO_COMPU_METHOD 1 100 0 255 ECU_ADDRESS 0x240249c8 /end MEASUREMENT
/begin MEASUREMENT DebugOut_Stub_next_FuncRoadClass_1 "" UBYTE NO_COMPU_METHOD 1 100 0 255 ECU_ADDRESS 0x24024cd1 /end MEASUREMENT
/begin MEASUREMENT DebugOut_Stub_next_FuncRoadClass_2 "" UBYTE NO_COMPU_METHOD 1 100 0 255 ECU_ADDRESS 0x24024ed3 /end MEASUREMENT
/begin MEASUREMENT DebugOut_Stub_next_FuncRoadClass_3 "" UBYTE NO_COMPU_METHOD 1 100 0 255 ECU_ADDRESS 0x24024ed4 /end MEASUREMENT
/begin MEASUREMENT DebugOut_Stub_next_FuncRoadClass_4 "" UBYTE NO_COMPU_METHOD 1 100 0 255 ECU_ADDRESS 0x24024ed2 /end MEASUREMENT
/begin MEASUREMENT DebugOut_Stub_next_Offset "" UWORD NO_COMPU_METHOD 1 100 0 65535 ECU_ADDRESS 0x240249ca /end MEASUREMENT
/begin MEASUREMENT DebugOut_Stub_next_PartRoute "" UBYTE NO_COMPU_METHOD 1 100 0 255 ECU_ADDRESS 0x240248c3 /end MEASUREMENT
/begin MEASUREMENT DebugOut_Stub_next_PartRoute_1 "" UBYTE NO_COMPU_METHOD 1 100 0 255 ECU_ADDRESS 0x24023998 /end MEASUREMENT
/begin MEASUREMENT DebugOut_Stub_next_PartRoute_2 "" UBYTE NO_COMPU_METHOD 1 100 0 255 ECU_ADDRESS 0x24023997 /end MEASUREMENT
/begin MEASUREMENT DebugOut_Stub_next_PartRoute_3 "" UBYTE NO_COMPU_METHOD 1 100 0 255 ECU_ADDRESS 0x24023ba0 /end MEASUREMENT
/begin MEASUREMENT DebugOut_Stub_next_PartRoute_4 "" UBYTE NO_COMPU_METHOD 1 100 0 255 ECU_ADDRESS 0x24023ba1 /end MEASUREMENT
/begin MEASUREMENT DebugOut_Stub_next_PathIdx "" UBYTE NO_COMPU_METHOD 1 100 0 255 ECU_ADDRESS 0x24023996 /end MEASUREMENT
/begin MEASUREMENT DebugOut_Stub_next_SubPathIdx "" UBYTE NO_COMPU_METHOD 1 100 0 255 ECU_ADDRESS 0x240246bc /end MEASUREMENT
/begin MEASUREMENT DebugOut_Stub_next_SubPathIdx_1 "" UBYTE NO_COMPU_METHOD 1 100 0 255 ECU_ADDRESS 0x240242b6 /end MEASUREMENT
/begin MEASUREMENT DebugOut_Stub_next_SubPathIdx_2 "" UBYTE NO_COMPU_METHOD 1 100 0 255 ECU_ADDRESS 0x240242b4 /end MEASUREMENT
/begin MEASUREMENT DebugOut_Stub_next_SubPathIdx_3 "" UBYTE NO_COMPU_METHOD 1 100 0 255 ECU_ADDRESS 0x240242b3 /end MEASUREMENT
/begin MEASUREMENT DebugOut_Stub_next_SubPathIdx_4 "" UBYTE NO_COMPU_METHOD 1 100 0 255 ECU_ADDRESS 0x240242b5 /end MEASUREMENT
/begin MEASUREMENT DebugOut_Stub_next_TurnAngle "" UWORD EQ_LSB_0_006 1 100 0 393.21000000000004 ECU_ADDRESS 0x240248c4 /end MEASUREMENT
/begin MEASUREMENT DebugOut_Stub_next_TurnAngle_1 "" UWORD EQ_LSB_0_006 1 100 0 393.21000000000004 ECU_ADDRESS 0x240240a6 /end MEASUREMENT
/begin MEASUREMENT DebugOut_Stub_next_TurnAngle_2 "" UWORD EQ_LSB_0_006 1 100 0 393.21000000000004 ECU_ADDRESS 0x240240a4 /end MEASUREMENT
/begin MEASUREMENT DebugOut_Stub_next_TurnAngle_3 "" UWORD EQ_LSB_0_006 1 100 0 393.21000000000004 ECU_ADDRESS 0x240240ae /end MEASUREMENT
/begin MEASUREMENT DebugOut_Stub_next_TurnAngle_4 "" UWORD EQ_LSB_0_006 1 100 0 393.21000000000004 ECU_ADDRESS 0x240240ac /end MEASUREMENT
/begin MEASUREMENT DebugOut_Stub_next_WayForm "" UBYTE NO_COMPU_METHOD 1 100 0 255 ECU_ADDRESS 0x24023ba3 /end MEASUREMENT
/begin MEASUREMENT DebugOut_Stub_next_WayForm_1 "" UBYTE NO_COMPU_METHOD 1 100 0 255 ECU_ADDRESS 0x24023990 /end MEASUREMENT
/begin MEASUREMENT DebugOut_Stub_next_WayForm_2 "" UBYTE NO_COMPU_METHOD 1 100 0 255 ECU_ADDRESS 0x24023992 /end MEASUREMENT
/begin MEASUREMENT DebugOut_Stub_next_WayForm_3 "" UBYTE NO_COMPU_METHOD 1 100 0 255 ECU_ADDRESS 0x24023993 /end MEASUREMENT
/begin MEASUREMENT DebugOut_Stub_next_WayForm_4 "" UBYTE NO_COMPU_METHOD 1 100 0 255 ECU_ADDRESS 0x24023991 /end MEASUREMENT
/begin MEASUREMENT DebugOut_Stub_remind_initial_S_I_W "" UWORD NO_COMPU_METHOD 1 100 0 65535 ECU_ADDRESS 0x240253d8 /end MEASUREMENT
/begin MEASUREMENT DebugOut_Stub_StateControl_read "" UBYTE NO_COMPU_METHOD 1 100 0 255 ECU_ADDRESS 0x240246bb /end MEASUREMENT
/begin MEASUREMENT DebugOut_Stub_StateControl_write "" UBYTE NO_COMPU_METHOD 1 100 0 255 ECU_ADDRESS 0x240249cc /end MEASUREMENT
/begin MEASUREMENT Debugout_TurnLane_detected "" UBYTE NO_COMPU_METHOD 1 100 0 1 ECU_ADDRESS 0x24000008 /end MEASUREMENT
/begin MEASUREMENT fill_Iter_out "" SWORD NO_COMPU_METHOD 1 100 -32768 32767 ECU_ADDRESS 0x24026b9c /end MEASUREMENT
/begin MEASUREMENT index_out "" SWORD NO_COMPU_METHOD 1 100 -32768 32767 ECU_ADDRESS 0x24025bd2 /end MEASUREMENT
/begin MEASUREMENT panther_can1_in.asw_in_can1_0x20_VCLASS_CentrLockSys_Status "CAN1 receive signal 15" UBYTE NO_COMPU_METHOD 1 100 0 4 ECU_ADDRESS 0x24026fa4 SYMBOL_LINK "panther_can1_in" 64 /end MEASUREMENT
/begin MEASUREMENT panther_can1_in.asw_in_can1_0x20_VCLASS_CountryCode "CAN1 receive signal 12" UBYTE NO_COMPU_METHOD 1 100 0 255 ECU_ADDRESS 0x24026fa1 SYMBOL_LINK "panther_can1_in" 61 /end MEASUREMENT
/begin MEASUREMENT panther_can1_in.asw_in_can1_0x20_VCLASS_EmergencyFlasher_on "CAN1 receive signal 11" UBYTE NO_COMPU_METHOD 1 100 0 1 ECU_ADDRESS 0x24026fa0 SYMBOL_LINK "panther_can1_in" 60 /end MEASUREMENT
/begin MEASUREMENT panther_can1_in.asw_in_can1_0x20_VCLASS_FL_DoorHndlStatus "CAN1 receive signal 5" UBYTE NO_COMPU_METHOD 1 100 0 1 ECU_ADDRESS 0x24026f9a SYMBOL_LINK "panther_can1_in" 54 /end MEASUREMENT
/begin MEASUREMENT panther_can1_in.asw_in_can1_0x20_VCLASS_FL_DoorStatus "CAN1 receive signal 1" UBYTE NO_COMPU_METHOD 1 100 0 2 ECU_ADDRESS 0x24026f96 SYMBOL_LINK "panther_can1_in" 50 /end MEASUREMENT
/begin MEASUREMENT panther_can1_in.asw_in_can1_0x20_VCLASS_FR_DoorHndlStatus "CAN1 receive signal 6" UBYTE NO_COMPU_METHOD 1 100 0 1 ECU_ADDRESS 0x24026f9b SYMBOL_LINK "panther_can1_in" 55 /end MEASUREMENT
/begin MEASUREMENT panther_can1_in.asw_in_can1_0x20_VCLASS_FR_DoorStatus "CAN1 receive signal 2" UBYTE NO_COMPU_METHOD 1 100 0 2 ECU_ADDRESS 0x24026f97 SYMBOL_LINK "panther_can1_in" 51 /end MEASUREMENT
/begin MEASUREMENT panther_can1_in.asw_in_can1_0x20_VCLASS_Lt_BlindSpWarn_on "CAN1 receive signal 13" UBYTE NO_COMPU_METHOD 1 100 0 2 ECU_ADDRESS 0x24026fa2 SYMBOL_LINK "panther_can1_in" 62 /end MEASUREMENT
/begin MEASUREMENT panther_can1_in.asw_in_can1_0x20_VCLASS_Lt_TurnIndicator_on "CAN1 receive signal 9" UBYTE NO_COMPU_METHOD 1 100 0 1 ECU_ADDRESS 0x24026f9e SYMBOL_LINK "panther_can1_in" 58 /end MEASUREMENT
/begin MEASUREMENT panther_can1_in.asw_in_can1_0x20_VCLASS_RL_DoorHndlStatus "CAN1 receive signal 7" UBYTE NO_COMPU_METHOD 1 100 0 1 ECU_ADDRESS 0x24026f9c SYMBOL_LINK "panther_can1_in" 56 /end MEASUREMENT
/begin MEASUREMENT panther_can1_in.asw_in_can1_0x20_VCLASS_RL_DoorStatus "CAN1 receive signal 3" UBYTE NO_COMPU_METHOD 1 100 0 2 ECU_ADDRESS 0x24026f98 SYMBOL_LINK "panther_can1_in" 52 /end MEASUREMENT
/begin MEASUREMENT panther_can1_in.asw_in_can1_0x20_VCLASS_RR_DoorHndlStatus "CAN1 receive signal 8" UBYTE NO_COMPU_METHOD 1 100 0 1 ECU_ADDRESS 0x24026f9d SYMBOL_LINK "panther_can1_in" 57 /end MEASUREMENT
/begin MEASUREMENT panther_can1_in.asw_in_can1_0x20_VCLASS_RR_DoorStatus "CAN1 receive signal 4" UBYTE NO_COMPU_METHOD 1 100 0 2 ECU_ADDRESS 0x24026f99 SYMBOL_LINK "panther_can1_in" 53 /end MEASUREMENT
/begin MEASUREMENT panther_can1_in.asw_in_can1_0x20_VCLASS_Rt_BlindSpWarn_on "CAN1 receive signal 14" UBYTE NO_COMPU_METHOD 1 100 0 2 ECU_ADDRESS 0x24026fa3 SYMBOL_LINK "panther_can1_in" 63 /end MEASUREMENT
/begin MEASUREMENT panther_can1_in.asw_in_can1_0x20_VCLASS_Rt_TurnIndicator_on "CAN1 receive signal 10" UBYTE NO_COMPU_METHOD 1 100 0 1 ECU_ADDRESS 0x24026f9f SYMBOL_LINK "panther_can1_in" 59 /end MEASUREMENT
/begin MEASUREMENT panther_can1_in.asw_in_can1_0x30_VCLASS_AccelPdlPos_perc "CAN1 receive signal 1" FLOAT32_IEEE NO_COMPU_METHOD 1 100 0 100 ECU_ADDRESS 0x24026f7c SYMBOL_LINK "panther_can1_in" 24 /end MEASUREMENT
/begin MEASUREMENT panther_can1_in.asw_in_can1_0x30_VCLASS_BrakeTrqDriver_Nm "CAN1 receive signal 2" FLOAT32_IEEE NO_COMPU_METHOD 1 100 0 24570 ECU_ADDRESS 0x24026f80 SYMBOL_LINK "panther_can1_in" 28 /end MEASUREMENT
/begin MEASUREMENT panther_can1_in.asw_in_can1_0x30_VCLASS_DriveMode "CAN1 receive signal 5" UBYTE NO_COMPU_METHOD 1 100 1 13 ECU_ADDRESS 0x24026f8c SYMBOL_LINK "panther_can1_in" 40 /end MEASUREMENT
/begin MEASUREMENT panther_can1_in.asw_in_can1_0x30_VCLASS_DriverTakesCtrlRq "CAN1 receive signal 13" UBYTE NO_COMPU_METHOD 1 100 0 5 ECU_ADDRESS 0x24026f94 SYMBOL_LINK "panther_can1_in" 48 /end MEASUREMENT
/begin MEASUREMENT panther_can1_in.asw_in_can1_0x30_VCLASS_ESPStatus "CAN1 receive signal 3" UBYTE NO_COMPU_METHOD 1 100 0 6 ECU_ADDRESS 0x24026f84 SYMBOL_LINK "panther_can1_in" 32 /end MEASUREMENT
/begin MEASUREMENT panther_can1_in.asw_in_can1_0x30_VCLASS_FL_BuckleStatus "CAN1 receive signal 7" UBYTE NO_COMPU_METHOD 1 100 0 2 ECU_ADDRESS 0x24026f8e SYMBOL_LINK "panther_can1_in" 42 /end MEASUREMENT
/begin MEASUREMENT panther_can1_in.asw_in_can1_0x30_VCLASS_FR_BuckleStatus "CAN1 receive signal 8" UBYTE NO_COMPU_METHOD 1 100 0 2 ECU_ADDRESS 0x24026f8f SYMBOL_LINK "panther_can1_in" 43 /end MEASUREMENT
/begin MEASUREMENT panther_can1_in.asw_in_can1_0x30_VCLASS_IgnitionStatus "CAN1 receive signal 6" UBYTE NO_COMPU_METHOD 1 100 0 5 ECU_ADDRESS 0x24026f8d SYMBOL_LINK "panther_can1_in" 41 /end MEASUREMENT
/begin MEASUREMENT panther_can1_in.asw_in_can1_0x30_VCLASS_R1_BuckleStatus "CAN1 receive signal 9" UBYTE NO_COMPU_METHOD 1 100 0 2 ECU_ADDRESS 0x24026f90 SYMBOL_LINK "panther_can1_in" 44 /end MEASUREMENT
/begin MEASUREMENT panther_can1_in.asw_in_can1_0x30_VCLASS_R2_BuckleStatus "CAN1 receive signal 10" UBYTE NO_COMPU_METHOD 1 100 0 2 ECU_ADDRESS 0x24026f91 SYMBOL_LINK "panther_can1_in" 45 /end MEASUREMENT
/begin MEASUREMENT panther_can1_in.asw_in_can1_0x30_VCLASS_RR1_BuckleStatus "CAN1 receive signal 11" UBYTE NO_COMPU_METHOD 1 100 0 2 ECU_ADDRESS 0x24026f92 SYMBOL_LINK "panther_can1_in" 46 /end MEASUREMENT
/begin MEASUREMENT panther_can1_in.asw_in_can1_0x30_VCLASS_TransmissionSelector "CAN1 receive signal 12" UBYTE NO_COMPU_METHOD 1 100 0 4 ECU_ADDRESS 0x24026f93 SYMBOL_LINK "panther_can1_in" 47 /end MEASUREMENT
/begin MEASUREMENT panther_can1_in.asw_in_can1_0x30_VCLASS_WheelAngle_deg "CAN1 receive signal 4" FLOAT32_IEEE NO_COMPU_METHOD 1 100 -81.92 81.91 ECU_ADDRESS 0x24026f88 SYMBOL_LINK "panther_can1_in" 36 /end MEASUREMENT
/begin MEASUREMENT panther_can1_in.asw_in_can1_0x40_VCLASS_Acceleration_X_ms2 "CAN1 receive signal 2" FLOAT32_IEEE NO_COMPU_METHOD 1 100 -40.96 40.92 ECU_ADDRESS 0x24026f6c SYMBOL_LINK "panther_can1_in" 8 /end MEASUREMENT
/begin MEASUREMENT panther_can1_in.asw_in_can1_0x40_VCLASS_Acceleration_Y_ms2 "CAN1 receive signal 1" FLOAT32_IEEE NO_COMPU_METHOD 1 100 -10.24 10.2 ECU_ADDRESS 0x24026f68 SYMBOL_LINK "panther_can1_in" 4 /end MEASUREMENT
/begin MEASUREMENT panther_can1_in.asw_in_can1_0x40_VCLASS_LaneDepBrkReqStatus "CAN1 receive signal 5" UBYTE NO_COMPU_METHOD 1 100 0 2 ECU_ADDRESS 0x24026f78 SYMBOL_LINK "panther_can1_in" 20 /end MEASUREMENT
/begin MEASUREMENT panther_can1_in.asw_in_can1_0x40_VCLASS_VehicleSpeed_kmh "CAN1 receive signal 4" FLOAT32_IEEE NO_COMPU_METHOD 1 100 0 409.4 ECU_ADDRESS 0x24026f74 SYMBOL_LINK "panther_can1_in" 16 /end MEASUREMENT
/begin MEASUREMENT panther_can1_in.asw_in_can1_0x40_VCLASS_YawRate_degs "CAN1 receive signal 3" FLOAT32_IEEE NO_COMPU_METHOD 1 100 -327.68 327.66 ECU_ADDRESS 0x24026f70 SYMBOL_LINK "panther_can1_in" 12 /end MEASUREMENT
/begin MEASUREMENT panther_can2_in.asw_in_can2_0x188_ACR_FL_ActivationLevelStatus "CAN2 receive signal 1" UBYTE NO_COMPU_METHOD 1 100 0 255 ECU_ADDRESS 0x24027018 SYMBOL_LINK "panther_can2_in" 48 /end MEASUREMENT
/begin MEASUREMENT panther_can2_in.asw_in_can2_0x188_ACR_FL_ActivationPhase "CAN2 receive signal 2" UBYTE NO_COMPU_METHOD 1 100 0 255 ECU_ADDRESS 0x24027019 SYMBOL_LINK "panther_can2_in" 49 /end MEASUREMENT
/begin MEASUREMENT panther_can2_in.asw_in_can2_0x189_ACR_FR_ActivationLevelStatus "CAN2 receive signal 1" UBYTE NO_COMPU_METHOD 1 100 0 255 ECU_ADDRESS 0x24027014 SYMBOL_LINK "panther_can2_in" 44 /end MEASUREMENT
/begin MEASUREMENT panther_can2_in.asw_in_can2_0x189_ACR_FR_ActivationPhase "CAN2 receive signal 2" UBYTE NO_COMPU_METHOD 1 100 0 255 ECU_ADDRESS 0x24027015 SYMBOL_LINK "panther_can2_in" 45 /end MEASUREMENT
/begin MEASUREMENT panther_can2_in.asw_in_can2_0x18A_ACR_RL1_ActivationLevelStatus "CAN2 receive signal 1" UBYTE NO_COMPU_METHOD 1 100 0 255 ECU_ADDRESS 0x24027010 SYMBOL_LINK "panther_can2_in" 40 /end MEASUREMENT
/begin MEASUREMENT panther_can2_in.asw_in_can2_0x18A_ACR_RL1_ActivationPhase "CAN2 receive signal 2" UBYTE NO_COMPU_METHOD 1 100 0 255 ECU_ADDRESS 0x24027011 SYMBOL_LINK "panther_can2_in" 41 /end MEASUREMENT
/begin MEASUREMENT panther_can2_in.asw_in_can2_0x18B_ACR_RL2_ActivationLevelStatus "CAN2 receive signal 1" UBYTE NO_COMPU_METHOD 1 100 0 255 ECU_ADDRESS 0x2402700c SYMBOL_LINK "panther_can2_in" 36 /end MEASUREMENT
/begin MEASUREMENT panther_can2_in.asw_in_can2_0x18B_ACR_RL2_ActivationPhase "CAN2 receive signal 2" UBYTE NO_COMPU_METHOD 1 100 0 255 ECU_ADDRESS 0x2402700d SYMBOL_LINK "panther_can2_in" 37 /end MEASUREMENT
/begin MEASUREMENT panther_can2_in.asw_in_can2_0x18C_ACR_RR1_ActivationLevelStatus "CAN2 receive signal 1" UBYTE NO_COMPU_METHOD 1 100 0 255 ECU_ADDRESS 0x24027008 SYMBOL_LINK "panther_can2_in" 32 /end MEASUREMENT
/begin MEASUREMENT panther_can2_in.asw_in_can2_0x18C_ACR_RR1_ActivationPhase "CAN2 receive signal 2" UBYTE NO_COMPU_METHOD 1 100 0 255 ECU_ADDRESS 0x24027009 SYMBOL_LINK "panther_can2_in" 33 /end MEASUREMENT
/begin MEASUREMENT panther_can2_in.asw_in_can2_0x190_WMS_FL_SensorStatus_bool "CAN2 receive signal 3" UBYTE NO_COMPU_METHOD 1 100 0 7 ECU_ADDRESS 0x24027006 SYMBOL_LINK "panther_can2_in" 30 /end MEASUREMENT
/begin MEASUREMENT panther_can2_in.asw_in_can2_0x190_WMS_FL_SpoolAngle_deg "CAN2 receive signal 2" UWORD NO_COMPU_METHOD 1 100 0 16383 ECU_ADDRESS 0x24027004 SYMBOL_LINK "panther_can2_in" 28 /end MEASUREMENT
/begin MEASUREMENT panther_can2_in.asw_in_can2_0x190_WMS_FL_WebbingMovement "CAN2 receive signal 1" UWORD NO_COMPU_METHOD 1 100 0 8191 ECU_ADDRESS 0x24027002 SYMBOL_LINK "panther_can2_in" 26 /end MEASUREMENT
/begin MEASUREMENT panther_can2_in.asw_in_can2_0x191_WMS_FR_SensorStatus "CAN2 receive signal 3" UBYTE NO_COMPU_METHOD 1 100 0 7 ECU_ADDRESS 0x24027000 SYMBOL_LINK "panther_can2_in" 24 /end MEASUREMENT
/begin MEASUREMENT panther_can2_in.asw_in_can2_0x191_WMS_FR_SpoolAngle "CAN2 receive signal 2" UWORD NO_COMPU_METHOD 1 100 0 16383 ECU_ADDRESS 0x24026ffe SYMBOL_LINK "panther_can2_in" 22 /end MEASUREMENT
/begin MEASUREMENT panther_can2_in.asw_in_can2_0x191_WMS_FR_WebbingMovement "CAN2 receive signal 1" UWORD NO_COMPU_METHOD 1 100 0 8191 ECU_ADDRESS 0x24026ffc SYMBOL_LINK "panther_can2_in" 20 /end MEASUREMENT
/begin MEASUREMENT panther_can2_in.asw_in_can2_0x192_WMS_RL1_SensorStatus "CAN2 receive signal 3" UBYTE NO_COMPU_METHOD 1 100 0 7 ECU_ADDRESS 0x24026ffa SYMBOL_LINK "panther_can2_in" 18 /end MEASUREMENT
/begin MEASUREMENT panther_can2_in.asw_in_can2_0x192_WMS_RL1_SpoolAngle "CAN2 receive signal 2" UWORD NO_COMPU_METHOD 1 100 0 16383 ECU_ADDRESS 0x24026ff8 SYMBOL_LINK "panther_can2_in" 16 /end MEASUREMENT
/begin MEASUREMENT panther_can2_in.asw_in_can2_0x192_WMS_RL1_WebbingMovement "CAN2 receive signal 1" UWORD NO_COMPU_METHOD 1 100 0 8191 ECU_ADDRESS 0x24026ff6 SYMBOL_LINK "panther_can2_in" 14 /end MEASUREMENT
/begin MEASUREMENT panther_can2_in.asw_in_can2_0x193_WMS_RL2_SensorStatus "CAN2 receive signal 3" UBYTE NO_COMPU_METHOD 1 100 0 7 ECU_ADDRESS 0x24026ff4 SYMBOL_LINK "panther_can2_in" 12 /end MEASUREMENT
/begin MEASUREMENT panther_can2_in.asw_in_can2_0x193_WMS_RL2_SpoolAngle "CAN2 receive signal 2" UWORD NO_COMPU_METHOD 1 100 0 16383 ECU_ADDRESS 0x24026ff2 SYMBOL_LINK "panther_can2_in" 10 /end MEASUREMENT
/begin MEASUREMENT panther_can2_in.asw_in_can2_0x193_WMS_RL2_WebbingMovement "CAN2 receive signal 1" UWORD NO_COMPU_METHOD 1 100 0 8191 ECU_ADDRESS 0x24026ff0 SYMBOL_LINK "panther_can2_in" 8 /end MEASUREMENT
/begin MEASUREMENT panther_can2_in.asw_in_can2_0x194_WMS_RR1_SensorStatus "CAN2 receive signal 3" UBYTE NO_COMPU_METHOD 1 100 0 7 ECU_ADDRESS 0x24026fee SYMBOL_LINK "panther_can2_in" 6 /end MEASUREMENT
/begin MEASUREMENT panther_can2_in.asw_in_can2_0x194_WMS_RR1_SpoolAngle "CAN2 receive signal 2" UWORD NO_COMPU_METHOD 1 100 0 16383 ECU_ADDRESS 0x24026fec SYMBOL_LINK "panther_can2_in" 4 /end MEASUREMENT
/begin MEASUREMENT panther_can2_in.asw_in_can2_0x194_WMS_RR1_WebbingMovement "CAN2 receive signal 1" UWORD NO_COMPU_METHOD 1 100 0 8191 ECU_ADDRESS 0x24026fea SYMBOL_LINK "panther_can2_in" 2 /end MEASUREMENT
/begin MEASUREMENT panther_can2_in.asw_in_can2_0x199_BSW_FL_BuckleStatus "CAN2 receive signal 1" UBYTE NO_COMPU_METHOD 1 100 0 1 ECU_ADDRESS 0x24027030 SYMBOL_LINK "panther_can2_in" 72 /end MEASUREMENT
/begin MEASUREMENT panther_can2_in.asw_in_can2_0x199_BSW_FR_BuckleStatus "CAN2 receive signal 2" UBYTE NO_COMPU_METHOD 1 100 0 1 ECU_ADDRESS 0x24027031 SYMBOL_LINK "panther_can2_in" 73 /end MEASUREMENT
/begin MEASUREMENT panther_can2_in.asw_in_can2_0x199_BSW_RL1_BuckleStatus "CAN2 receive signal 3" UBYTE NO_COMPU_METHOD 1 100 0 1 ECU_ADDRESS 0x24027032 SYMBOL_LINK "panther_can2_in" 74 /end MEASUREMENT
/begin MEASUREMENT panther_can2_in.asw_in_can2_0x199_BSW_RL2_BuckleStatus "CAN2 receive signal 4" UBYTE NO_COMPU_METHOD 1 100 0 1 ECU_ADDRESS 0x24027033 SYMBOL_LINK "panther_can2_in" 75 /end MEASUREMENT
/begin MEASUREMENT panther_can2_in.asw_in_can2_0x199_BSW_RR1_BuckleStatus "CAN2 receive signal 5" UBYTE NO_COMPU_METHOD 1 100 0 1 ECU_ADDRESS 0x24027034 SYMBOL_LINK "panther_can2_in" 76 /end MEASUREMENT
/begin MEASUREMENT panther_can2_in.asw_in_can2_0xC1_STS_BDS_FL_DataByte1 "CAN2 receive signal 1" UBYTE NO_COMPU_METHOD 1 100 0 255 ECU_ADDRESS 0x24027037 SYMBOL_LINK "panther_can2_in" 79 /end MEASUREMENT
/begin MEASUREMENT panther_can2_in.asw_in_can2_0xC1_STS_BDS_FL_DataByte2 "CAN2 receive signal 2" UBYTE NO_COMPU_METHOD 1 100 0 255 ECU_ADDRESS 0x24027038 SYMBOL_LINK "panther_can2_in" 80 /end MEASUREMENT
/begin MEASUREMENT panther_can2_in.asw_in_can2_0xC1_STS_BDS_FL_DataByte3 "CAN2 receive signal 3" UBYTE NO_COMPU_METHOD 1 100 0 255 ECU_ADDRESS 0x24027039 SYMBOL_LINK "panther_can2_in" 81 /end MEASUREMENT
/begin MEASUREMENT panther_can2_in.asw_in_can2_0xC1_STS_BDS_FL_DataByte4 "CAN2 receive signal 4" UBYTE NO_COMPU_METHOD 1 100 0 255 ECU_ADDRESS 0x2402703a SYMBOL_LINK "panther_can2_in" 82 /end MEASUREMENT
/begin MEASUREMENT panther_can2_in.asw_in_can2_0xC1_STS_BDS_FL_DataByte5 "CAN2 receive signal 5" UBYTE NO_COMPU_METHOD 1 100 0 255 ECU_ADDRESS 0x2402703b SYMBOL_LINK "panther_can2_in" 83 /end MEASUREMENT
/begin MEASUREMENT panther_can2_in.asw_in_can2_0xC1_STS_BDS_FL_DataByte6 "CAN2 receive signal 6" UBYTE NO_COMPU_METHOD 1 100 0 255 ECU_ADDRESS 0x2402703c SYMBOL_LINK "panther_can2_in" 84 /end MEASUREMENT
/begin MEASUREMENT panther_can2_in.asw_in_can2_0xC1_STS_BDS_FL_DataByte7 "CAN2 receive signal 7" UBYTE NO_COMPU_METHOD 1 100 0 255 ECU_ADDRESS 0x2402703d SYMBOL_LINK "panther_can2_in" 85 /end MEASUREMENT
/begin MEASUREMENT panther_can2_in.asw_in_can2_0xC1_STS_BDS_FL_DataByte8 "CAN2 receive signal 8" UBYTE NO_COMPU_METHOD 1 100 0 255 ECU_ADDRESS 0x2402703e SYMBOL_LINK "panther_can2_in" 86 /end MEASUREMENT
/begin MEASUREMENT panther_can2_in.asw_in_can2_0xC2_STS_BDS_FL_DataByte10 "CAN2 receive signal 2" UBYTE NO_COMPU_METHOD 1 100 0 255 ECU_ADDRESS 0x24027041 SYMBOL_LINK "panther_can2_in" 89 /end MEASUREMENT
/begin MEASUREMENT panther_can2_in.asw_in_can2_0xC2_STS_BDS_FL_DataByte11 "CAN2 receive signal 3" UBYTE NO_COMPU_METHOD 1 100 0 255 ECU_ADDRESS 0x24027042 SYMBOL_LINK "panther_can2_in" 90 /end MEASUREMENT
/begin MEASUREMENT panther_can2_in.asw_in_can2_0xC2_STS_BDS_FL_DataByte12 "CAN2 receive signal 4" UBYTE NO_COMPU_METHOD 1 100 0 255 ECU_ADDRESS 0x24027043 SYMBOL_LINK "panther_can2_in" 91 /end MEASUREMENT
/begin MEASUREMENT panther_can2_in.asw_in_can2_0xC2_STS_BDS_FL_DataByte13 "CAN2 receive signal 5" UBYTE NO_COMPU_METHOD 1 100 0 255 ECU_ADDRESS 0x24027044 SYMBOL_LINK "panther_can2_in" 92 /end MEASUREMENT
/begin MEASUREMENT panther_can2_in.asw_in_can2_0xC2_STS_BDS_FL_DataByte14 "CAN2 receive signal 6" UBYTE NO_COMPU_METHOD 1 100 0 255 ECU_ADDRESS 0x24027045 SYMBOL_LINK "panther_can2_in" 93 /end MEASUREMENT
/begin MEASUREMENT panther_can2_in.asw_in_can2_0xC2_STS_BDS_FL_DataByte15 "CAN2 receive signal 7" UBYTE NO_COMPU_METHOD 1 100 0 255 ECU_ADDRESS 0x24027046 SYMBOL_LINK "panther_can2_in" 94 /end MEASUREMENT
/begin MEASUREMENT panther_can2_in.asw_in_can2_0xC2_STS_BDS_FL_DataByte16 "CAN2 receive signal 8" UBYTE NO_COMPU_METHOD 1 100 0 255 ECU_ADDRESS 0x24027047 SYMBOL_LINK "panther_can2_in" 95 /end MEASUREMENT
/begin MEASUREMENT panther_can2_in.asw_in_can2_0xC2_STS_BDS_FL_DataByte9 "CAN2 receive signal 1" UBYTE NO_COMPU_METHOD 1 100 0 255 ECU_ADDRESS 0x24027040 SYMBOL_LINK "panther_can2_in" 88 /end MEASUREMENT
/begin MEASUREMENT panther_can2_in.asw_in_can2_0xC3_STS_BDS_FR_DataByte1 "CAN2 receive signal 1" UBYTE NO_COMPU_METHOD 1 100 0 255 ECU_ADDRESS 0x24027049 SYMBOL_LINK "panther_can2_in" 97 /end MEASUREMENT
/begin MEASUREMENT panther_can2_in.asw_in_can2_0xC3_STS_BDS_FR_DataByte2 "CAN2 receive signal 2" UBYTE NO_COMPU_METHOD 1 100 0 255 ECU_ADDRESS 0x2402704a SYMBOL_LINK "panther_can2_in" 98 /end MEASUREMENT
/begin MEASUREMENT panther_can2_in.asw_in_can2_0xC3_STS_BDS_FR_DataByte3 "CAN2 receive signal 3" UBYTE NO_COMPU_METHOD 1 100 0 255 ECU_ADDRESS 0x2402704b SYMBOL_LINK "panther_can2_in" 99 /end MEASUREMENT
/begin MEASUREMENT panther_can2_in.asw_in_can2_0xC3_STS_BDS_FR_DataByte4 "CAN2 receive signal 4" UBYTE NO_COMPU_METHOD 1 100 0 255 ECU_ADDRESS 0x2402704c SYMBOL_LINK "panther_can2_in" 100 /end MEASUREMENT
/begin MEASUREMENT panther_can2_in.asw_in_can2_0xC3_STS_BDS_FR_DataByte5 "CAN2 receive signal 5" UBYTE NO_COMPU_METHOD 1 100 0 255 ECU_ADDRESS 0x2402704d SYMBOL_LINK "panther_can2_in" 101 /end MEASUREMENT
/begin MEASUREMENT panther_can2_in.asw_in_can2_0xC3_STS_BDS_FR_DataByte6 "CAN2 receive signal 6" UBYTE NO_COMPU_METHOD 1 100 0 255 ECU_ADDRESS 0x2402704e SYMBOL_LINK "panther_can2_in" 102 /end MEASUREMENT
/begin MEASUREMENT panther_can2_in.asw_in_can2_0xC3_STS_BDS_FR_DataByte7 "CAN2 receive signal 7" UBYTE NO_COMPU_METHOD 1 100 0 255 ECU_ADDRESS 0x2402704f SYMBOL_LINK "panther_can2_in" 103 /end MEASUREMENT
/begin MEASUREMENT panther_can2_in.asw_in_can2_0xC3_STS_BDS_FR_DataByte8 "CAN2 receive signal 8" UBYTE NO_COMPU_METHOD 1 100 0 255 ECU_ADDRESS 0x24027050 SYMBOL_LINK "panther_can2_in" 104 /end MEASUREMENT
/begin MEASUREMENT panther_can2_in.asw_in_can2_0xC4_STS_BDS_FR_DataByte10 "CAN2 receive signal 2" UBYTE NO_COMPU_METHOD 1 100 0 255 ECU_ADDRESS 0x24027053 SYMBOL_LINK "panther_can2_in" 107 /end MEASUREMENT
/begin MEASUREMENT panther_can2_in.asw_in_can2_0xC4_STS_BDS_FR_DataByte11 "CAN2 receive signal 3" UBYTE NO_COMPU_METHOD 1 100 0 255 ECU_ADDRESS 0x24027054 SYMBOL_LINK "panther_can2_in" 108 /end MEASUREMENT
/begin MEASUREMENT panther_can2_in.asw_in_can2_0xC4_STS_BDS_FR_DataByte12 "CAN2 receive signal 4" UBYTE NO_COMPU_METHOD 1 100 0 255 ECU_ADDRESS 0x24027055 SYMBOL_LINK "panther_can2_in" 109 /end MEASUREMENT
/begin MEASUREMENT panther_can2_in.asw_in_can2_0xC4_STS_BDS_FR_DataByte13 "CAN2 receive signal 5" UBYTE NO_COMPU_METHOD 1 100 0 255 ECU_ADDRESS 0x24027056 SYMBOL_LINK "panther_can2_in" 110 /end MEASUREMENT
/begin MEASUREMENT panther_can2_in.asw_in_can2_0xC4_STS_BDS_FR_DataByte14 "CAN2 receive signal 6" UBYTE NO_COMPU_METHOD 1 100 0 255 ECU_ADDRESS 0x24027057 SYMBOL_LINK "panther_can2_in" 111 /end MEASUREMENT
/begin MEASUREMENT panther_can2_in.asw_in_can2_0xC4_STS_BDS_FR_DataByte15 "CAN2 receive signal 7" UBYTE NO_COMPU_METHOD 1 100 0 255 ECU_ADDRESS 0x24027058 SYMBOL_LINK "panther_can2_in" 112 /end MEASUREMENT
/begin MEASUREMENT panther_can2_in.asw_in_can2_0xC4_STS_BDS_FR_DataByte16 "CAN2 receive signal 8" UBYTE NO_COMPU_METHOD 1 100 0 255 ECU_ADDRESS 0x24027059 SYMBOL_LINK "panther_can2_in" 113 /end MEASUREMENT
/begin MEASUREMENT panther_can2_in.asw_in_can2_0xC4_STS_BDS_FR_DataByte9 "CAN2 receive signal 1" UBYTE NO_COMPU_METHOD 1 100 0 255 ECU_ADDRESS 0x24027052 SYMBOL_LINK "panther_can2_in" 106 /end MEASUREMENT
/begin MEASUREMENT panther_can2_out.asw_out_can2_0x90_ABL_FL_RetractRequest "CAN2 transmit signal 1" UBYTE NO_COMPU_METHOD 1 100 0 255 ECU_ADDRESS 0x24026fe1 SYMBOL_LINK "panther_can2_out" 57 /end MEASUREMENT
/begin MEASUREMENT panther_can2_out.asw_out_can2_0x90_ABL_FR_RetractRequest "CAN2 transmit signal 2" UBYTE NO_COMPU_METHOD 1 100 0 255 ECU_ADDRESS 0x24026fe2 SYMBOL_LINK "panther_can2_out" 58 /end MEASUREMENT
/begin MEASUREMENT panther_can2_out.asw_out_can2_0x90_ABL_RL1_RetractRequest "CAN2 transmit signal 3" UBYTE NO_COMPU_METHOD 1 100 0 255 ECU_ADDRESS 0x24026fe3 SYMBOL_LINK "panther_can2_out" 59 /end MEASUREMENT
/begin MEASUREMENT panther_can2_out.asw_out_can2_0x90_ABL_RL2_RetractRequest "CAN2 transmit signal 4" UBYTE NO_COMPU_METHOD 1 100 0 255 ECU_ADDRESS 0x24026fe4 SYMBOL_LINK "panther_can2_out" 60 /end MEASUREMENT
/begin MEASUREMENT panther_can2_out.asw_out_can2_0x90_ABL_RR1_RetractRequest "CAN2 transmit signal 5" UBYTE NO_COMPU_METHOD 1 100 0 255 ECU_ADDRESS 0x24026fe5 SYMBOL_LINK "panther_can2_out" 61 /end MEASUREMENT
/begin MEASUREMENT panther_can2_out.asw_out_can2_0x90_tx_status "CAN2 Transmit Status" UBYTE NO_COMPU_METHOD 1 100 0 1 ECU_ADDRESS 0x24026fe0 SYMBOL_LINK "panther_can2_out" 56 /end MEASUREMENT
/begin MEASUREMENT panther_can2_out.asw_out_can2_0x91_ACR_FL_RetractRequest "CAN2 transmit signal 1" UBYTE NO_COMPU_METHOD 1 100 0 255 ECU_ADDRESS 0x24026fdb SYMBOL_LINK "panther_can2_out" 51 /end MEASUREMENT
/begin MEASUREMENT panther_can2_out.asw_out_can2_0x91_ACR_FR_RetractRequest "CAN2 transmit signal 2" UBYTE NO_COMPU_METHOD 1 100 0 255 ECU_ADDRESS 0x24026fdc SYMBOL_LINK "panther_can2_out" 52 /end MEASUREMENT
/begin MEASUREMENT panther_can2_out.asw_out_can2_0x91_ACR_RL1_RetractRequest "CAN2 transmit signal 3" UBYTE NO_COMPU_METHOD 1 100 0 255 ECU_ADDRESS 0x24026fdd SYMBOL_LINK "panther_can2_out" 53 /end MEASUREMENT
/begin MEASUREMENT panther_can2_out.asw_out_can2_0x91_ACR_RL2_RetractRequest "CAN2 transmit signal 4" UBYTE NO_COMPU_METHOD 1 100 0 255 ECU_ADDRESS 0x24026fde SYMBOL_LINK "panther_can2_out" 54 /end MEASUREMENT
/begin MEASUREMENT panther_can2_out.asw_out_can2_0x91_ACR_RR1_RetractRequest "CAN2 transmit signal 5" UBYTE NO_COMPU_METHOD 1 100 0 255 ECU_ADDRESS 0x24026fdf SYMBOL_LINK "panther_can2_out" 55 /end MEASUREMENT
/begin MEASUREMENT panther_can2_out.asw_out_can2_0x91_tx_status "CAN2 Transmit Status" UBYTE NO_COMPU_METHOD 1 100 0 1 ECU_ADDRESS 0x24026fda SYMBOL_LINK "panther_can2_out" 50 /end MEASUREMENT
/begin MEASUREMENT panther_can2_out.asw_out_can2_0xA0_ISB_FL_AddressByte0_byte "CAN2 transmit signal 8" UBYTE NO_COMPU_METHOD 1 100 0 255 ECU_ADDRESS 0x24026fd8 SYMBOL_LINK "panther_can2_out" 48 /end MEASUREMENT
/begin MEASUREMENT panther_can2_out.asw_out_can2_0xA0_ISB_FL_AddressByte1_byte "CAN2 transmit signal 9" UBYTE NO_COMPU_METHOD 1 100 0 255 ECU_ADDRESS 0x24026fd9 SYMBOL_LINK "panther_can2_out" 49 /end MEASUREMENT
/begin MEASUREMENT panther_can2_out.asw_out_can2_0xA0_ISB_FL_ColorBlue_byte "CAN2 transmit signal 2" UBYTE NO_COMPU_METHOD 1 100 0 255 ECU_ADDRESS 0x24026fd2 SYMBOL_LINK "panther_can2_out" 42 /end MEASUREMENT
/begin MEASUREMENT panther_can2_out.asw_out_can2_0xA0_ISB_FL_ColorGreen_byte "CAN2 transmit signal 1" UBYTE NO_COMPU_METHOD 1 100 0 255 ECU_ADDRESS 0x24026fd1 SYMBOL_LINK "panther_can2_out" 41 /end MEASUREMENT
/begin MEASUREMENT panther_can2_out.asw_out_can2_0xA0_ISB_FL_ColorRed_byte "CAN2 transmit signal 3" UBYTE NO_COMPU_METHOD 1 100 0 255 ECU_ADDRESS 0x24026fd3 SYMBOL_LINK "panther_can2_out" 43 /end MEASUREMENT
/begin MEASUREMENT panther_can2_out.asw_out_can2_0xA0_ISB_FL_GroupOrModule_bool "CAN2 transmit signal 7" UBYTE NO_COMPU_METHOD 1 100 0 1 ECU_ADDRESS 0x24026fd7 SYMBOL_LINK "panther_can2_out" 47 /end MEASUREMENT
/begin MEASUREMENT panther_can2_out.asw_out_can2_0xA0_ISB_FL_Intensity_perc "CAN2 transmit signal 4" UBYTE NO_COMPU_METHOD 1 100 0 127 ECU_ADDRESS 0x24026fd4 SYMBOL_LINK "panther_can2_out" 44 /end MEASUREMENT
/begin MEASUREMENT panther_can2_out.asw_out_can2_0xA0_ISB_FL_Normalization_bool "CAN2 transmit signal 5" UBYTE NO_COMPU_METHOD 1 100 0 1 ECU_ADDRESS 0x24026fd5 SYMBOL_LINK "panther_can2_out" 45 /end MEASUREMENT
/begin MEASUREMENT panther_can2_out.asw_out_can2_0xA0_ISB_FL_Transitionspeed_nibble "CAN2 transmit signal 6" UBYTE NO_COMPU_METHOD 1 100 0 15 ECU_ADDRESS 0x24026fd6 SYMBOL_LINK "panther_can2_out" 46 /end MEASUREMENT
/begin MEASUREMENT panther_can2_out.asw_out_can2_0xA0_tx_status "CAN2 Transmit Status" UBYTE NO_COMPU_METHOD 1 100 0 1 ECU_ADDRESS 0x24026fd0 SYMBOL_LINK "panther_can2_out" 40 /end MEASUREMENT
/begin MEASUREMENT panther_can2_out.asw_out_can2_0xA1_ISB_FR_AddressByte0 "CAN2 transmit signal 8" UBYTE NO_COMPU_METHOD 1 100 0 255 ECU_ADDRESS 0x24026fce SYMBOL_LINK "panther_can2_out" 38 /end MEASUREMENT
/begin MEASUREMENT panther_can2_out.asw_out_can2_0xA1_ISB_FR_AddressByte1 "CAN2 transmit signal 9" UBYTE NO_COMPU_METHOD 1 100 0 255 ECU_ADDRESS 0x24026fcf SYMBOL_LINK "panther_can2_out" 39 /end MEASUREMENT
/begin MEASUREMENT panther_can2_out.asw_out_can2_0xA1_ISB_FR_ColorBlue "CAN2 transmit signal 2" UBYTE NO_COMPU_METHOD 1 100 0 255 ECU_ADDRESS 0x24026fc8 SYMBOL_LINK "panther_can2_out" 32 /end MEASUREMENT
/begin MEASUREMENT panther_can2_out.asw_out_can2_0xA1_ISB_FR_ColorGreen "CAN2 transmit signal 1" UBYTE NO_COMPU_METHOD 1 100 0 255 ECU_ADDRESS 0x24026fc7 SYMBOL_LINK "panther_can2_out" 31 /end MEASUREMENT
/begin MEASUREMENT panther_can2_out.asw_out_can2_0xA1_ISB_FR_ColorRed "CAN2 transmit signal 3" UBYTE NO_COMPU_METHOD 1 100 0 255 ECU_ADDRESS 0x24026fc9 SYMBOL_LINK "panther_can2_out" 33 /end MEASUREMENT
/begin MEASUREMENT panther_can2_out.asw_out_can2_0xA1_ISB_FR_GroupOrModule "CAN2 transmit signal 7" UBYTE NO_COMPU_METHOD 1 100 0 1 ECU_ADDRESS 0x24026fcd SYMBOL_LINK "panther_can2_out" 37 /end MEASUREMENT
/begin MEASUREMENT panther_can2_out.asw_out_can2_0xA1_ISB_FR_Intensity_perc "CAN2 transmit signal 4" UBYTE NO_COMPU_METHOD 1 100 0 127 ECU_ADDRESS 0x24026fca SYMBOL_LINK "panther_can2_out" 34 /end MEASUREMENT
/begin MEASUREMENT panther_can2_out.asw_out_can2_0xA1_ISB_FR_Normalization "CAN2 transmit signal 5" UBYTE NO_COMPU_METHOD 1 100 0 1 ECU_ADDRESS 0x24026fcb SYMBOL_LINK "panther_can2_out" 35 /end MEASUREMENT
/begin MEASUREMENT panther_can2_out.asw_out_can2_0xA1_ISB_FR_Transitionspeed "CAN2 transmit signal 6" UBYTE NO_COMPU_METHOD 1 100 0 15 ECU_ADDRESS 0x24026fcc SYMBOL_LINK "panther_can2_out" 36 /end MEASUREMENT
/begin MEASUREMENT panther_can2_out.asw_out_can2_0xA1_tx_status "CAN2 Transmit Status" UBYTE NO_COMPU_METHOD 1 100 0 1 ECU_ADDRESS 0x24026fc6 SYMBOL_LINK "panther_can2_out" 30 /end MEASUREMENT
/begin MEASUREMENT panther_can2_out.asw_out_can2_0xA2_ISB_RL1_AddressByte0 "CAN2 transmit signal 8" UBYTE NO_COMPU_METHOD 1 100 0 255 ECU_ADDRESS 0x24026fc4 SYMBOL_LINK "panther_can2_out" 28 /end MEASUREMENT
/begin MEASUREMENT panther_can2_out.asw_out_can2_0xA2_ISB_RL1_AddressByte1 "CAN2 transmit signal 9" UBYTE NO_COMPU_METHOD 1 100 0 255 ECU_ADDRESS 0x24026fc5 SYMBOL_LINK "panther_can2_out" 29 /end MEASUREMENT
/begin MEASUREMENT panther_can2_out.asw_out_can2_0xA2_ISB_RL1_ColorBlue "CAN2 transmit signal 2" UBYTE NO_COMPU_METHOD 1 100 0 255 ECU_ADDRESS 0x24026fbe SYMBOL_LINK "panther_can2_out" 22 /end MEASUREMENT
/begin MEASUREMENT panther_can2_out.asw_out_can2_0xA2_ISB_RL1_ColorGreen "CAN2 transmit signal 1" UBYTE NO_COMPU_METHOD 1 100 0 255 ECU_ADDRESS 0x24026fbd SYMBOL_LINK "panther_can2_out" 21 /end MEASUREMENT
/begin MEASUREMENT panther_can2_out.asw_out_can2_0xA2_ISB_RL1_ColorRed "CAN2 transmit signal 3" UBYTE NO_COMPU_METHOD 1 100 0 255 ECU_ADDRESS 0x24026fbf SYMBOL_LINK "panther_can2_out" 23 /end MEASUREMENT
/begin MEASUREMENT panther_can2_out.asw_out_can2_0xA2_ISB_RL1_GroupOrModule "CAN2 transmit signal 7" UBYTE NO_COMPU_METHOD 1 100 0 1 ECU_ADDRESS 0x24026fc3 SYMBOL_LINK "panther_can2_out" 27 /end MEASUREMENT
/begin MEASUREMENT panther_can2_out.asw_out_can2_0xA2_ISB_RL1_Intensity "CAN2 transmit signal 4" UBYTE NO_COMPU_METHOD 1 100 0 127 ECU_ADDRESS 0x24026fc0 SYMBOL_LINK "panther_can2_out" 24 /end MEASUREMENT
/begin MEASUREMENT panther_can2_out.asw_out_can2_0xA2_ISB_RL1_Normalization "CAN2 transmit signal 5" UBYTE NO_COMPU_METHOD 1 100 0 1 ECU_ADDRESS 0x24026fc1 SYMBOL_LINK "panther_can2_out" 25 /end MEASUREMENT
/begin MEASUREMENT panther_can2_out.asw_out_can2_0xA2_ISB_RL1_Transitionspeed "CAN2 transmit signal 6" UBYTE NO_COMPU_METHOD 1 100 0 15 ECU_ADDRESS 0x24026fc2 SYMBOL_LINK "panther_can2_out" 26 /end MEASUREMENT
/begin MEASUREMENT panther_can2_out.asw_out_can2_0xA2_tx_status "CAN2 Transmit Status" UBYTE NO_COMPU_METHOD 1 100 0 1 ECU_ADDRESS 0x24026fbc SYMBOL_LINK "panther_can2_out" 20 /end MEASUREMENT
/begin MEASUREMENT panther_can2_out.asw_out_can2_0xA3_ISB_RL2_AddressByte0 "CAN2 transmit signal 8" UBYTE NO_COMPU_METHOD 1 100 0 255 ECU_ADDRESS 0x24026fba SYMBOL_LINK "panther_can2_out" 18 /end MEASUREMENT
/begin MEASUREMENT panther_can2_out.asw_out_can2_0xA3_ISB_RL2_AddressByte1 "CAN2 transmit signal 9" UBYTE NO_COMPU_METHOD 1 100 0 255 ECU_ADDRESS 0x24026fbb SYMBOL_LINK "panther_can2_out" 19 /end MEASUREMENT
/begin MEASUREMENT panther_can2_out.asw_out_can2_0xA3_ISB_RL2_ColorBlue "CAN2 transmit signal 2" UBYTE NO_COMPU_METHOD 1 100 0 255 ECU_ADDRESS 0x24026fb4 SYMBOL_LINK "panther_can2_out" 12 /end MEASUREMENT
/begin MEASUREMENT panther_can2_out.asw_out_can2_0xA3_ISB_RL2_ColorGreen "CAN2 transmit signal 1" UBYTE NO_COMPU_METHOD 1 100 0 255 ECU_ADDRESS 0x24026fb3 SYMBOL_LINK "panther_can2_out" 11 /end MEASUREMENT
/begin MEASUREMENT panther_can2_out.asw_out_can2_0xA3_ISB_RL2_ColorRed "CAN2 transmit signal 3" UBYTE NO_COMPU_METHOD 1 100 0 255 ECU_ADDRESS 0x24026fb5 SYMBOL_LINK "panther_can2_out" 13 /end MEASUREMENT
/begin MEASUREMENT panther_can2_out.asw_out_can2_0xA3_ISB_RL2_GroupOrModule "CAN2 transmit signal 7" UBYTE NO_COMPU_METHOD 1 100 0 1 ECU_ADDRESS 0x24026fb9 SYMBOL_LINK "panther_can2_out" 17 /end MEASUREMENT
/begin MEASUREMENT panther_can2_out.asw_out_can2_0xA3_ISB_RL2_Intensity "CAN2 transmit signal 4" UBYTE NO_COMPU_METHOD 1 100 0 127 ECU_ADDRESS 0x24026fb6 SYMBOL_LINK "panther_can2_out" 14 /end MEASUREMENT
/begin MEASUREMENT panther_can2_out.asw_out_can2_0xA3_ISB_RL2_Normalization "CAN2 transmit signal 5" UBYTE NO_COMPU_METHOD 1 100 0 1 ECU_ADDRESS 0x24026fb7 SYMBOL_LINK "panther_can2_out" 15 /end MEASUREMENT
/begin MEASUREMENT panther_can2_out.asw_out_can2_0xA3_ISB_RL2_Transitionspeed "CAN2 transmit signal 6" UBYTE NO_COMPU_METHOD 1 100 0 15 ECU_ADDRESS 0x24026fb8 SYMBOL_LINK "panther_can2_out" 16 /end MEASUREMENT
/begin MEASUREMENT panther_can2_out.asw_out_can2_0xA3_tx_status "CAN2 Transmit Status" UBYTE NO_COMPU_METHOD 1 100 0 1 ECU_ADDRESS 0x24026fb2 SYMBOL_LINK "panther_can2_out" 10 /end MEASUREMENT
/begin MEASUREMENT panther_can2_out.asw_out_can2_0xA4_ISB_RR1_AddressByte0 "CAN2 transmit signal 8" UBYTE NO_COMPU_METHOD 1 100 0 255 ECU_ADDRESS 0x24026fb0 SYMBOL_LINK "panther_can2_out" 8 /end MEASUREMENT
/begin MEASUREMENT panther_can2_out.asw_out_can2_0xA4_ISB_RR1_AddressByte1 "CAN2 transmit signal 9" UBYTE NO_COMPU_METHOD 1 100 0 255 ECU_ADDRESS 0x24026fb1 SYMBOL_LINK "panther_can2_out" 9 /end MEASUREMENT
/begin MEASUREMENT panther_can2_out.asw_out_can2_0xA4_ISB_RR1_ColorBlue "CAN2 transmit signal 2" UBYTE NO_COMPU_METHOD 1 100 0 255 ECU_ADDRESS 0x24026faa SYMBOL_LINK "panther_can2_out" 2 /end MEASUREMENT
/begin MEASUREMENT panther_can2_out.asw_out_can2_0xA4_ISB_RR1_ColorGreen "CAN2 transmit signal 1" UBYTE NO_COMPU_METHOD 1 100 0 255 ECU_ADDRESS 0x24026fa9 SYMBOL_LINK "panther_can2_out" 1 /end MEASUREMENT
/begin MEASUREMENT panther_can2_out.asw_out_can2_0xA4_ISB_RR1_ColorRed "CAN2 transmit signal 3" UBYTE NO_COMPU_METHOD 1 100 0 255 ECU_ADDRESS 0x24026fab SYMBOL_LINK "panther_can2_out" 3 /end MEASUREMENT
/begin MEASUREMENT panther_can2_out.asw_out_can2_0xA4_ISB_RR1_GroupOrModule "CAN2 transmit signal 7" UBYTE NO_COMPU_METHOD 1 100 0 1 ECU_ADDRESS 0x24026faf SYMBOL_LINK "panther_can2_out" 7 /end MEASUREMENT
/begin MEASUREMENT panther_can2_out.asw_out_can2_0xA4_ISB_RR1_Intensity "CAN2 transmit signal 4" UBYTE NO_COMPU_METHOD 1 100 0 127 ECU_ADDRESS 0x24026fac SYMBOL_LINK "panther_can2_out" 4 /end MEASUREMENT
/begin MEASUREMENT panther_can2_out.asw_out_can2_0xA4_ISB_RR1_Normalization "CAN2 transmit signal 5" UBYTE NO_COMPU_METHOD 1 100 0 1 ECU_ADDRESS 0x24026fad SYMBOL_LINK "panther_can2_out" 5 /end MEASUREMENT
/begin MEASUREMENT panther_can2_out.asw_out_can2_0xA4_ISB_RR1_Transitionspeed "CAN2 transmit signal 6" UBYTE NO_COMPU_METHOD 1 100 0 15 ECU_ADDRESS 0x24026fae SYMBOL_LINK "panther_can2_out" 6 /end MEASUREMENT
/begin MEASUREMENT panther_can2_out.asw_out_can2_0xA4_tx_status "CAN2 Transmit Status" UBYTE NO_COMPU_METHOD 1 100 0 1 ECU_ADDRESS 0x24026fa8 SYMBOL_LINK "panther_can2_out" 0 /end MEASUREMENT
/begin MEASUREMENT panther_can3_in.asw_in_can3_0x150_Algo_Status_FL "CAN3 receive signal 2" UBYTE NO_COMPU_METHOD 1 100 0 1 ECU_ADDRESS 0x24026f4a SYMBOL_LINK "panther_can3_in" 2 /end MEASUREMENT
/begin MEASUREMENT panther_can3_in.asw_in_can3_0x150_Algo_Status_FR "CAN3 receive signal 7" UBYTE NO_COMPU_METHOD 1 100 0 1 ECU_ADDRESS 0x24026f4f SYMBOL_LINK "panther_can3_in" 7 /end MEASUREMENT
/begin MEASUREMENT panther_can3_in.asw_in_can3_0x150_Algo_Status_RL "CAN3 receive signal 8" UBYTE NO_COMPU_METHOD 1 100 0 1 ECU_ADDRESS 0x24026f50 SYMBOL_LINK "panther_can3_in" 8 /end MEASUREMENT
/begin MEASUREMENT panther_can3_in.asw_in_can3_0x150_Lock_Status_FL "CAN3 receive signal 1" UBYTE NO_COMPU_METHOD 1 100 0 1 ECU_ADDRESS 0x24026f49 SYMBOL_LINK "panther_can3_in" 1 /end MEASUREMENT
/begin MEASUREMENT panther_can3_in.asw_in_can3_0x150_Lock_Status_FR "CAN3 receive signal 4" UBYTE NO_COMPU_METHOD 1 100 0 1 ECU_ADDRESS 0x24026f4c SYMBOL_LINK "panther_can3_in" 4 /end MEASUREMENT
/begin MEASUREMENT panther_can3_in.asw_in_can3_0x150_Lock_Status_RL "CAN3 receive signal 5" UBYTE NO_COMPU_METHOD 1 100 0 1 ECU_ADDRESS 0x24026f4d SYMBOL_LINK "panther_can3_in" 5 /end MEASUREMENT
/begin MEASUREMENT panther_can3_in.asw_in_can3_0x160_ECU_Status_Act_1 "CAN3 receive signal 1" SBYTE NO_COMPU_METHOD 1 100 0 8 ECU_ADDRESS 0x24026f5d SYMBOL_LINK "panther_can3_in" 21 /end MEASUREMENT
/begin MEASUREMENT panther_can3_in.asw_in_can3_0x160_ECU_Status_Act_2 "CAN3 receive signal 2" SBYTE NO_COMPU_METHOD 1 100 0 8 ECU_ADDRESS 0x24026f5e SYMBOL_LINK "panther_can3_in" 22 /end MEASUREMENT
/begin MEASUREMENT panther_can3_in.asw_in_can3_0x160_ECU_Status_Act_3 "CAN3 receive signal 3" SBYTE NO_COMPU_METHOD 1 100 0 8 ECU_ADDRESS 0x24026f5f SYMBOL_LINK "panther_can3_in" 23 /end MEASUREMENT
/begin MEASUREMENT panther_can3_out.asw_out_can3_0x100_Debug_Mode "CAN3 transmit signal 2" SBYTE NO_COMPU_METHOD 1 100 0 0 ECU_ADDRESS 0x24026dfe SYMBOL_LINK "panther_can3_out" 2 /end MEASUREMENT
/begin MEASUREMENT panther_can3_out.asw_out_can3_0x100_Ext_Trigger_FL "CAN3 transmit signal 3" SBYTE NO_COMPU_METHOD 1 100 0 0 ECU_ADDRESS 0x24026dff SYMBOL_LINK "panther_can3_out" 3 /end MEASUREMENT
/begin MEASUREMENT panther_can3_out.asw_out_can3_0x100_Ext_Trigger_FR "CAN3 transmit signal 8" SBYTE NO_COMPU_METHOD 1 100 0 0 ECU_ADDRESS 0x24026e04 SYMBOL_LINK "panther_can3_out" 8 /end MEASUREMENT
/begin MEASUREMENT panther_can3_out.asw_out_can3_0x100_Ext_Trigger_RL "CAN3 transmit signal 9" SBYTE NO_COMPU_METHOD 1 100 0 0 ECU_ADDRESS 0x24026e05 SYMBOL_LINK "panther_can3_out" 9 /end MEASUREMENT
/begin MEASUREMENT panther_can3_out.asw_out_can3_0x100_OutputMode "CAN3 transmit signal 7" UBYTE NO_COMPU_METHOD 1 100 0 100 ECU_ADDRESS 0x24026e03 SYMBOL_LINK "panther_can3_out" 7 /end MEASUREMENT
/begin MEASUREMENT panther_can3_out.asw_out_can3_0x100_Seat_Buckle_FL "CAN3 transmit signal 1" UBYTE NO_COMPU_METHOD 1 100 0 3 ECU_ADDRESS 0x24026dfd SYMBOL_LINK "panther_can3_out" 1 /end MEASUREMENT
/begin MEASUREMENT panther_can3_out.asw_out_can3_0x100_Seat_Buckle_FR "CAN3 transmit signal 4" UBYTE NO_COMPU_METHOD 1 100 0 3 ECU_ADDRESS 0x24026e00 SYMBOL_LINK "panther_can3_out" 4 /end MEASUREMENT
/begin MEASUREMENT panther_can3_out.asw_out_can3_0x100_Seat_Buckle_RL "CAN3 transmit signal 5" UBYTE NO_COMPU_METHOD 1 100 0 3 ECU_ADDRESS 0x24026e01 SYMBOL_LINK "panther_can3_out" 5 /end MEASUREMENT
/begin MEASUREMENT panther_can3_out.asw_out_can3_0x100_Seat_Buckle_RR "CAN3 transmit signal 6" UBYTE NO_COMPU_METHOD 1 100 0 3 ECU_ADDRESS 0x24026e02 SYMBOL_LINK "panther_can3_out" 6 /end MEASUREMENT
/begin MEASUREMENT panther_can3_out.asw_out_can3_0x100_TiltMountPos "CAN3 transmit signal 11" SBYTE NO_COMPU_METHOD 1 100 0 0 ECU_ADDRESS 0x24026e07 SYMBOL_LINK "panther_can3_out" 11 /end MEASUREMENT
/begin MEASUREMENT panther_can3_out.asw_out_can3_0x100_tx_status "CAN3 Transmit Status" UBYTE NO_COMPU_METHOD 1 100 0 1 ECU_ADDRESS 0x24026dfc SYMBOL_LINK "panther_can3_out" 0 /end MEASUREMENT
/begin MEASUREMENT panther_can6_in.asw_in_can6_0xA2_ISB_RL1_ColorBlue "CAN6 receive signal 2" UBYTE NO_COMPU_METHOD 1 100 0 255 ECU_ADDRESS 0x24026e2e SYMBOL_LINK "panther_can6_in" 22 /end MEASUREMENT
/begin MEASUREMENT panther_can6_in.asw_in_can6_0xA2_ISB_RL1_ColorGreen "CAN6 receive signal 1" UBYTE NO_COMPU_METHOD 1 100 0 255 ECU_ADDRESS 0x24026e2d SYMBOL_LINK "panther_can6_in" 21 /end MEASUREMENT
/begin MEASUREMENT panther_can6_in.asw_in_can6_0xA2_ISB_RL1_ColorRed "CAN6 receive signal 3" UBYTE NO_COMPU_METHOD 1 100 0 255 ECU_ADDRESS 0x24026e2f SYMBOL_LINK "panther_can6_in" 23 /end MEASUREMENT
/begin MEASUREMENT panther_can6_in.asw_in_can6_0xA2_ISB_RL1_Intensity "CAN6 receive signal 4" UBYTE NO_COMPU_METHOD 1 100 0 127 ECU_ADDRESS 0x24026e30 SYMBOL_LINK "panther_can6_in" 24 /end MEASUREMENT
/begin MEASUREMENT panther_can6_in.asw_in_can6_0xA2_rx_status "CAN6 Receive Status" UBYTE NO_COMPU_METHOD 1 100 0 1 ECU_ADDRESS 0x24026e2c SYMBOL_LINK "panther_can6_in" 20 /end MEASUREMENT
/begin MEASUREMENT panther_can6_in.asw_in_can6_0xA3_ISB_RL2_AddressByte0 "CAN6 receive signal 8" UBYTE NO_COMPU_METHOD 1 100 0 255 ECU_ADDRESS 0x24026e2a SYMBOL_LINK "panther_can6_in" 18 /end MEASUREMENT
/begin MEASUREMENT panther_can6_in.asw_in_can6_0xA3_ISB_RL2_AddressByte1 "CAN6 receive signal 9" UBYTE NO_COMPU_METHOD 1 100 0 255 ECU_ADDRESS 0x24026e2b SYMBOL_LINK "panther_can6_in" 19 /end MEASUREMENT
/begin MEASUREMENT panther_can6_in.asw_in_can6_0xA3_ISB_RL2_ColorBlue "CAN6 receive signal 2" UBYTE NO_COMPU_METHOD 1 100 0 255 ECU_ADDRESS 0x24026e24 SYMBOL_LINK "panther_can6_in" 12 /end MEASUREMENT
/begin MEASUREMENT panther_can6_in.asw_in_can6_0xA3_ISB_RL2_ColorGreen "CAN6 receive signal 1" UBYTE NO_COMPU_METHOD 1 100 0 255 ECU_ADDRESS 0x24026e23 SYMBOL_LINK "panther_can6_in" 11 /end MEASUREMENT
/begin MEASUREMENT panther_can6_in.asw_in_can6_0xA3_ISB_RL2_ColorRed "CAN6 receive signal 3" UBYTE NO_COMPU_METHOD 1 100 0 255 ECU_ADDRESS 0x24026e25 SYMBOL_LINK "panther_can6_in" 13 /end MEASUREMENT
/begin MEASUREMENT panther_can6_in.asw_in_can6_0xA3_ISB_RL2_GroupOrModule "CAN6 receive signal 7" UBYTE NO_COMPU_METHOD 1 100 0 1 ECU_ADDRESS 0x24026e29 SYMBOL_LINK "panther_can6_in" 17 /end MEASUREMENT
/begin MEASUREMENT panther_can6_in.asw_in_can6_0xA3_ISB_RL2_Intensity "CAN6 receive signal 4" UBYTE NO_COMPU_METHOD 1 100 0 127 ECU_ADDRESS 0x24026e26 SYMBOL_LINK "panther_can6_in" 14 /end MEASUREMENT
/begin MEASUREMENT panther_can6_in.asw_in_can6_0xA3_ISB_RL2_Normalization "CAN6 receive signal 5" UBYTE NO_COMPU_METHOD 1 100 0 1 ECU_ADDRESS 0x24026e27 SYMBOL_LINK "panther_can6_in" 15 /end MEASUREMENT
/begin MEASUREMENT panther_can6_in.asw_in_can6_0xA3_ISB_RL2_Transitionspeed "CAN6 receive signal 6" UBYTE NO_COMPU_METHOD 1 100 0 15 ECU_ADDRESS 0x24026e28 SYMBOL_LINK "panther_can6_in" 16 /end MEASUREMENT
/begin MEASUREMENT panther_can6_in.asw_in_can6_0xA3_rx_status "CAN6 Receive Status" UBYTE NO_COMPU_METHOD 1 100 0 1 ECU_ADDRESS 0x24026e22 SYMBOL_LINK "panther_can6_in" 10 /end MEASUREMENT
/begin MEASUREMENT panther_can6_in.asw_in_can6_0xA4_ISB_RR1_AddressByte0 "CAN6 receive signal 8" UBYTE NO_COMPU_METHOD 1 100 0 255 ECU_ADDRESS 0x24026e20 SYMBOL_LINK "panther_can6_in" 8 /end MEASUREMENT
/begin MEASUREMENT panther_can6_in.asw_in_can6_0xA4_ISB_RR1_AddressByte1 "CAN6 receive signal 9" UBYTE NO_COMPU_METHOD 1 100 0 255 ECU_ADDRESS 0x24026e21 SYMBOL_LINK "panther_can6_in" 9 /end MEASUREMENT
/begin MEASUREMENT panther_can6_in.asw_in_can6_0xA4_ISB_RR1_ColorBlue "CAN6 receive signal 2" UBYTE NO_COMPU_METHOD 1 100 0 255 ECU_ADDRESS 0x24026e1a SYMBOL_LINK "panther_can6_in" 2 /end MEASUREMENT
/begin MEASUREMENT panther_can6_in.asw_in_can6_0xA4_ISB_RR1_ColorGreen "CAN6 receive signal 1" UBYTE NO_COMPU_METHOD 1 100 0 255 ECU_ADDRESS 0x24026e19 SYMBOL_LINK "panther_can6_in" 1 /end MEASUREMENT
/begin MEASUREMENT panther_can6_in.asw_in_can6_0xA4_ISB_RR1_ColorRed "CAN6 receive signal 3" UBYTE NO_COMPU_METHOD 1 100 0 255 ECU_ADDRESS 0x24026e1b SYMBOL_LINK "panther_can6_in" 3 /end MEASUREMENT
/begin MEASUREMENT panther_can6_in.asw_in_can6_0xA4_ISB_RR1_GroupOrModule "CAN6 receive signal 7" UBYTE NO_COMPU_METHOD 1 100 0 1 ECU_ADDRESS 0x24026e1f SYMBOL_LINK "panther_can6_in" 7 /end MEASUREMENT
/begin MEASUREMENT panther_can6_in.asw_in_can6_0xA4_ISB_RR1_Intensity "CAN6 receive signal 4" UBYTE NO_COMPU_METHOD 1 100 0 127 ECU_ADDRESS 0x24026e1c SYMBOL_LINK "panther_can6_in" 4 /end MEASUREMENT
/begin MEASUREMENT panther_can6_in.asw_in_can6_0xA4_ISB_RR1_Normalization "CAN6 receive signal 5" UBYTE NO_COMPU_METHOD 1 100 0 1 ECU_ADDRESS 0x24026e1d SYMBOL_LINK "panther_can6_in" 5 /end MEASUREMENT
/begin MEASUREMENT panther_can6_in.asw_in_can6_0xA4_ISB_RR1_Transitionspeed "CAN6 receive signal 6" UBYTE NO_COMPU_METHOD 1 100 0 15 ECU_ADDRESS 0x24026e1e SYMBOL_LINK "panther_can6_in" 6 /end MEASUREMENT
/begin MEASUREMENT panther_can6_in.asw_in_can6_0xA4_rx_status "CAN6 Receive Status" UBYTE NO_COMPU_METHOD 1 100 0 1 ECU_ADDRESS 0x24026e18 SYMBOL_LINK "panther_can6_in" 0 /end MEASUREMENT
/begin MEASUREMENT panther_can6_out.asw_out_can6_0x190_tx_status "CAN6 Transmit Status" UBYTE NO_COMPU_METHOD 1 100 0 1 ECU_ADDRESS 0x24026ed1 SYMBOL_LINK "panther_can6_out" 49 /end MEASUREMENT
/begin MEASUREMENT panther_can6_out.asw_out_can6_0x190_WMS_FL_SensorStatus_bool "CAN6 transmit signal 3" UBYTE NO_COMPU_METHOD 1 100 0 7 ECU_ADDRESS 0x24026ed6 SYMBOL_LINK "panther_can6_out" 54 /end MEASUREMENT
/begin MEASUREMENT panther_can6_out.asw_out_can6_0x190_WMS_FL_SpoolAngle_deg "CAN6 transmit signal 2" UWORD NO_COMPU_METHOD 1 100 0 16383 ECU_ADDRESS 0x24026ed4 SYMBOL_LINK "panther_can6_out" 52 /end MEASUREMENT
/begin MEASUREMENT panther_can6_out.asw_out_can6_0x190_WMS_FL_WebbingMovement "CAN6 transmit signal 1" UWORD NO_COMPU_METHOD 1 100 0 8191 ECU_ADDRESS 0x24026ed2 SYMBOL_LINK "panther_can6_out" 50 /end MEASUREMENT
/begin MEASUREMENT panther_can6_out.asw_out_can6_0x191_tx_status "CAN6 Transmit Status" UBYTE NO_COMPU_METHOD 1 100 0 1 ECU_ADDRESS 0x24026ecb SYMBOL_LINK "panther_can6_out" 43 /end MEASUREMENT
/begin MEASUREMENT panther_can6_out.asw_out_can6_0x191_WMS_FR_SensorStatus "CAN6 transmit signal 3" UBYTE NO_COMPU_METHOD 1 100 0 7 ECU_ADDRESS 0x24026ed0 SYMBOL_LINK "panther_can6_out" 48 /end MEASUREMENT
/begin MEASUREMENT panther_can6_out.asw_out_can6_0x191_WMS_FR_SpoolAngle "CAN6 transmit signal 2" UWORD NO_COMPU_METHOD 1 100 0 16383 ECU_ADDRESS 0x24026ece SYMBOL_LINK "panther_can6_out" 46 /end MEASUREMENT
/begin MEASUREMENT panther_can6_out.asw_out_can6_0x191_WMS_FR_WebbingMovement "CAN6 transmit signal 1" UWORD NO_COMPU_METHOD 1 100 0 8191 ECU_ADDRESS 0x24026ecc SYMBOL_LINK "panther_can6_out" 44 /end MEASUREMENT
/begin MEASUREMENT panther_can6_out.asw_out_can6_0x192_tx_status "CAN6 Transmit Status" UBYTE NO_COMPU_METHOD 1 100 0 1 ECU_ADDRESS 0x24026ec5 SYMBOL_LINK "panther_can6_out" 37 /end MEASUREMENT
/begin MEASUREMENT panther_can6_out.asw_out_can6_0x192_WMS_RL1_SensorStatus "CAN6 transmit signal 3" UBYTE NO_COMPU_METHOD 1 100 0 7 ECU_ADDRESS 0x24026eca SYMBOL_LINK "panther_can6_out" 42 /end MEASUREMENT
/begin MEASUREMENT panther_can6_out.asw_out_can6_0x192_WMS_RL1_SpoolAngle "CAN6 transmit signal 2" UWORD NO_COMPU_METHOD 1 100 0 16383 ECU_ADDRESS 0x24026ec8 SYMBOL_LINK "panther_can6_out" 40 /end MEASUREMENT
/begin MEASUREMENT panther_can6_out.asw_out_can6_0x192_WMS_RL1_WebbingMovement "CAN6 transmit signal 1" UWORD NO_COMPU_METHOD 1 100 0 8191 ECU_ADDRESS 0x24026ec6 SYMBOL_LINK "panther_can6_out" 38 /end MEASUREMENT
/begin MEASUREMENT panther_can6_out.asw_out_can6_0x193_tx_status "CAN6 Transmit Status" UBYTE NO_COMPU_METHOD 1 100 0 1 ECU_ADDRESS 0x24026ebf SYMBOL_LINK "panther_can6_out" 31 /end MEASUREMENT
/begin MEASUREMENT panther_can6_out.asw_out_can6_0x193_WMS_RL2_SensorStatus "CAN6 transmit signal 3" UBYTE NO_COMPU_METHOD 1 100 0 7 ECU_ADDRESS 0x24026ec4 SYMBOL_LINK "panther_can6_out" 36 /end MEASUREMENT
/begin MEASUREMENT panther_can6_out.asw_out_can6_0x193_WMS_RL2_SpoolAngle "CAN6 transmit signal 2" UWORD NO_COMPU_METHOD 1 100 0 16383 ECU_ADDRESS 0x24026ec2 SYMBOL_LINK "panther_can6_out" 34 /end MEASUREMENT
/begin MEASUREMENT panther_can6_out.asw_out_can6_0x193_WMS_RL2_WebbingMovement "CAN6 transmit signal 1" UWORD NO_COMPU_METHOD 1 100 0 8191 ECU_ADDRESS 0x24026ec0 SYMBOL_LINK "panther_can6_out" 32 /end MEASUREMENT
/begin MEASUREMENT panther_can6_out.asw_out_can6_0x194_tx_status "CAN6 Transmit Status" UBYTE NO_COMPU_METHOD 1 100 0 1 ECU_ADDRESS 0x24026eb8 SYMBOL_LINK "panther_can6_out" 24 /end MEASUREMENT
/begin MEASUREMENT panther_can6_out.asw_out_can6_0x194_WMS_RR1_SensorStatus "CAN6 transmit signal 3" UBYTE NO_COMPU_METHOD 1 100 0 7 ECU_ADDRESS 0x24026ebe SYMBOL_LINK "panther_can6_out" 30 /end MEASUREMENT
/begin MEASUREMENT panther_can6_out.asw_out_can6_0x194_WMS_RR1_SpoolAngle "CAN6 transmit signal 2" UWORD NO_COMPU_METHOD 1 100 0 16383 ECU_ADDRESS 0x24026ebc SYMBOL_LINK "panther_can6_out" 28 /end MEASUREMENT
/begin MEASUREMENT panther_can6_out.asw_out_can6_0x194_WMS_RR1_WebbingMovement "CAN6 transmit signal 1" UWORD NO_COMPU_METHOD 1 100 0 8191 ECU_ADDRESS 0x24026eba SYMBOL_LINK "panther_can6_out" 26 /end MEASUREMENT
/begin MEASUREMENT panther_can6_out.asw_out_can6_0x198_ELK_FL_LockingStatus "CAN6 transmit signal 1" UBYTE NO_COMPU_METHOD 1 100 0 3 ECU_ADDRESS 0x24026ed8 SYMBOL_LINK "panther_can6_out" 56 /end MEASUREMENT
/begin MEASUREMENT panther_can6_out.asw_out_can6_0x198_ELK_FR_LockingStatus "CAN6 transmit signal 2" UBYTE NO_COMPU_METHOD 1 100 0 3 ECU_ADDRESS 0x24026ed9 SYMBOL_LINK "panther_can6_out" 57 /end MEASUREMENT
/begin MEASUREMENT panther_can6_out.asw_out_can6_0x198_ELK_RL1_ActuatorStatus "CAN6 transmit signal 8" UBYTE NO_COMPU_METHOD 1 100 0 3 ECU_ADDRESS 0x24026f37 SYMBOL_LINK "panther_can6_out" 151 /end MEASUREMENT
/begin MEASUREMENT panther_can6_out.asw_out_can6_0x198_ELK_RL1_LockingStatus "CAN6 transmit signal 3" UBYTE NO_COMPU_METHOD 1 100 0 3 ECU_ADDRESS 0x24026eda SYMBOL_LINK "panther_can6_out" 58 /end MEASUREMENT
/begin MEASUREMENT panther_can6_out.asw_out_can6_0x198_ELK_RL2_ActuatorStatus "CAN6 transmit signal 9" UBYTE NO_COMPU_METHOD 1 100 0 3 ECU_ADDRESS 0x24026f38 SYMBOL_LINK "panther_can6_out" 152 /end MEASUREMENT
/begin MEASUREMENT panther_can6_out.asw_out_can6_0x198_ELK_RL2_LockingStatus "CAN6 transmit signal 4" UBYTE NO_COMPU_METHOD 1 100 0 3 ECU_ADDRESS 0x24026edb SYMBOL_LINK "panther_can6_out" 59 /end MEASUREMENT
/begin MEASUREMENT panther_can6_out.asw_out_can6_0x198_ELK_RR1_ActuatorStatus "CAN6 transmit signal 10" UBYTE NO_COMPU_METHOD 1 100 0 3 ECU_ADDRESS 0x24026f39 SYMBOL_LINK "panther_can6_out" 153 /end MEASUREMENT
/begin MEASUREMENT panther_can6_out.asw_out_can6_0x198_ELK_RR1_LockingStatus "CAN6 transmit signal 5" UBYTE NO_COMPU_METHOD 1 100 0 3 ECU_ADDRESS 0x24026edc SYMBOL_LINK "panther_can6_out" 60 /end MEASUREMENT
/begin MEASUREMENT panther_can6_out.asw_out_can6_0x198_tx_status "CAN6 Transmit Status" UBYTE NO_COMPU_METHOD 1 100 0 1 ECU_ADDRESS 0x24026ed7 SYMBOL_LINK "panther_can6_out" 55 /end MEASUREMENT
/begin MEASUREMENT panther_can6_out.asw_out_can6_0x199_BSW_FL_BuckleStatus "CAN6 transmit signal 1" UBYTE NO_COMPU_METHOD 1 100 0 1 ECU_ADDRESS 0x24026ede SYMBOL_LINK "panther_can6_out" 62 /end MEASUREMENT
/begin MEASUREMENT panther_can6_out.asw_out_can6_0x199_BSW_FR_BuckleStatus "CAN6 transmit signal 2" UBYTE NO_COMPU_METHOD 1 100 0 1 ECU_ADDRESS 0x24026edf SYMBOL_LINK "panther_can6_out" 63 /end MEASUREMENT
/begin MEASUREMENT panther_can6_out.asw_out_can6_0x199_BSW_RL1_BuckleStatus "CAN6 transmit signal 3" UBYTE NO_COMPU_METHOD 1 100 0 1 ECU_ADDRESS 0x24026ee0 SYMBOL_LINK "panther_can6_out" 64 /end MEASUREMENT
/begin MEASUREMENT panther_can6_out.asw_out_can6_0x199_BSW_RL2_BuckleStatus "CAN6 transmit signal 4" UBYTE NO_COMPU_METHOD 1 100 0 1 ECU_ADDRESS 0x24026ee1 SYMBOL_LINK "panther_can6_out" 65 /end MEASUREMENT
/begin MEASUREMENT panther_can6_out.asw_out_can6_0x199_BSW_RR1_BuckleStatus "CAN6 transmit signal 5" UBYTE NO_COMPU_METHOD 1 100 0 1 ECU_ADDRESS 0x24026ee2 SYMBOL_LINK "panther_can6_out" 66 /end MEASUREMENT
/begin MEASUREMENT panther_can6_out.asw_out_can6_0x199_tx_status "CAN6 Transmit Status" UBYTE NO_COMPU_METHOD 1 100 0 1 ECU_ADDRESS 0x24026edd SYMBOL_LINK "panther_can6_out" 61 /end MEASUREMENT
/begin MEASUREMENT panther_can6_out.asw_out_can6_0x19C_HB_State_FL "CAN6 transmit signal 1" UBYTE NO_COMPU_METHOD 1 100 0 255 ECU_ADDRESS 0x24026f41 SYMBOL_LINK "panther_can6_out" 161 /end MEASUREMENT
/begin MEASUREMENT panther_can6_out.asw_out_can6_0x19C_HB_State_FR "CAN6 transmit signal 2" UBYTE NO_COMPU_METHOD 1 100 0 255 ECU_ADDRESS 0x24026f42 SYMBOL_LINK "panther_can6_out" 162 /end MEASUREMENT
/begin MEASUREMENT panther_can6_out.asw_out_can6_0x19C_HB_State_RL1 "CAN6 transmit signal 3" UBYTE NO_COMPU_METHOD 1 100 0 255 ECU_ADDRESS 0x24026f43 SYMBOL_LINK "panther_can6_out" 163 /end MEASUREMENT
/begin MEASUREMENT panther_can6_out.asw_out_can6_0x19C_HB_State_RL2 "CAN6 transmit signal 4" UBYTE NO_COMPU_METHOD 1 100 0 255 ECU_ADDRESS 0x24026f44 SYMBOL_LINK "panther_can6_out" 164 /end MEASUREMENT
/begin MEASUREMENT panther_can6_out.asw_out_can6_0x19C_HB_State_RR1 "CAN6 transmit signal 5" UBYTE NO_COMPU_METHOD 1 100 0 255 ECU_ADDRESS 0x24026f45 SYMBOL_LINK "panther_can6_out" 165 /end MEASUREMENT
/begin MEASUREMENT panther_can6_out.asw_out_can6_0x19C_tx_status "CAN6 Transmit Status" UBYTE NO_COMPU_METHOD 1 100 0 1 ECU_ADDRESS 0x24026f40 SYMBOL_LINK "panther_can6_out" 160 /end MEASUREMENT
/begin MEASUREMENT panther_can6_out.asw_out_can6_0x200_COM_Status_PumaFRCan "CAN6 transmit signal 2" UBYTE NO_COMPU_METHOD 1 100 0 1 ECU_ADDRESS 0x24026f3c SYMBOL_LINK "panther_can6_out" 156 /end MEASUREMENT
/begin MEASUREMENT panther_can6_out.asw_out_can6_0x200_COM_Status_PumaRL1Can "CAN6 transmit signal 3" UBYTE NO_COMPU_METHOD 1 100 0 1 ECU_ADDRESS 0x24026f3d SYMBOL_LINK "panther_can6_out" 157 /end MEASUREMENT
/begin MEASUREMENT panther_can6_out.asw_out_can6_0x200_COM_Status_PumaRL2Can "CAN6 transmit signal 4" UBYTE NO_COMPU_METHOD 1 100 0 1 ECU_ADDRESS 0x24026f3e SYMBOL_LINK "panther_can6_out" 158 /end MEASUREMENT
/begin MEASUREMENT panther_can6_out.asw_out_can6_0x200_COM_Status_PumaRR1Can "CAN6 transmit signal 5" UBYTE NO_COMPU_METHOD 1 100 0 1 ECU_ADDRESS 0x24026f3f SYMBOL_LINK "panther_can6_out" 159 /end MEASUREMENT
/begin MEASUREMENT panther_can6_out.asw_out_can6_0x200_tx_status "CAN6 Transmit Status" UBYTE NO_COMPU_METHOD 1 100 0 1 ECU_ADDRESS 0x24026f3a SYMBOL_LINK "panther_can6_out" 154 /end MEASUREMENT
/begin MEASUREMENT panther_can6_out.asw_out_can6_0xB1_ARS_FL_InjuryRiskAdaptive "CAN6 transmit signal 1" UBYTE NO_COMPU_METHOD 1 100 0 255 ECU_ADDRESS 0x24026f0c SYMBOL_LINK "panther_can6_out" 108 /end MEASUREMENT
/begin MEASUREMENT panther_can6_out.asw_out_can6_0xB1_ARS_FL_InjuryRiskNonAdaptive "CAN6 transmit signal 2" UBYTE NO_COMPU_METHOD 1 100 0 255 ECU_ADDRESS 0x24026f0d SYMBOL_LINK "panther_can6_out" 109 /end MEASUREMENT
/begin MEASUREMENT panther_can6_out.asw_out_can6_0xB1_ARS_FR_InjuryRiskAdaptive "CAN6 transmit signal 3" UBYTE NO_COMPU_METHOD 1 100 0 255 ECU_ADDRESS 0x24026f0e SYMBOL_LINK "panther_can6_out" 110 /end MEASUREMENT
/begin MEASUREMENT panther_can6_out.asw_out_can6_0xB1_ARS_FR_InjuryRiskNonAdaptive "CAN6 transmit signal 4" UBYTE NO_COMPU_METHOD 1 100 0 255 ECU_ADDRESS 0x24026f0f SYMBOL_LINK "panther_can6_out" 111 /end MEASUREMENT
/begin MEASUREMENT panther_can6_out.asw_out_can6_0xB1_tx_status "CAN6 Transmit Status" UBYTE NO_COMPU_METHOD 1 100 0 1 ECU_ADDRESS 0x24026f0b SYMBOL_LINK "panther_can6_out" 107 /end MEASUREMENT
/begin MEASUREMENT panther_can6_out.asw_out_can6_0xB2_ARS_FL_TimeToFireAirbag "CAN6 transmit signal 1" UBYTE NO_COMPU_METHOD 1 100 0 255 ECU_ADDRESS 0x24026f07 SYMBOL_LINK "panther_can6_out" 103 /end MEASUREMENT
/begin MEASUREMENT panther_can6_out.asw_out_can6_0xB2_ARS_FL_TimeToFireSeatbelt "CAN6 transmit signal 2" UBYTE NO_COMPU_METHOD 1 100 0 255 ECU_ADDRESS 0x24026f08 SYMBOL_LINK "panther_can6_out" 104 /end MEASUREMENT
/begin MEASUREMENT panther_can6_out.asw_out_can6_0xB2_ARS_FR_TimeToFireAirbag "CAN6 transmit signal 3" UBYTE NO_COMPU_METHOD 1 100 0 255 ECU_ADDRESS 0x24026f09 SYMBOL_LINK "panther_can6_out" 105 /end MEASUREMENT
/begin MEASUREMENT panther_can6_out.asw_out_can6_0xB2_ARS_FR_TimeToFireSeatbelt "CAN6 transmit signal 4" UBYTE NO_COMPU_METHOD 1 100 0 255 ECU_ADDRESS 0x24026f0a SYMBOL_LINK "panther_can6_out" 106 /end MEASUREMENT
/begin MEASUREMENT panther_can6_out.asw_out_can6_0xB2_tx_status "CAN6 Transmit Status" UBYTE NO_COMPU_METHOD 1 100 0 1 ECU_ADDRESS 0x24026f06 SYMBOL_LINK "panther_can6_out" 102 /end MEASUREMENT
/begin MEASUREMENT panther_can6_out.asw_out_can6_0xBB_SPS_FL_FootRestPosition "CAN6 transmit signal 4" UWORD NO_COMPU_METHOD 1 100 0 4095 ECU_ADDRESS 0x24026eb4 SYMBOL_LINK "panther_can6_out" 20 /end MEASUREMENT
/begin MEASUREMENT panther_can6_out.asw_out_can6_0xBB_SPS_FL_HeadRestPosition "CAN6 transmit signal 5" UWORD NO_COMPU_METHOD 1 100 0 4095 ECU_ADDRESS 0x24026eb6 SYMBOL_LINK "panther_can6_out" 22 /end MEASUREMENT
/begin MEASUREMENT panther_can6_out.asw_out_can6_0xBB_SPS_FL_SeatBackRestPosition "CAN6 transmit signal 3" UWORD NO_COMPU_METHOD 1 100 0 4095 ECU_ADDRESS 0x24026eb2 SYMBOL_LINK "panther_can6_out" 18 /end MEASUREMENT
/begin MEASUREMENT panther_can6_out.asw_out_can6_0xBB_SPS_FL_SeatDirectionX "CAN6 transmit signal 1" UWORD NO_COMPU_METHOD 1 100 0 4095 ECU_ADDRESS 0x24026eae SYMBOL_LINK "panther_can6_out" 14 /end MEASUREMENT
/begin MEASUREMENT panther_can6_out.asw_out_can6_0xBB_SPS_FL_SeatDirectionZ "CAN6 transmit signal 2" UWORD NO_COMPU_METHOD 1 100 0 4095 ECU_ADDRESS 0x24026eb0 SYMBOL_LINK "panther_can6_out" 16 /end MEASUREMENT
/begin MEASUREMENT panther_can6_out.asw_out_can6_0xBB_tx_status "CAN6 Transmit Status" UBYTE NO_COMPU_METHOD 1 100 0 1 ECU_ADDRESS 0x24026eac SYMBOL_LINK "panther_can6_out" 12 /end MEASUREMENT
/begin MEASUREMENT panther_can6_out.asw_out_can6_0xBC_SPS_FR_FootRestPosition "CAN6 transmit signal 4" UWORD NO_COMPU_METHOD 1 100 0 4095 ECU_ADDRESS 0x24026ea8 SYMBOL_LINK "panther_can6_out" 8 /end MEASUREMENT
/begin MEASUREMENT panther_can6_out.asw_out_can6_0xBC_SPS_FR_HeadRestPosition "CAN6 transmit signal 5" UWORD NO_COMPU_METHOD 1 100 0 4095 ECU_ADDRESS 0x24026eaa SYMBOL_LINK "panther_can6_out" 10 /end MEASUREMENT
/begin MEASUREMENT panther_can6_out.asw_out_can6_0xBC_SPS_FR_SeatBackRestPosition "CAN6 transmit signal 3" UWORD NO_COMPU_METHOD 1 100 0 4095 ECU_ADDRESS 0x24026ea6 SYMBOL_LINK "panther_can6_out" 6 /end MEASUREMENT
/begin MEASUREMENT panther_can6_out.asw_out_can6_0xBC_SPS_FR_SeatDirectionX "CAN6 transmit signal 1" UWORD NO_COMPU_METHOD 1 100 0 4095 ECU_ADDRESS 0x24026ea2 SYMBOL_LINK "panther_can6_out" 2 /end MEASUREMENT
/begin MEASUREMENT panther_can6_out.asw_out_can6_0xBC_SPS_FR_SeatDirectionZ "CAN6 transmit signal 2" UWORD NO_COMPU_METHOD 1 100 0 4095 ECU_ADDRESS 0x24026ea4 SYMBOL_LINK "panther_can6_out" 4 /end MEASUREMENT
/begin MEASUREMENT panther_can6_out.asw_out_can6_0xBC_tx_status "CAN6 Transmit Status" UBYTE NO_COMPU_METHOD 1 100 0 1 ECU_ADDRESS 0x24026ea0 SYMBOL_LINK "panther_can6_out" 0 /end MEASUREMENT
/begin MEASUREMENT panther_can6_out.asw_out_can6_0xC1_STS_BDS_FL_DataByte1 "CAN6 transmit signal 1" UBYTE NO_COMPU_METHOD 1 100 0 255 ECU_ADDRESS 0x24026f12 SYMBOL_LINK "panther_can6_out" 114 /end MEASUREMENT
/begin MEASUREMENT panther_can6_out.asw_out_can6_0xC1_STS_BDS_FL_DataByte2 "CAN6 transmit signal 2" UBYTE NO_COMPU_METHOD 1 100 0 255 ECU_ADDRESS 0x24026f13 SYMBOL_LINK "panther_can6_out" 115 /end MEASUREMENT
/begin MEASUREMENT panther_can6_out.asw_out_can6_0xC1_STS_BDS_FL_DataByte3 "CAN6 transmit signal 3" UBYTE NO_COMPU_METHOD 1 100 0 255 ECU_ADDRESS 0x24026f14 SYMBOL_LINK "panther_can6_out" 116 /end MEASUREMENT
/begin MEASUREMENT panther_can6_out.asw_out_can6_0xC1_STS_BDS_FL_DataByte4 "CAN6 transmit signal 4" UBYTE NO_COMPU_METHOD 1 100 0 255 ECU_ADDRESS 0x24026f15 SYMBOL_LINK "panther_can6_out" 117 /end MEASUREMENT
/begin MEASUREMENT panther_can6_out.asw_out_can6_0xC1_STS_BDS_FL_DataByte5 "CAN6 transmit signal 5" UBYTE NO_COMPU_METHOD 1 100 0 255 ECU_ADDRESS 0x24026f16 SYMBOL_LINK "panther_can6_out" 118 /end MEASUREMENT
/begin MEASUREMENT panther_can6_out.asw_out_can6_0xC1_STS_BDS_FL_DataByte6 "CAN6 transmit signal 6" UBYTE NO_COMPU_METHOD 1 100 0 255 ECU_ADDRESS 0x24026f17 SYMBOL_LINK "panther_can6_out" 119 /end MEASUREMENT
/begin MEASUREMENT panther_can6_out.asw_out_can6_0xC1_STS_BDS_FL_DataByte7 "CAN6 transmit signal 7" UBYTE NO_COMPU_METHOD 1 100 0 255 ECU_ADDRESS 0x24026f18 SYMBOL_LINK "panther_can6_out" 120 /end MEASUREMENT
/begin MEASUREMENT panther_can6_out.asw_out_can6_0xC1_STS_BDS_FL_DataByte8 "CAN6 transmit signal 8" UBYTE NO_COMPU_METHOD 1 100 0 255 ECU_ADDRESS 0x24026f19 SYMBOL_LINK "panther_can6_out" 121 /end MEASUREMENT
/begin MEASUREMENT panther_can6_out.asw_out_can6_0xC2_STS_BDS_FL_DataByte10 "CAN6 transmit signal 2" UBYTE NO_COMPU_METHOD 1 100 0 255 ECU_ADDRESS 0x24026f1c SYMBOL_LINK "panther_can6_out" 124 /end MEASUREMENT
/begin MEASUREMENT panther_can6_out.asw_out_can6_0xC2_STS_BDS_FL_DataByte11 "CAN6 transmit signal 3" UBYTE NO_COMPU_METHOD 1 100 0 255 ECU_ADDRESS 0x24026f1d SYMBOL_LINK "panther_can6_out" 125 /end MEASUREMENT
/begin MEASUREMENT panther_can6_out.asw_out_can6_0xC2_STS_BDS_FL_DataByte12 "CAN6 transmit signal 4" UBYTE NO_COMPU_METHOD 1 100 0 255 ECU_ADDRESS 0x24026f1e SYMBOL_LINK "panther_can6_out" 126 /end MEASUREMENT
/begin MEASUREMENT panther_can6_out.asw_out_can6_0xC2_STS_BDS_FL_DataByte13 "CAN6 transmit signal 5" UBYTE NO_COMPU_METHOD 1 100 0 255 ECU_ADDRESS 0x24026f1f SYMBOL_LINK "panther_can6_out" 127 /end MEASUREMENT
/begin MEASUREMENT panther_can6_out.asw_out_can6_0xC2_STS_BDS_FL_DataByte14 "CAN6 transmit signal 6" UBYTE NO_COMPU_METHOD 1 100 0 255 ECU_ADDRESS 0x24026f20 SYMBOL_LINK "panther_can6_out" 128 /end MEASUREMENT
/begin MEASUREMENT panther_can6_out.asw_out_can6_0xC2_STS_BDS_FL_DataByte15 "CAN6 transmit signal 7" UBYTE NO_COMPU_METHOD 1 100 0 255 ECU_ADDRESS 0x24026f21 SYMBOL_LINK "panther_can6_out" 129 /end MEASUREMENT
/begin MEASUREMENT panther_can6_out.asw_out_can6_0xC2_STS_BDS_FL_DataByte16 "CAN6 transmit signal 8" UBYTE NO_COMPU_METHOD 1 100 0 255 ECU_ADDRESS 0x24026f22 SYMBOL_LINK "panther_can6_out" 130 /end MEASUREMENT
/begin MEASUREMENT panther_can6_out.asw_out_can6_0xC2_STS_BDS_FL_DataByte9 "CAN6 transmit signal 1" UBYTE NO_COMPU_METHOD 1 100 0 255 ECU_ADDRESS 0x24026f1b SYMBOL_LINK "panther_can6_out" 123 /end MEASUREMENT
/begin MEASUREMENT panther_can6_out.asw_out_can6_0xC2_tx_status "CAN6 Transmit Status" UBYTE NO_COMPU_METHOD 1 100 0 1 ECU_ADDRESS 0x24026f1a SYMBOL_LINK "panther_can6_out" 122 /end MEASUREMENT
/begin MEASUREMENT panther_can6_out.asw_out_can6_0xC3_STS_BDS_FR_DataByte1 "CAN6 transmit signal 1" UBYTE NO_COMPU_METHOD 1 100 0 255 ECU_ADDRESS 0x24026f24 SYMBOL_LINK "panther_can6_out" 132 /end MEASUREMENT
/begin MEASUREMENT panther_can6_out.asw_out_can6_0xC3_STS_BDS_FR_DataByte2 "CAN6 transmit signal 2" UBYTE NO_COMPU_METHOD 1 100 0 255 ECU_ADDRESS 0x24026f25 SYMBOL_LINK "panther_can6_out" 133 /end MEASUREMENT
/begin MEASUREMENT panther_can6_out.asw_out_can6_0xC3_STS_BDS_FR_DataByte3 "CAN6 transmit signal 3" UBYTE NO_COMPU_METHOD 1 100 0 255 ECU_ADDRESS 0x24026f26 SYMBOL_LINK "panther_can6_out" 134 /end MEASUREMENT
/begin MEASUREMENT panther_can6_out.asw_out_can6_0xC3_STS_BDS_FR_DataByte4 "CAN6 transmit signal 4" UBYTE NO_COMPU_METHOD 1 100 0 255 ECU_ADDRESS 0x24026f27 SYMBOL_LINK "panther_can6_out" 135 /end MEASUREMENT
/begin MEASUREMENT panther_can6_out.asw_out_can6_0xC3_STS_BDS_FR_DataByte5 "CAN6 transmit signal 5" UBYTE NO_COMPU_METHOD 1 100 0 255 ECU_ADDRESS 0x24026f28 SYMBOL_LINK "panther_can6_out" 136 /end MEASUREMENT
/begin MEASUREMENT panther_can6_out.asw_out_can6_0xC3_STS_BDS_FR_DataByte6 "CAN6 transmit signal 6" UBYTE NO_COMPU_METHOD 1 100 0 255 ECU_ADDRESS 0x24026f29 SYMBOL_LINK "panther_can6_out" 137 /end MEASUREMENT
/begin MEASUREMENT panther_can6_out.asw_out_can6_0xC3_STS_BDS_FR_DataByte7 "CAN6 transmit signal 7" UBYTE NO_COMPU_METHOD 1 100 0 255 ECU_ADDRESS 0x24026f2a SYMBOL_LINK "panther_can6_out" 138 /end MEASUREMENT
/begin MEASUREMENT panther_can6_out.asw_out_can6_0xC3_STS_BDS_FR_DataByte8 "CAN6 transmit signal 8" UBYTE NO_COMPU_METHOD 1 100 0 255 ECU_ADDRESS 0x24026f2b SYMBOL_LINK "panther_can6_out" 139 /end MEASUREMENT
/begin MEASUREMENT panther_can6_out.asw_out_can6_0xC3_tx_status "CAN6 Transmit Status" UBYTE NO_COMPU_METHOD 1 100 0 1 ECU_ADDRESS 0x24026f23 SYMBOL_LINK "panther_can6_out" 131 /end MEASUREMENT
/begin MEASUREMENT panther_can6_out.asw_out_can6_0xC4_STS_BDS_FR_DataByte10 "CAN6 transmit signal 2" UBYTE NO_COMPU_METHOD 1 100 0 255 ECU_ADDRESS 0x24026f2e SYMBOL_LINK "panther_can6_out" 142 /end MEASUREMENT
/begin MEASUREMENT panther_can6_out.asw_out_can6_0xC4_STS_BDS_FR_DataByte11 "CAN6 transmit signal 3" UBYTE NO_COMPU_METHOD 1 100 0 255 ECU_ADDRESS 0x24026f2f SYMBOL_LINK "panther_can6_out" 143 /end MEASUREMENT
/begin MEASUREMENT panther_can6_out.asw_out_can6_0xC4_STS_BDS_FR_DataByte12 "CAN6 transmit signal 4" UBYTE NO_COMPU_METHOD 1 100 0 255 ECU_ADDRESS 0x24026f30 SYMBOL_LINK "panther_can6_out" 144 /end MEASUREMENT
/begin MEASUREMENT panther_can6_out.asw_out_can6_0xC4_STS_BDS_FR_DataByte13 "CAN6 transmit signal 5" UBYTE NO_COMPU_METHOD 1 100 0 255 ECU_ADDRESS 0x24026f31 SYMBOL_LINK "panther_can6_out" 145 /end MEASUREMENT
/begin MEASUREMENT panther_can6_out.asw_out_can6_0xC4_STS_BDS_FR_DataByte14 "CAN6 transmit signal 6" UBYTE NO_COMPU_METHOD 1 100 0 255 ECU_ADDRESS 0x24026f32 SYMBOL_LINK "panther_can6_out" 146 /end MEASUREMENT
/begin MEASUREMENT panther_can6_out.asw_out_can6_0xC4_STS_BDS_FR_DataByte15 "CAN6 transmit signal 7" UBYTE NO_COMPU_METHOD 1 100 0 255 ECU_ADDRESS 0x24026f33 SYMBOL_LINK "panther_can6_out" 147 /end MEASUREMENT
/begin MEASUREMENT panther_can6_out.asw_out_can6_0xC4_STS_BDS_FR_DataByte16 "CAN6 transmit signal 8" UBYTE NO_COMPU_METHOD 1 100 0 255 ECU_ADDRESS 0x24026f34 SYMBOL_LINK "panther_can6_out" 148 /end MEASUREMENT
/begin MEASUREMENT panther_can6_out.asw_out_can6_0xC4_STS_BDS_FR_DataByte9 "CAN6 transmit signal 1" UBYTE NO_COMPU_METHOD 1 100 0 255 ECU_ADDRESS 0x24026f2d SYMBOL_LINK "panther_can6_out" 141 /end MEASUREMENT
/begin MEASUREMENT panther_can6_out.asw_out_can6_0xC4_tx_status "CAN6 Transmit Status" UBYTE NO_COMPU_METHOD 1 100 0 1 ECU_ADDRESS 0x24026f2c SYMBOL_LINK "panther_can6_out" 140 /end MEASUREMENT
/begin MEASUREMENT PathSegment_readIter_in "" SWORD NO_COMPU_METHOD 1 100 -32768 32767 ECU_ADDRESS 0x24025bb0 /end MEASUREMENT
/begin MEASUREMENT remind_index_PathSegment "" SWORD NO_COMPU_METHOD 1 100 -32768 32767 ECU_ADDRESS 0x240253de /end MEASUREMENT
/begin MEASUREMENT Result_Curvature_interpolated "" SWORD EQ_LSB_1em05 1 100 -0.32768 0.32767 ECU_ADDRESS 0x24025bb6 /end MEASUREMENT
/begin MEASUREMENT Sa3_ABL_ACR_PRIO_ReleaseStable_FL "" UBYTE NO_COMPU_METHOD 1 100 0 1 ECU_ADDRESS 0x24026c54 /end MEASUREMENT
/begin MEASUREMENT Sa3_ABL_ACR_PRIO_ReleaseStable_FR "" UBYTE NO_COMPU_METHOD 1 100 0 1 ECU_ADDRESS 0x24026c60 /end MEASUREMENT
/begin MEASUREMENT Sa3_SMA_CarStable "" UBYTE NO_COMPU_METHOD 1 100 0 1 ECU_ADDRESS 0x24026d74 /end MEASUREMENT
/begin MEASUREMENT StateControl_read "" SWORD NO_COMPU_METHOD 1 100 -32768 32767 ECU_ADDRESS 0x24025bd0 /end MEASUREMENT
/begin MEASUREMENT StateControl_write "" SWORD NO_COMPU_METHOD 1 100 -32768 32767 ECU_ADDRESS 0x24025be2 /end MEASUREMENT
/begin MEASUREMENT Switch "" SWORD EQ_LSB_0_002 1 100 -65.536 65.534 ECU_ADDRESS 0x24025be0 /end MEASUREMENT
/begin MEASUREMENT VehiclePosn_Curv "" UWORD EQ_LSB_0_2 1 100 0 13107 ECU_ADDRESS 0x24025bbc /end MEASUREMENT
/begin MEASUREMENT VehiclePosn_interpolated "" UWORD EQ_LSB_0_2 1 100 0 13107 ECU_ADDRESS 0x24026b8c /end MEASUREMENT
/begin MEASUREMENT VehiclePosn_Stub "" UWORD EQ_LSB_0_2 1 100 0 13107 ECU_ADDRESS 0x24026b92 /end MEASUREMENT
/begin COMPU_METHOD EQ_LSB_0_002 "" LINEAR "%6.3" "" COEFFS_LINEAR 0.002 0 /end COMPU_METHOD
/begin COMPU_METHOD EQ_LSB_0_005 "" LINEAR "%7.3" "" COEFFS_LINEAR 0.005 0 /end COMPU_METHOD
/begin COMPU_METHOD EQ_LSB_0_006 "" LINEAR "%7.3" "" COEFFS_LINEAR 0.006 0 /end COMPU_METHOD
/begin COMPU_METHOD EQ_LSB_0_01 "" LINEAR "%6.2" "" COEFFS_LINEAR 0.01 0 /end COMPU_METHOD
/begin COMPU_METHOD EQ_LSB_0_02 "" LINEAR "%6.2" "" COEFFS_LINEAR 0.02 0 /end COMPU_METHOD
/begin COMPU_METHOD EQ_LSB_0_05 "" LINEAR "%5.2" "" COEFFS_LINEAR 0.05 0 /end COMPU_METHOD
/begin COMPU_METHOD EQ_LSB_0_2 "" LINEAR "%7.1" "" COEFFS_LINEAR 0.2 0 /end COMPU_METHOD
/begin COMPU_METHOD EQ_LSB_1em05 "" LINEAR "%6.5" "" COEFFS_LINEAR 1e-05 0 /end COMPU_METHOD
/begin COMPU_METHOD SMA_FNC_YawRate_Z "" LINEAR "%6.2" "deg/s" COEFFS_LINEAR 0.01 0 /end COMPU_METHOD
/begin FUNCTION ADAS_Stub_Write_Read.Instance1 ""
 /begin LOC_MEASUREMENT VehiclePosn_Stub Array_ADAS_Stub_FuncRoadClass Array_ADAS_Stub_FuncRoadClass_1 Array_ADAS_Stub_FuncRoadClass_2 Array_ADAS_Stub_Offset Array_ADAS_Stub_PartRoute Array_ADAS_Stub_PartRoute_1 Array_ADAS_Stub_PartRoute_2 Array_ADAS_Stub_PathIdx Array_ADAS_Stub_SubPathIdx Array_ADAS_Stub_SubPathIdx_1 Array_ADAS_Stub_SubPathIdx_2 Array_ADAS_Stub_TurnAngle Array_ADAS_Stub_TurnAngle_1 Array_ADAS_Stub_TurnAngle_2 Array_ADAS_Stub_WayForm Array_ADAS_Stub_WayForm_1 Array_ADAS_Stub_WayForm_2 Array_Seg_ADAS_Seg_AreaBuildUp Array_Seg_ADAS_Seg_NumOfLaneDrvDir Array_Seg_ADAS_Seg_Offset Array_Seg_ADAS_Seg_PathIdx DebugOut_ADAS_Seg_Offset_pre DebugOut_ADAS_Seg_PathIdx_pre DebugOut_SegIndex_read DebugOut_Seg_SegIndexWriteOut DebugOut_Seg_StateControl_read DebugOut_Seg_StateControl_write DebugOut_Seg_actual_AreaBuildUp DebugOut_Seg_actual_NumOfLaneDrvDir DebugOut_Seg_actual_Offset DebugOut_Seg_next1_NumOfLaneDrvDir DebugOut_Seg_next1_Offset DebugOut_Seg_next2_Offset DebugOut_Seg_next_NumOfLaneDrvDir DebugOut_Seg_next_Offset DebugOut_Seg_next_PathIdx DebugOut_Seg_remind_initial_S_I_W DebugOut_Stub_IndexRead DebugOut_Stub_IndexWrite DebugOut_Stub_StateControl_read DebugOut_Stub_StateControl_write DebugOut_Stub_next_FuncRoadClass_1 DebugOut_Stub_next_FuncRoadClass_2 DebugOut_Stub_next_FuncRoadClass_3 DebugOut_Stub_next_FuncRoadClass_4 DebugOut_Stub_next_FuncroadClass DebugOut_Stub_next_Offset DebugOut_Stub_next_PartRoute DebugOut_Stub_next_PartRoute_1 DebugOut_Stub_next_PartRoute_2 DebugOut_Stub_next_PartRoute_3 DebugOut_Stub_next_PartRoute_4 DebugOut_Stub_next_PathIdx DebugOut_Stub_next_SubPathIdx DebugOut_Stub_next_SubPathIdx_1 DebugOut_Stub_next_SubPathIdx_2 DebugOut_Stub_next_SubPathIdx_3 DebugOut_Stub_next_SubPathIdx_4 DebugOut_Stub_next_TurnAngle DebugOut_Stub_next_TurnAngle_1 DebugOut_Stub_next_TurnAngle_2 DebugOut_Stub_next_TurnAngle_3 DebugOut_Stub_next_TurnAngle_4 DebugOut_Stub_next_WayForm DebugOut_Stub_next_WayForm_1 DebugOut_Stub_next_WayForm_2 DebugOut_Stub_next_WayForm_3 DebugOut_Stub_next_WayForm_4 DebugOut_Stub_remind_initial_S_I_W Debug_ADAS_Seg_Retr Debugout_TurnLane_detected /end LOC_MEASUREMENT
 /begin SUB_FUNCTION CADAS_Stub_Write_Read21_Storage_of_ADAS_Seg_data.Instance1 /end SUB_FUNCTION
/end FUNCTION
/begin FUNCTION AL_ACR_DAG_DynamicSupport_VS07_DecisionLogic_ADAS "" /begin DEF_CHARACTERISTIC ADAS_Retract_definition_point /end DEF_CHARACTERISTIC
 /begin LOC_MEASUREMENT Curv_Offset_1_out Curv_Offset_2_out Curv_Value_1_out Curv_Value_2_out Curv_index_read_out ADAS_AY_Requested ADAS_ay_Limit ADAS_2_ay_Limit ADAS_exp_lateralAcceleration Abs_Value0 Abs_Value1 Debug_curvature_value0 Debug_curvature_value1 Curvature_interpolated Result_Curvature_interpolated ADAS_Posn_Offset_FallingEdge Array_ADAS_Curv_Offset Array_ADAS_Curv_PathIdx Array_ADAS_Curv_Value Curv_remind_Initial_index Debug_Offset_1 Debug_Offset_2 Debug_PathChange_Control Debug_transmission8km PathSegment_readIter_in StateControl_read StateControl_write fill_Iter_out index_out remind_index_PathSegment ADAS_VehSpd_ms Switch VehiclePosn_interpolated VehiclePosn_Curv VehiclePosn_Stub /end LOC_MEASUREMENT
 /begin SUB_FUNCTION CVS0713_Storage_of_ADAS_data.Instance1 CVS071_Read_ADAS_data.Instance1 JncLogic.Instance1 ADAS_Stub_Write_Read.Instance1 /end SUB_FUNCTION
/end FUNCTION
/begin FUNCTION AL_Mainfunction_PANTHER_10ms ""
 /begin LOC_MEASUREMENT ALI_BrakePressCalc Debug_ALI_CountryCode Debug_ALI_ISw_Stat Debug_VehAccel_Y Debug_VehAccel_X DEBUGOUT_ALI_OffroadSport_activated DEBUGOUT_ALI_ESP_deactivated Debug_E_classVersion DEBUGOUT_ELK_Lock_Status_RL1 DEBUGOUT_ELK_Lock_Status_RL2 DEBUGOUT_ELK_Lock_Status_RR1 DEBUGOUT_ELK_Algo_Status_RL1 DEBUGOUT_ELK_Algo_Status_RL2 DEBUGOUT_ELK_Algo_Status_RR1 DEBUGOUT_ELK_ECU_Status_RL1 DEBUGOUT_ELK_ECU_Status_RL2 DEBUGOUT_ELK_ECU_Status_RR1 DEBUGOUT_HMI_ABL_Rx_Status DEBUGOUT_HMI_ABL_FR_RetractRequest DEBUGOUT_HMI_ABL_FL_RetractRequest DEBUGOUT_HMI_ABL_RL1_RetractRequest DEBUGOUT_HMI_ABL_RL2_RetractRequest DEBUGOUT_HMI_ABL_RR1_RetractRequest DEBUGOUT_HMI_ACR_Rx_Status DEBUGOUT_HMI_ACR_FR_RetractRequest DEBUGOUT_HMI_ACR_FL_RetractRequest DEBUGOUT_HMI_ACR_RL1_RetractRequest DEBUGOUT_HMI_ACR_RL2_RetractRequest DEBUGOUT_HMI_ACR_RR1_RetractRequest DEBUGOUT_HMI_ELK_Rx_Status DEBUGOUT_HMI_ELK_RL1_LockingRequest DEBUGOUT_HMI_ELK_FR_LockingRequest DEBUGOUT_HMI_ELK_FL_LockingRequest DEBUGOUT_HMI_ELK_RL2_LockingRequest DEBUGOUT_HMI_ELK_RR1_LockingRequest DEBUGOUT_HMI_ELK_ResetErrorFlags DEBUGOUT_HMI_ISB_FL_Rx_Status DEBUGOUT_HMI_ISB_FL_AddressByte1_byte DEBUGOUT_HMI_ISB_FL_ColorBlue_byte DEBUGOUT_HMI_ISB_FL_ColorGreen_byte DEBUGOUT_HMI_ISB_FL_ColorRed_byte DEBUGOUT_HMI_ISB_FL_Intensity_perc DEBUGOUT_HMI_ISB_FL_Normalization_bool DEBUGOUT_HMI_ISB_FL_Transitionspeed_nibble DEBUGOUT_HMI_ISB_FL_AddressByte0_byte DEBUGOUT_HMI_ISB_FL_GroupOrModule_bool DEBUGOUT_HMI_ISB_FR_Rx_Status DEBUGOUT_HMI_ISB_FR_AddressByte1 DEBUGOUT_HMI_ISB_FR_ColorBlue DEBUGOUT_HMI_ISB_FR_ColorGreen DEBUGOUT_HMI_ISB_FR_ColorRed DEBUGOUT_HMI_ISB_FR_Intensity_perc DEBUGOUT_HMI_ISB_FR_Normalization DEBUGOUT_HMI_ISB_FR_Transitionspeed DEBUGOUT_HMI_ISB_FR_AddressByte0 DEBUGOUT_HMI_ISB_FR_GroupOrModule DEBUGOUT_HMI_ISB_RL1_Rx_Status DEBUGOUT_HMI_ISB_RL1_AddressByte1 DEBUGOUT_HMI_ISB_RL1_ColorBlue DEBUGOUT_HMI_ISB_RL1_ColorGreen DEBUGOUT_HMI_ISB_RL1_ColorRed DEBUGOUT_HMI_ISB_RL1_Intensity DEBUGOUT_HMI_ISB_RL1_Normalization DEBUGOUT_HMI_ISB_RL1_Transitionspeed DEBUGOUT_HMI_ISB_RL1_AddressByte0 DEBUGOUT_HMI_ISB_RL1_GroupOrModule DEBUGOUT_HMI_ISB_RL2_Rx_Status DEBUGOUT_HMI_ISB_RL2_AddressByte1 DEBUGOUT_HMI_ISB_RL2_ColorBlue DEBUGOUT_HMI_ISB_RL2_ColorGreen DEBUGOUT_HMI_ISB_RL2_ColorRed DEBUGOUT_HMI_ISB_RL2_Intensity DEBUGOUT_HMI_ISB_RL2_Normalization DEBUGOUT_HMI_ISB_RL2_Transitionspeed DEBUGOUT_HMI_ISB_RL2_AddressByte0 DEBUGOUT_HMI_ISB_RL2_GroupOrModule DEBUGOUT_HMI_ISB_RR1_Rx_Status DEBUGOUT_HMI_ISB_RR1_AddressByte1 DEBUGOUT_HMI_ISB_RR1_ColorBlue DEBUGOUT_HMI_ISB_RR1_ColorGreen DEBUGOUT_HMI_ISB_RR1_ColorRed DEBUGOUT_HMI_ISB_RR1_Intensity DEBUGOUT_HMI_ISB_RR1_Normalization DEBUGOUT_HMI_ISB_RR1_Transitionspeed DEBUGOUT_HMI_ISB_RR1_AddressByte0 DEBUGOUT_HMI_ISB_RR1_GroupOrModule DEBUGOUT_HMI_SEAL_ActivationRequest DEBUGOUT_OMS_FL_Rx_Status DEBUGOUT_OMS_FL_OccupantClassification DEBUGOUT_OMS_RL2_OccupantClassification DEBUGOUT_OMS_RR1_OccupantClassification DEBUGOUT_OMS_FR_OccupantPresence DEBUGOUT_OMS_RL1_OutOfPosition DEBUGOUT_OMS_FL_OccupantWeightMean_kg DEBUGOUT_OMS_FR_OccupantWeightStd_kg DEBUGOUT_OMS_RR1_OccupantPresence DEBUGOUT_OMS_RL1_OccupantPresence DEBUGOUT_OMS_RL2_OccupantPresence DEBUGOUT_OMS_FL_OccupantPresence DEBUGOUT_OMS_FR_OutOfPosition DEBUGOUT_OMS_RL2_OutOfPosition DEBUGOUT_OMS_FL_OutOfPosition DEBUGOUT_OMS_FL_OccupantWeightStd_kg DEBUGOUT_OMS_RR1_OutOfPosition DEBUGOUT_OMS_FR_OccupantWeightMean_kg DEBUGOUT_OMS_RR1_OccupantWeightMean_kg DEBUGOUT_OMS_FR_OccupantHeightMean_cm DEBUGOUT_OMS_RL1_OccupantHeightStd_cm DEBUGOUT_OMS_RL2_OccupantWeightStd_kg DEBUGOUT_OMS_FR_Rx_Status DEBUGOUT_OMS_RL1_OccupantWeightStd_kg DEBUGOUT_OMS_RL1_OccupantWeightMean_kg DEBUGOUT_OMS_RR1_OccupantWeightStd_kg DEBUGOUT_OMS_FL_OccupantHeightStd_cm DEBUGOUT_OMS_RL2_OccupantWeightMean_kg DEBUGOUT_OMS_FR_OccupantHeightStd_cm DEBUGOUT_OMS_FL_OccupantHeightMean_cm DEBUGOUT_OMS_RL1_OccupantHeightMean_cm DEBUGOUT_OMS_RL1_Rx_Status DEBUGOUT_OMS_RL2_OccupantHeightStd_cm DEBUGOUT_OMS_RL2_OccupantHeightMean_cm DEBUGOUT_OMS_RR1_OccupantHeightStd_cm DEBUGOUT_OMS_RR1_OccupantHeightMean_cm DEBUGOUT_OMS_RL2_Rx_Status DEBUGOUT_OMS_FL_HandsOnWheel DEBUGOUT_OMS_RR1_Rx_Status DEBUGOUT_OMS_RL1_OccupantClassification DEBUGOUT_OMS_FR_OccupantClassification check_ACR_Activation_ALO_CAN2_FL check_ACR_Activation_ALO_CAN2_RL2 DEBUGOUT_ALO_COM_Status_PumaFLCan DEBUGOUT_ALO_COM_Status_PumaFRCan DEBUGOUT_ALO_COM_Status_PumaRL1Can DEBUGOUT_ALO_COM_Status_PumaRL2Can DEBUGOUT_ALO_COM_Status_PumaRR1Can DEBUGOUT_ALO_HB_State_FR DEBUGOUT_ALO_HB_State_RL1 DEBUGOUT_ALO_HB_State_RL2 DEBUGOUT_ALO_HB_State_RR1 Sa3_SMA_CarStable Sa3_ABL_ACR_PRIO_ReleaseStable_FL Sa3_ABL_ACR_PRIO_ReleaseStable_FR ALI_YawRate_Z_degs panther_can2_out.asw_out_can2_0xA4_tx_status panther_can2_out.asw_out_can2_0xA4_ISB_RR1_ColorGreen panther_can2_out.asw_out_can2_0xA4_ISB_RR1_ColorBlue panther_can2_out.asw_out_can2_0xA4_ISB_RR1_ColorRed panther_can2_out.asw_out_can2_0xA4_ISB_RR1_Intensity panther_can2_out.asw_out_can2_0xA4_ISB_RR1_Normalization panther_can2_out.asw_out_can2_0xA4_ISB_RR1_Transitionspeed panther_can2_out.asw_out_can2_0xA4_ISB_RR1_GroupOrModule panther_can2_out.asw_out_can2_0xA4_ISB_RR1_AddressByte0 panther_can2_out.asw_out_can2_0xA4_ISB_RR1_AddressByte1 panther_can2_out.asw_out_can2_0xA3_tx_status panther_can2_out.asw_out_can2_0xA3_ISB_RL2_ColorGreen panther_can2_out.asw_out_can2_0xA3_ISB_RL2_ColorBlue panther_can2_out.asw_out_can2_0xA3_ISB_RL2_ColorRed panther_can2_out.asw_out_can2_0xA3_ISB_RL2_Intensity panther_can2_out.asw_out_can2_0xA3_ISB_RL2_Normalization panther_can2_out.asw_out_can2_0xA3_ISB_RL2_Transitionspeed panther_can2_out.asw_out_can2_0xA3_ISB_RL2_GroupOrModule panther_can2_out.asw_out_can2_0xA3_ISB_RL2_AddressByte0 panther_can2_out.asw_out_can2_0xA3_ISB_RL2_AddressByte1 panther_can2_out.asw_out_can2_0xA2_tx_status panther_can2_out.asw_out_can2_0xA2_ISB_RL1_ColorGreen panther_can2_out.asw_out_can2_0xA2_ISB_RL1_ColorBlue panther_can2_out.asw_out_can2_0xA2_ISB_RL1_ColorRed panther_can2_out.asw_out_can2_0xA2_ISB_RL1_Intensity panther_can2_out.asw_out_can2_0xA2_ISB_RL1_Normalization panther_can2_out.asw_out_can2_0xA2_ISB_RL1_Transitionspeed panther_can2_out.asw_out_can2_0xA2_ISB_RL1_GroupOrModule panther_can2_out.asw_out_can2_0xA2_ISB_RL1_AddressByte0 panther_can2_out.asw_out_can2_0xA2_ISB_RL1_AddressByte1 panther_can2_out.asw_out_can2_0xA1_tx_status panther_can2_out.asw_out_can2_0xA1_ISB_FR_ColorGreen panther_can2_out.asw_out_can2_0xA1_ISB_FR_ColorBlue panther_can2_out.asw_out_can2_0xA1_ISB_FR_ColorRed panther_can2_out.asw_out_can2_0xA1_ISB_FR_Intensity_perc panther_can2_out.asw_out_can2_0xA1_ISB_FR_Normalization panther_can2_out.asw_out_can2_0xA1_ISB_FR_Transitionspeed panther_can2_out.asw_out_can2_0xA1_ISB_FR_GroupOrModule panther_can2_out.asw_out_can2_0xA1_ISB_FR_AddressByte0 panther_can2_out.asw_out_can2_0xA1_ISB_FR_AddressByte1 panther_can2_out.asw_out_can2_0xA0_tx_status panther_can2_out.asw_out_can2_0xA0_ISB_FL_ColorGreen_byte panther_can2_out.asw_out_can2_0xA0_ISB_FL_ColorBlue_byte panther_can2_out.asw_out_can2_0xA0_ISB_FL_ColorRed_byte panther_can2_out.asw_out_can2_0xA0_ISB_FL_Intensity_perc panther_can2_out.asw_out_can2_0xA0_ISB_FL_Normalization_bool panther_can2_out.asw_out_can2_0xA0_ISB_FL_Transitionspeed_nibble panther_can2_out.asw_out_can2_0xA0_ISB_FL_GroupOrModule_bool panther_can2_out.asw_out_can2_0xA0_ISB_FL_AddressByte0_byte panther_can2_out.asw_out_can2_0xA0_ISB_FL_AddressByte1_byte panther_can2_out.asw_out_can2_0x91_tx_status panther_can2_out.asw_out_can2_0x91_ACR_FL_RetractRequest panther_can2_out.asw_out_can2_0x91_ACR_FR_RetractRequest panther_can2_out.asw_out_can2_0x91_ACR_RL1_RetractRequest panther_can2_out.asw_out_can2_0x91_ACR_RL2_RetractRequest panther_can2_out.asw_out_can2_0x91_ACR_RR1_RetractRequest panther_can2_out.asw_out_can2_0x90_tx_status panther_can2_out.asw_out_can2_0x90_ABL_FL_RetractRequest panther_can2_out.asw_out_can2_0x90_ABL_FR_RetractRequest panther_can2_out.asw_out_can2_0x90_ABL_RL1_RetractRequest panther_can2_out.asw_out_can2_0x90_ABL_RL2_RetractRequest panther_can2_out.asw_out_can2_0x90_ABL_RR1_RetractRequest panther_can3_out.asw_out_can3_0x100_tx_status panther_can3_out.asw_out_can3_0x100_Seat_Buckle_FL panther_can3_out.asw_out_can3_0x100_Debug_Mode panther_can3_out.asw_out_can3_0x100_Ext_Trigger_FL panther_can3_out.asw_out_can3_0x100_Seat_Buckle_FR panther_can3_out.asw_out_can3_0x100_Seat_Buckle_RL panther_can3_out.asw_out_can3_0x100_Seat_Buckle_RR panther_can3_out.asw_out_can3_0x100_OutputMode panther_can3_out.asw_out_can3_0x100_Ext_Trigger_FR panther_can3_out.asw_out_can3_0x100_Ext_Trigger_RL panther_can3_out.asw_out_can3_0x100_TiltMountPos panther_can6_out.asw_out_can6_0xBC_tx_status panther_can6_out.asw_out_can6_0xBC_SPS_FR_SeatDirectionX panther_can6_out.asw_out_can6_0xBC_SPS_FR_SeatDirectionZ panther_can6_out.asw_out_can6_0xBC_SPS_FR_SeatBackRestPosition panther_can6_out.asw_out_can6_0xBC_SPS_FR_FootRestPosition panther_can6_out.asw_out_can6_0xBC_SPS_FR_HeadRestPosition panther_can6_out.asw_out_can6_0xBB_tx_status panther_can6_out.asw_out_can6_0xBB_SPS_FL_SeatDirectionX panther_can6_out.asw_out_can6_0xBB_SPS_FL_SeatDirectionZ panther_can6_out.asw_out_can6_0xBB_SPS_FL_SeatBackRestPosition panther_can6_out.asw_out_can6_0xBB_SPS_FL_FootRestPosition panther_can6_out.asw_out_can6_0xBB_SPS_FL_HeadRestPosition panther_can6_out.asw_out_can6_0x194_tx_status panther_can6_out.asw_out_can6_0x194_WMS_RR1_WebbingMovement panther_can6_out.asw_out_can6_0x194_WMS_RR1_SpoolAngle panther_can6_out.asw_out_can6_0x194_WMS_RR1_SensorStatus panther_can6_out.asw_out_can6_0x193_tx_status panther_can6_out.asw_out_can6_0x193_WMS_RL2_WebbingMovement panther_can6_out.asw_out_can6_0x193_WMS_RL2_SpoolAngle panther_can6_out.asw_out_can6_0x193_WMS_RL2_SensorStatus panther_can6_out.asw_out_can6_0x192_tx_status panther_can6_out.asw_out_can6_0x192_WMS_RL1_WebbingMovement panther_can6_out.asw_out_can6_0x192_WMS_RL1_SpoolAngle panther_can6_out.asw_out_can6_0x192_WMS_RL1_SensorStatus panther_can6_out.asw_out_can6_0x191_tx_status panther_can6_out.asw_out_can6_0x191_WMS_FR_WebbingMovement panther_can6_out.asw_out_can6_0x191_WMS_FR_SpoolAngle panther_can6_out.asw_out_can6_0x191_WMS_FR_SensorStatus panther_can6_out.asw_out_can6_0x190_tx_status panther_can6_out.asw_out_can6_0x190_WMS_FL_WebbingMovement panther_can6_out.asw_out_can6_0x190_WMS_FL_SpoolAngle_deg panther_can6_out.asw_out_can6_0x190_WMS_FL_SensorStatus_bool panther_can6_out.asw_out_can6_0x198_tx_status panther_can6_out.asw_out_can6_0x198_ELK_FL_LockingStatus panther_can6_out.asw_out_can6_0x198_ELK_FR_LockingStatus panther_can6_out.asw_out_can6_0x198_ELK_RL1_LockingStatus panther_can6_out.asw_out_can6_0x198_ELK_RL2_LockingStatus panther_can6_out.asw_out_can6_0x198_ELK_RR1_LockingStatus panther_can6_out.asw_out_can6_0x199_tx_status panther_can6_out.asw_out_can6_0x199_BSW_FL_BuckleStatus panther_can6_out.asw_out_can6_0x199_BSW_FR_BuckleStatus panther_can6_out.asw_out_can6_0x199_BSW_RL1_BuckleStatus panther_can6_out.asw_out_can6_0x199_BSW_RL2_BuckleStatus panther_can6_out.asw_out_can6_0x199_BSW_RR1_BuckleStatus panther_can6_out.asw_out_can6_0xB2_tx_status panther_can6_out.asw_out_can6_0xB2_ARS_FL_TimeToFireAirbag panther_can6_out.asw_out_can6_0xB2_ARS_FL_TimeToFireSeatbelt panther_can6_out.asw_out_can6_0xB2_ARS_FR_TimeToFireAirbag panther_can6_out.asw_out_can6_0xB2_ARS_FR_TimeToFireSeatbelt panther_can6_out.asw_out_can6_0xB1_tx_status panther_can6_out.asw_out_can6_0xB1_ARS_FL_InjuryRiskAdaptive panther_can6_out.asw_out_can6_0xB1_ARS_FL_InjuryRiskNonAdaptive panther_can6_out.asw_out_can6_0xB1_ARS_FR_InjuryRiskAdaptive panther_can6_out.asw_out_can6_0xB1_ARS_FR_InjuryRiskNonAdaptive panther_can6_out.asw_out_can6_0xC1_STS_BDS_FL_DataByte1 panther_can6_out.asw_out_can6_0xC1_STS_BDS_FL_DataByte2 panther_can6_out.asw_out_can6_0xC1_STS_BDS_FL_DataByte3 panther_can6_out.asw_out_can6_0xC1_STS_BDS_FL_DataByte4 panther_can6_out.asw_out_can6_0xC1_STS_BDS_FL_DataByte5 panther_can6_out.asw_out_can6_0xC1_STS_BDS_FL_DataByte6 panther_can6_out.asw_out_can6_0xC1_STS_BDS_FL_DataByte7 panther_can6_out.asw_out_can6_0xC1_STS_BDS_FL_DataByte8 panther_can6_out.asw_out_can6_0xC2_tx_status panther_can6_out.asw_out_can6_0xC2_STS_BDS_FL_DataByte9 panther_can6_out.asw_out_can6_0xC2_STS_BDS_FL_DataByte10 panther_can6_out.asw_out_can6_0xC2_STS_BDS_FL_DataByte11 panther_can6_out.asw_out_can6_0xC2_STS_BDS_FL_DataByte12 panther_can6_out.asw_out_can6_0xC2_STS_BDS_FL_DataByte13 panther_can6_out.asw_out_can6_0xC2_STS_BDS_FL_DataByte14 panther_can6_out.asw_out_can6_0xC2_STS_BDS_FL_DataByte15 panther_can6_out.asw_out_can6_0xC2_STS_BDS_FL_DataByte16 panther_can6_out.asw_out_can6_0xC3_tx_status panther_can6_out.asw_out_can6_0xC3_STS_BDS_FR_DataByte1 panther_can6_out.asw_out_can6_0xC3_STS_BDS_FR_DataByte2 panther_can6_out.asw_out_can6_0xC3_STS_BDS_FR_DataByte3 panther_can6_out.asw_out_can6_0xC3_STS_BDS_FR_DataByte4 panther_can6_out.asw_out_can6_0xC3_STS_BDS_FR_DataByte5 panther_can6_out.asw_out_can6_0xC3_STS_BDS_FR_DataByte6 panther_can6_out.asw_out_can6_0xC3_STS_BDS_FR_DataByte7 panther_can6_out.asw_out_can6_0xC3_STS_BDS_FR_DataByte8 panther_can6_out.asw_out_can6_0xC4_tx_status panther_can6_out.asw_out_can6_0xC4_STS_BDS_FR_DataByte9 panther_can6_out.asw_out_can6_0xC4_STS_BDS_FR_DataByte10 panther_can6_out.asw_out_can6_0xC4_STS_BDS_FR_DataByte11 panther_can6_out.asw_out_can6_0xC4_STS_BDS_FR_DataByte12 panther_can6_out.asw_out_can6_0xC4_STS_BDS_FR_DataByte13 panther_can6_out.asw_out_can6_0xC4_STS_BDS_FR_DataByte14 panther_can6_out.asw_out_can6_0xC4_STS_BDS_FR_DataByte15 panther_can6_out.asw_out_can6_0xC4_STS_BDS_FR_DataByte16 panther_can6_out.asw_out_can6_0x198_ELK_RL1_ActuatorStatus panther_can6_out.asw_out_can6_0x198_ELK_RL2_ActuatorStatus panther_can6_out.asw_out_can6_0x198_ELK_RR1_ActuatorStatus panther_can6_out.asw_out_can6_0x200_tx_status panther_can6_out.asw_out_can6_0x200_COM_Status_PumaFRCan panther_can6_out.asw_out_can6_0x200_COM_Status_PumaRL1Can panther_can6_out.asw_out_can6_0x200_COM_Status_PumaRL2Can panther_can6_out.asw_out_can6_0x200_COM_Status_PumaRR1Can panther_can6_out.asw_out_can6_0x19C_tx_status panther_can6_out.asw_out_can6_0x19C_HB_State_FL panther_can6_out.asw_out_can6_0x19C_HB_State_FR panther_can6_out.asw_out_can6_0x19C_HB_State_RL1 panther_can6_out.asw_out_can6_0x19C_HB_State_RL2 panther_can6_out.asw_out_can6_0x19C_HB_State_RR1 panther_can1_in.asw_in_can1_0x40_VCLASS_Acceleration_Y_ms2 panther_can1_in.asw_in_can1_0x40_VCLASS_Acceleration_X_ms2 panther_can1_in.asw_in_can1_0x40_VCLASS_YawRate_degs panther_can1_in.asw_in_can1_0x40_VCLASS_VehicleSpeed_kmh panther_can1_in.asw_in_can1_0x40_VCLASS_LaneDepBrkReqStatus panther_can1_in.asw_in_can1_0x30_VCLASS_AccelPdlPos_perc panther_can1_in.asw_in_can1_0x30_VCLASS_BrakeTrqDriver_Nm panther_can1_in.asw_in_can1_0x30_VCLASS_ESPStatus panther_can1_in.asw_in_can1_0x30_VCLASS_WheelAngle_deg panther_can1_in.asw_in_can1_0x30_VCLASS_DriveMode panther_can1_in.asw_in_can1_0x30_VCLASS_IgnitionStatus panther_can1_in.asw_in_can1_0x30_VCLASS_FL_BuckleStatus panther_can1_in.asw_in_can1_0x30_VCLASS_FR_BuckleStatus panther_can1_in.asw_in_can1_0x30_VCLASS_R1_BuckleStatus panther_can1_in.asw_in_can1_0x30_VCLASS_R2_BuckleStatus panther_can1_in.asw_in_can1_0x30_VCLASS_RR1_BuckleStatus panther_can1_in.asw_in_can1_0x30_VCLASS_TransmissionSelector panther_can1_in.asw_in_can1_0x30_VCLASS_DriverTakesCtrlRq panther_can1_in.asw_in_can1_0x20_VCLASS_FL_DoorStatus panther_can1_in.asw_in_can1_0x20_VCLASS_FR_DoorStatus panther_can1_in.asw_in_can1_0x20_VCLASS_RL_DoorStatus panther_can1_in.asw_in_can1_0x20_VCLASS_RR_DoorStatus panther_can1_in.asw_in_can1_0x20_VCLASS_FL_DoorHndlStatus panther_can1_in.asw_in_can1_0x20_VCLASS_FR_DoorHndlStatus panther_can1_in.asw_in_can1_0x20_VCLASS_RL_DoorHndlStatus panther_can1_in.asw_in_can1_0x20_VCLASS_RR_DoorHndlStatus panther_can1_in.asw_in_can1_0x20_VCLASS_Lt_TurnIndicator_on panther_can1_in.asw_in_can1_0x20_VCLASS_Rt_TurnIndicator_on panther_can1_in.asw_in_can1_0x20_VCLASS_EmergencyFlasher_on panther_can1_in.asw_in_can1_0x20_VCLASS_CountryCode panther_can1_in.asw_in_can1_0x20_VCLASS_Lt_BlindSpWarn_on panther_can1_in.asw_in_can1_0x20_VCLASS_Rt_BlindSpWarn_on panther_can1_in.asw_in_can1_0x20_VCLASS_CentrLockSys_Status panther_can2_in.asw_in_can2_0x194_WMS_RR1_WebbingMovement panther_can2_in.asw_in_can2_0x194_WMS_RR1_SpoolAngle panther_can2_in.asw_in_can2_0x194_WMS_RR1_SensorStatus panther_can2_in.asw_in_can2_0x193_WMS_RL2_WebbingMovement panther_can2_in.asw_in_can2_0x193_WMS_RL2_SpoolAngle panther_can2_in.asw_in_can2_0x193_WMS_RL2_SensorStatus panther_can2_in.asw_in_can2_0x192_WMS_RL1_WebbingMovement panther_can2_in.asw_in_can2_0x192_WMS_RL1_SpoolAngle panther_can2_in.asw_in_can2_0x192_WMS_RL1_SensorStatus panther_can2_in.asw_in_can2_0x191_WMS_FR_WebbingMovement panther_can2_in.asw_in_can2_0x191_WMS_FR_SpoolAngle panther_can2_in.asw_in_can2_0x191_WMS_FR_SensorStatus panther_can2_in.asw_in_can2_0x190_WMS_FL_WebbingMovement panther_can2_in.asw_in_can2_0x190_WMS_FL_SpoolAngle_deg panther_can2_in.asw_in_can2_0x190_WMS_FL_SensorStatus_bool panther_can2_in.asw_in_can2_0x18C_ACR_RR1_ActivationLevelStatus panther_can2_in.asw_in_can2_0x18C_ACR_RR1_ActivationPhase panther_can2_in.asw_in_can2_0x18B_ACR_RL2_ActivationLevelStatus panther_can2_in.asw_in_can2_0x18B_ACR_RL2_ActivationPhase panther_can2_in.asw_in_can2_0x18A_ACR_RL1_ActivationLevelStatus panther_can2_in.asw_in_can2_0x18A_ACR_RL1_ActivationPhase panther_can2_in.asw_in_can2_0x189_ACR_FR_ActivationLevelStatus panther_can2_in.asw_in_can2_0x189_ACR_FR_ActivationPhase panther_can2_in.asw_in_can2_0x188_ACR_FL_ActivationLevelStatus panther_can2_in.asw_in_can2_0x188_ACR_FL_ActivationPhase panther_can2_in.asw_in_can2_0x199_BSW_FL_BuckleStatus panther_can2_in.asw_in_can2_0x199_BSW_FR_BuckleStatus panther_can2_in.asw_in_can2_0x199_BSW_RL1_BuckleStatus panther_can2_in.asw_in_can2_0x199_BSW_RL2_BuckleStatus panther_can2_in.asw_in_can2_0x199_BSW_RR1_BuckleStatus panther_can2_in.asw_in_can2_0xC1_STS_BDS_FL_DataByte1 panther_can2_in.asw_in_can2_0xC1_STS_BDS_FL_DataByte2 panther_can2_in.asw_in_can2_0xC1_STS_BDS_FL_DataByte3 panther_can2_in.asw_in_can2_0xC1_STS_BDS_FL_DataByte4 panther_can2_in.asw_in_can2_0xC1_STS_BDS_FL_DataByte5 panther_can2_in.asw_in_can2_0xC1_STS_BDS_FL_DataByte6 panther_can2_in.asw_in_can2_0xC1_STS_BDS_FL_DataByte7 panther_can2_in.asw_in_can2_0xC1_STS_BDS_FL_DataByte8 panther_can2_in.asw_in_can2_0xC2_STS_BDS_FL_DataByte9 panther_can2_in.asw_in_can2_0xC2_STS_BDS_FL_DataByte10 panther_can2_in.asw_in_can2_0xC2_STS_BDS_FL_DataByte11 panther_can2_in.asw_in_can2_0xC2_STS_BDS_FL_DataByte12 panther_can2_in.asw_in_can2_0xC2_STS_BDS_FL_DataByte13 panther_can2_in.asw_in_can2_0xC2_STS_BDS_FL_DataByte14 panther_can2_in.asw_in_can2_0xC2_STS_BDS_FL_DataByte15 panther_can2_in.asw_in_can2_0xC2_STS_BDS_FL_DataByte16 panther_can2_in.asw_in_can2_0xC3_STS_BDS_FR_DataByte1 panther_can2_in.asw_in_can2_0xC3_STS_BDS_FR_DataByte2 panther_can2_in.asw_in_can2_0xC3_STS_BDS_FR_DataByte3 panther_can2_in.asw_in_can2_0xC3_STS_BDS_FR_DataByte4 panther_can2_in.asw_in_can2_0xC3_STS_BDS_FR_DataByte5 panther_can2_in.asw_in_can2_0xC3_STS_BDS_FR_DataByte6 panther_can2_in.asw_in_can2_0xC3_STS_BDS_FR_DataByte7 panther_can2_in.asw_in_can2_0xC3_STS_BDS_FR_DataByte8 panther_can2_in.asw_in_can2_0xC4_STS_BDS_FR_DataByte9 panther_can2_in.asw_in_can2_0xC4_STS_BDS_FR_DataByte10 panther_can2_in.asw_in_can2_0xC4_STS_BDS_FR_DataByte11 panther_can2_in.asw_in_can2_0xC4_STS_BDS_FR_DataByte12 panther_can2_in.asw_in_can2_0xC4_STS_BDS_FR_DataByte13 panther_can2_in.asw_in_can2_0xC4_STS_BDS_FR_DataByte14 panther_can2_in.asw_in_can2_0xC4_STS_BDS_FR_DataByte15 panther_can2_in.asw_in_can2_0xC4_STS_BDS_FR_DataByte16 panther_can3_in.asw_in_can3_0x150_Lock_Status_FL panther_can3_in.asw_in_can3_0x150_Algo_Status_FL panther_can3_in.asw_in_can3_0x150_Lock_Status_FR panther_can3_in.asw_in_can3_0x150_Lock_Status_RL panther_can3_in.asw_in_can3_0x150_Algo_Status_FR panther_can3_in.asw_in_can3_0x150_Algo_Status_RL panther_can3_in.asw_in_can3_0x160_ECU_Status_Act_1 panther_can3_in.asw_in_can3_0x160_ECU_Status_Act_2 panther_can3_in.asw_in_can3_0x160_ECU_Status_Act_3 panther_can6_in.asw_in_can6_0xA4_rx_status panther_can6_in.asw_in_can6_0xA4_ISB_RR1_ColorGreen panther_can6_in.asw_in_can6_0xA4_ISB_RR1_ColorBlue panther_can6_in.asw_in_can6_0xA4_ISB_RR1_ColorRed panther_can6_in.asw_in_can6_0xA4_ISB_RR1_Intensity panther_can6_in.asw_in_can6_0xA4_ISB_RR1_Normalization panther_can6_in.asw_in_can6_0xA4_ISB_RR1_Transitionspeed panther_can6_in.asw_in_can6_0xA4_ISB_RR1_GroupOrModule panther_can6_in.asw_in_can6_0xA4_ISB_RR1_AddressByte0 panther_can6_in.asw_in_can6_0xA4_ISB_RR1_AddressByte1 panther_can6_in.asw_in_can6_0xA3_rx_status panther_can6_in.asw_in_can6_0xA3_ISB_RL2_ColorGreen panther_can6_in.asw_in_can6_0xA3_ISB_RL2_ColorBlue panther_can6_in.asw_in_can6_0xA3_ISB_RL2_ColorRed panther_can6_in.asw_in_can6_0xA3_ISB_RL2_Intensity panther_can6_in.asw_in_can6_0xA3_ISB_RL2_Normalization panther_can6_in.asw_in_can6_0xA3_ISB_RL2_Transitionspeed panther_can6_in.asw_in_can6_0xA3_ISB_RL2_GroupOrModule panther_can6_in.asw_in_can6_0xA3_ISB_RL2_AddressByte0 panther_can6_in.asw_in_can6_0xA3_ISB_RL2_AddressByte1 panther_can6_in.asw_in_can6_0xA2_rx_status panther_can6_in.asw_in_can6_0xA2_ISB_RL1_ColorGreen panther_can6_in.asw_in_can6_0xA2_ISB_RL1_ColorBlue panther_can6_in.asw_in_can6_0xA2_ISB_RL1_ColorRed panther_can6_in.asw_in_can6_0xA2_ISB_RL1_Intensity /end LOC_MEASUREMENT
 /begin IN_MEASUREMENT panther_can1_in.asw_in_can1_0x40_VCLASS_Acceleration_Y_ms2 panther_can1_in.asw_in_can1_0x40_VCLASS_Acceleration_X_ms2 panther_can1_in.asw_in_can1_0x40_VCLASS_YawRate_degs panther_can1_in.asw_in_can1_0x40_VCLASS_VehicleSpeed_kmh panther_can1_in.asw_in_can1_0x40_VCLASS_LaneDepBrkReqStatus panther_can1_in.asw_in_can1_0x30_VCLASS_AccelPdlPos_perc panther_can1_in.asw_in_can1_0x30_VCLASS_BrakeTrqDriver_Nm panther_can1_in.asw_in_can1_0x30_VCLASS_ESPStatus panther_can1_in.asw_in_can1_0x30_VCLASS_WheelAngle_deg panther_can1_in.asw_in_can1_0x30_VCLASS_DriveMode panther_can1_in.asw_in_can1_0x30_VCLASS_IgnitionStatus panther_can1_in.asw_in_can1_0x30_VCLASS_FL_BuckleStatus panther_can1_in.asw_in_can1_0x30_VCLASS_FR_BuckleStatus panther_can1_in.asw_in_can1_0x30_VCLASS_R1_BuckleStatus panther_can1_in.asw_in_can1_0x30_VCLASS_R2_BuckleStatus panther_can1_in.asw_in_can1_0x30_VCLASS_RR1_BuckleStatus panther_can1_in.asw_in_can1_0x30_VCLASS_TransmissionSelector panther_can1_in.asw_in_can1_0x30_VCLASS_DriverTakesCtrlRq panther_can1_in.asw_in_can1_0x20_VCLASS_FL_DoorStatus panther_can1_in.asw_in_can1_0x20_VCLASS_FR_DoorStatus panther_can1_in.asw_in_can1_0x20_VCLASS_RL_DoorStatus panther_can1_in.asw_in_can1_0x20_VCLASS_RR_DoorStatus panther_can1_in.asw_in_can1_0x20_VCLASS_FL_DoorHndlStatus panther_can1_in.asw_in_can1_0x20_VCLASS_FR_DoorHndlStatus panther_can1_in.asw_in_can1_0x20_VCLASS_RL_DoorHndlStatus panther_can1_in.asw_in_can1_0x20_VCLASS_RR_DoorHndlStatus panther_can1_in.asw_in_can1_0x20_VCLASS_Lt_TurnIndicator_on panther_can1_in.asw_in_can1_0x20_VCLASS_Rt_TurnIndicator_on panther_can1_in.asw_in_can1_0x20_VCLASS_EmergencyFlasher_on panther_can1_in.asw_in_can1_0x20_VCLASS_CountryCode panther_can1_in.asw_in_can1_0x20_VCLASS_Lt_BlindSpWarn_on panther_can1_in.asw_in_can1_0x20_VCLASS_Rt_BlindSpWarn_on panther_can1_in.asw_in_can1_0x20_VCLASS_CentrLockSys_Status panther_can2_in.asw_in_can2_0x194_WMS_RR1_WebbingMovement panther_can2_in.asw_in_can2_0x194_WMS_RR1_SpoolAngle panther_can2_in.asw_in_can2_0x194_WMS_RR1_SensorStatus panther_can2_in.asw_in_can2_0x193_WMS_RL2_WebbingMovement panther_can2_in.asw_in_can2_0x193_WMS_RL2_SpoolAngle panther_can2_in.asw_in_can2_0x193_WMS_RL2_SensorStatus panther_can2_in.asw_in_can2_0x192_WMS_RL1_WebbingMovement panther_can2_in.asw_in_can2_0x192_WMS_RL1_SpoolAngle panther_can2_in.asw_in_can2_0x192_WMS_RL1_SensorStatus panther_can2_in.asw_in_can2_0x191_WMS_FR_WebbingMovement panther_can2_in.asw_in_can2_0x191_WMS_FR_SpoolAngle panther_can2_in.asw_in_can2_0x191_WMS_FR_SensorStatus panther_can2_in.asw_in_can2_0x190_WMS_FL_WebbingMovement panther_can2_in.asw_in_can2_0x190_WMS_FL_SpoolAngle_deg panther_can2_in.asw_in_can2_0x190_WMS_FL_SensorStatus_bool panther_can2_in.asw_in_can2_0x18C_ACR_RR1_ActivationLevelStatus panther_can2_in.asw_in_can2_0x18C_ACR_RR1_ActivationPhase panther_can2_in.asw_in_can2_0x18B_ACR_RL2_ActivationLevelStatus panther_can2_in.asw_in_can2_0x18B_ACR_RL2_ActivationPhase panther_can2_in.asw_in_can2_0x18A_ACR_RL1_ActivationLevelStatus panther_can2_in.asw_in_can2_0x18A_ACR_RL1_ActivationPhase panther_can2_in.asw_in_can2_0x189_ACR_FR_ActivationLevelStatus panther_can2_in.asw_in_can2_0x189_ACR_FR_ActivationPhase panther_can2_in.asw_in_can2_0x188_ACR_FL_ActivationLevelStatus panther_can2_in.asw_in_can2_0x188_ACR_FL_ActivationPhase panther_can2_in.asw_in_can2_0x199_BSW_FL_BuckleStatus panther_can2_in.asw_in_can2_0x199_BSW_FR_BuckleStatus panther_can2_in.asw_in_can2_0x199_BSW_RL1_BuckleStatus panther_can2_in.asw_in_can2_0x199_BSW_RL2_BuckleStatus panther_can2_in.asw_in_can2_0x199_BSW_RR1_BuckleStatus panther_can2_in.asw_in_can2_0xC1_STS_BDS_FL_DataByte1 panther_can2_in.asw_in_can2_0xC1_STS_BDS_FL_DataByte2 panther_can2_in.asw_in_can2_0xC1_STS_BDS_FL_DataByte3 panther_can2_in.asw_in_can2_0xC1_STS_BDS_FL_DataByte4 panther_can2_in.asw_in_can2_0xC1_STS_BDS_FL_DataByte5 panther_can2_in.asw_in_can2_0xC1_STS_BDS_FL_DataByte6 panther_can2_in.asw_in_can2_0xC1_STS_BDS_FL_DataByte7 panther_can2_in.asw_in_can2_0xC1_STS_BDS_FL_DataByte8 panther_can2_in.asw_in_can2_0xC2_STS_BDS_FL_DataByte9 panther_can2_in.asw_in_can2_0xC2_STS_BDS_FL_DataByte10 panther_can2_in.asw_in_can2_0xC2_STS_BDS_FL_DataByte11 panther_can2_in.asw_in_can2_0xC2_STS_BDS_FL_DataByte12 panther_can2_in.asw_in_can2_0xC2_STS_BDS_FL_DataByte13 panther_can2_in.asw_in_can2_0xC2_STS_BDS_FL_DataByte14 panther_can2_in.asw_in_can2_0xC2_STS_BDS_FL_DataByte15 panther_can2_in.asw_in_can2_0xC2_STS_BDS_FL_DataByte16 panther_can2_in.asw_in_can2_0xC3_STS_BDS_FR_DataByte1 panther_can2_in.asw_in_can2_0xC3_STS_BDS_FR_DataByte2 panther_can2_in.asw_in_can2_0xC3_STS_BDS_FR_DataByte3 panther_can2_in.asw_in_can2_0xC3_STS_BDS_FR_DataByte4 panther_can2_in.asw_in_can2_0xC3_STS_BDS_FR_DataByte5 panther_can2_in.asw_in_can2_0xC3_STS_BDS_FR_DataByte6 panther_can2_in.asw_in_can2_0xC3_STS_BDS_FR_DataByte7 panther_can2_in.asw_in_can2_0xC3_STS_BDS_FR_DataByte8 panther_can2_in.asw_in_can2_0xC4_STS_BDS_FR_DataByte9 panther_can2_in.asw_in_can2_0xC4_STS_BDS_FR_DataByte10 panther_can2_in.asw_in_can2_0xC4_STS_BDS_FR_DataByte11 panther_can2_in.asw_in_can2_0xC4_STS_BDS_FR_DataByte12 panther_can2_in.asw_in_can2_0xC4_STS_BDS_FR_DataByte13 panther_can2_in.asw_in_can2_0xC4_STS_BDS_FR_DataByte14 panther_can2_in.asw_in_can2_0xC4_STS_BDS_FR_DataByte15 panther_can2_in.asw_in_can2_0xC4_STS_BDS_FR_DataByte16 panther_can3_in.asw_in_can3_0x150_Lock_Status_FL panther_can3_in.asw_in_can3_0x150_Algo_Status_FL panther_can3_in.asw_in_can3_0x150_Lock_Status_FR panther_can3_in.asw_in_can3_0x150_Lock_Status_RL panther_can3_in.asw_in_can3_0x150_Algo_Status_FR panther_can3_in.asw_in_can3_0x150_Algo_Status_RL panther_can3_in.asw_in_can3_0x160_ECU_Status_Act_1 panther_can3_in.asw_in_can3_0x160_ECU_Status_Act_2 panther_can3_in.asw_in_can3_0x160_ECU_Status_Act_3 panther_can6_in.asw_in_can6_0xA4_rx_status panther_can6_in.asw_in_can6_0xA4_ISB_RR1_ColorGreen panther_can6_in.asw_in_can6_0xA4_ISB_RR1_ColorBlue panther_can6_in.asw_in_can6_0xA4_ISB_RR1_ColorRed panther_can6_in.asw_in_can6_0xA4_ISB_RR1_Intensity panther_can6_in.asw_in_can6_0xA4_ISB_RR1_Normalization panther_can6_in.asw_in_can6_0xA4_ISB_RR1_Transitionspeed panther_can6_in.asw_in_can6_0xA4_ISB_RR1_GroupOrModule panther_can6_in.asw_in_can6_0xA4_ISB_RR1_AddressByte0 panther_can6_in.asw_in_can6_0xA4_ISB_RR1_AddressByte1 panther_can6_in.asw_in_can6_0xA3_rx_status panther_can6_in.asw_in_can6_0xA3_ISB_RL2_ColorGreen panther_can6_in.asw_in_can6_0xA3_ISB_RL2_ColorBlue panther_can6_in.asw_in_can6_0xA3_ISB_RL2_ColorRed panther_can6_in.asw_in_can6_0xA3_ISB_RL2_Intensity panther_can6_in.asw_in_can6_0xA3_ISB_RL2_Normalization panther_can6_in.asw_in_can6_0xA3_ISB_RL2_Transitionspeed panther_can6_in.asw_in_can6_0xA3_ISB_RL2_GroupOrModule panther_can6_in.asw_in_can6_0xA3_ISB_RL2_AddressByte0 panther_can6_in.asw_in_can6_0xA3_ISB_RL2_AddressByte1 panther_can6_in.asw_in_can6_0xA2_rx_status panther_can6_in.asw_in_can6_0xA2_ISB_RL1_ColorGreen panther_can6_in.asw_in_can6_0xA2_ISB_RL1_ColorBlue panther_can6_in.asw_in_can6_0xA2_ISB_RL1_ColorRed panther_can6_in.asw_in_can6_0xA2_ISB_RL1_Intensity panther_can6_in.asw_in_can6_0xA2_ISB_RL1_Normalization panther_can6_in.asw_in_can6_0xA2_ISB_RL1_Transitionspeed panther_can6_in.asw_in_can6_0xA2_ISB_RL1_GroupOrModule panther_can6_in.asw_in_can6_0xA2_ISB_RL1_AddressByte0 panther_can6_in.asw_in_can6_0xA2_ISB_RL1_AddressByte1 panther_can6_in.asw_in_can6_0xA1_rx_status panther_can6_in.asw_in_can6_0xA1_ISB_FR_ColorGreen panther_can6_in.asw_in_can6_0xA1_ISB_FR_ColorBlue panther_can6_in.asw_in_can6_0xA1_ISB_FR_ColorRed panther_can6_in.asw_in_can6_0xA1_ISB_FR_Intensity_perc panther_can6_in.asw_in_can6_0xA1_ISB_FR_Normalization panther_can6_in.asw_in_can6_0xA1_ISB_FR_Transitionspeed panther_can6_in.asw_in_can6_0xA1_ISB_FR_GroupOrModule panther_can6_in.asw_in_can6_0xA1_ISB_FR_AddressByte0 panther_can6_in.asw_in_can6_0xA1_ISB_FR_AddressByte1 panther_can6_in.asw_in_can6_0xA0_rx_status panther_can6_in.asw_in_can6_0xA0_ISB_FL_ColorGreen_byte panther_can6_in.asw_in_can6_0xA0_ISB_FL_ColorBlue_byte panther_can6_in.asw_in_can6_0xA0_ISB_FL_ColorRed_byte panther_can6_in.asw_in_can6_0xA0_ISB_FL_Intensity_perc panther_can6_in.asw_in_can6_0xA0_ISB_FL_Normalization_bool panther_can6_in.asw_in_can6_0xA0_ISB_FL_Transitionspeed_nibble panther_can6_in.asw_in_can6_0xA0_ISB_FL_GroupOrModule_bool panther_can6_in.asw_in_can6_0xA0_ISB_FL_AddressByte0_byte panther_can6_in.asw_in_can6_0xA0_ISB_FL_AddressByte1_byte panther_can6_in.asw_in_can6_0x92_rx_status panther_can6_in.asw_in_can6_0x92_ELK_FL_LockingRequest panther_can6_in.asw_in_can6_0x92_ELK_FR_LockingRequest panther_can6_in.asw_in_can6_0x92_ELK_RL1_LockingRequest panther_can6_in.asw_in_can6_0x92_ELK_RL2_LockingRequest panther_can6_in.asw_in_can6_0x92_ELK_RR1_LockingRequest panther_can6_in.asw_in_can6_0x91_rx_status panther_can6_in.asw_in_can6_0x91_ACR_FL_RetractRequest panther_can6_in.asw_in_can6_0x91_ACR_FR_RetractRequest panther_can6_in.asw_in_can6_0x91_ACR_RL1_RetractRequest panther_can6_in.asw_in_can6_0x91_ACR_RL2_RetractRequest panther_can6_in.asw_in_can6_0x91_ACR_RR1_RetractRequest panther_can6_in.asw_in_can6_0x90_rx_status panther_can6_in.asw_in_can6_0x90_ABL_FL_RetractRequest panther_can6_in.asw_in_can6_0x90_ABL_FR_RetractRequest panther_can6_in.asw_in_can6_0x90_ABL_RL1_RetractRequest panther_can6_in.asw_in_can6_0x90_ABL_RL2_RetractRequest panther_can6_in.asw_in_can6_0x90_ABL_RR1_RetractRequest panther_can6_in.asw_in_can6_0xB4_rx_status panther_can6_in.asw_in_can6_0xB4_OMS_FR_OccupantClassification panther_can6_in.asw_in_can6_0xB4_OMS_FR_OutOfPosition panther_can6_in.asw_in_can6_0xB4_OMS_FR_OccupantWeightMean_kg panther_can6_in.asw_in_can6_0xB4_OMS_FR_OccupantWeightStd_kg panther_can6_in.asw_in_can6_0xB4_OMS_FR_OccupantHeightMean_cm panther_can6_in.asw_in_can6_0xB4_OMS_FR_OccupantHeightStd_cm panther_can6_in.asw_in_can6_0xB4_OMS_FR_OccupantPresence_bool panther_can6_in.asw_in_can6_0xB3_rx_status panther_can6_in.asw_in_can6_0xB3_OMS_FL_HandsOnWheel panther_can6_in.asw_in_can6_0xB3_OMS_FL_OccupantClassification panther_can6_in.asw_in_can6_0xB3_OMS_FL_OutOfPosition panther_can6_in.asw_in_can6_0xB3_OMS_FL_OccupantWeightMean_kg panther_can6_in.asw_in_can6_0xB3_OMS_FL_OccupantWeightStd_kg panther_can6_in.asw_in_can6_0xB3_OMS_FL_OccupantHeightMean_cm panther_can6_in.asw_in_can6_0xB3_OMS_FL_OccupantHeightStd_cm panther_can6_in.asw_in_can6_0xB3_OMS_FL_OccupantPresence_bool panther_can6_in.asw_in_can6_0xB6_rx_status panther_can6_in.asw_in_can6_0xB6_OMS_RL2_OccupantClassification panther_can6_in.asw_in_can6_0xB6_OMS_RL2_OccupantHeightMean_cm panther_can6_in.asw_in_can6_0xB6_OMS_RL2_OccupantHeightStd_cm panther_can6_in.asw_in_can6_0xB6_OMS_RL2_OccupantPresence_bool panther_can6_in.asw_in_can6_0xB6_OMS_RL2_OccupantWeightMean_kg panther_can6_in.asw_in_can6_0xB6_OMS_RL2_OccupantWeightStd_kg panther_can6_in.asw_in_can6_0xB6_OMS_RL2_OutOfPosition panther_can6_in.asw_in_can6_0xB7_rx_status panther_can6_in.asw_in_can6_0xB7_OMS_RR1_OccupantClassification panther_can6_in.asw_in_can6_0xB7_OMS_RR1_OccupantHeightMean_cm panther_can6_in.asw_in_can6_0xB7_OMS_RR1_OccupantHeightStd_cm panther_can6_in.asw_in_can6_0xB7_OMS_RR1_OccupantPresence_bool panther_can6_in.asw_in_can6_0xB7_OMS_RR1_OccupantWeightMean_kg panther_can6_in.asw_in_can6_0xB7_OMS_RR1_OccupantWeightStd_kg panther_can6_in.asw_in_can6_0xB7_OMS_RR1_OutOfPosition panther_can6_in.asw_in_can6_0xB5_rx_status panther_can6_in.asw_in_can6_0xB5_OMS_RL1_OccupantClassification panther_can6_in.asw_in_can6_0xB5_OMS_RL1_OutOfPosition panther_can6_in.asw_in_can6_0xB5_OMS_RL1_OccupantHeightMean_cm panther_can6_in.asw_in_can6_0xB5_OMS_RL1_OccupantHeightStd_cm panther_can6_in.asw_in_can6_0xB5_OMS_RL1_OccupantPresence_bool panther_can6_in.asw_in_can6_0xB5_OMS_RL1_OccupantWeightMean_kg panther_can6_in.asw_in_can6_0xB5_OMS_RL1_OccupantWeightStd_kg panther_can6_in.asw_in_can6_0x92_ELK_ResetErrorFlags panther_can6_in.asw_in_can6_0x81_HMI_SEAL_ActivationRequest /end IN_MEASUREMENT
 /begin SUB_FUNCTION Sa4_MGR_Manager_PANTHER Sa59_If_Action_Subsystem Sa60_If_Action_Subsystem1 Sa61_If_Action_Subsystem Sa62_If_Action_Subsystem1 Sa63_If_Action_Subsystem Sa64_If_Action_Subsystem1 Sa65_If_Action_Subsystem Sa66_If_Action_Subsystem1 Sa67_If_Action_Subsystem Sa68_If_Action_Subsystem1 Sa69_If_Action_Subsystem Sa70_If_Action_Subsystem1 Sa71_If_Action_Subsystem Sa72_If_Action_Subsystem1 Sa73_If_Action_Subsystem Sa74_If_Action_Subsystem1 Sa75_If_Action_Subsystem Sa76_If_Action_Subsystem1 Sa93_If_Action_Subsystem Sa94_If_Action_Subsystem1 Sa95_If_Action_Subsystem Sa96_If_Action_Subsystem1 Sa97_If_Action_Subsystem Sa98_If_Action_Subsystem1 Sa99_If_Action_Subsystem Sa100_If_Action_Subsystem1 Sa101_If_Action_Subsystem Sa102_If_Action_Subsystem1 Sa103_If_Action_Subsystem Sa104_If_Action_Subsystem1 Sa111_If_Action_Subsystem Sa112_If_Action_Subsystem1 Sa113_If_Action_Subsystem Sa114_If_Action_Subsystem1 Sa115_If_Action_Subsystem Sa116_If_Action_Subsystem1 Sa117_If_Action_Subsystem Sa118_If_Action_Subsystem1 Sa119_If_Action_Subsystem Sa120_If_Action_Subsystem1 Sa121_If_Action_Subsystem Sa122_If_Action_Subsystem1 Sa130_If_Action_Subsystem Sa131_If_Action_Subsystem1 Sa132_If_Action_Subsystem Sa133_If_Action_Subsystem1 Sa134_If_Action_Subsystem Sa135_If_Action_Subsystem1 Sa136_If_Action_Subsystem Sa137_If_Action_Subsystem1 Sa138_If_Action_Subsystem Sa139_If_Action_Subsystem1 Sa140_If_Action_Subsystem Sa141_If_Action_Subsystem1 Sa142_If_Action_Subsystem Sa143_If_Action_Subsystem1 Sa154_If_Action_Subsystem Sa155_If_Action_Subsystem1 Sa156_If_Action_Subsystem Sa157_If_Action_Subsystem1 Sa158_If_Action_Subsystem Sa159_If_Action_Subsystem1 Sa160_If_Action_Subsystem Sa161_If_Action_Subsystem1 Sa162_If_Action_Subsystem Sa163_If_Action_Subsystem1 Sa164_If_Action_Subsystem Sa165_If_Action_Subsystem1 Sa166_If_Action_Subsystem Sa167_If_Action_Subsystem1 Sa168_If_Action_Subsystem Sa169_If_Action_Subsystem1 Sa170_If_Action_Subsystem Sa171_If_Action_Subsystem1 Sa172_If_Action_Subsystem Sa173_If_Action_Subsystem1 Sa184_If_Action_Subsystem Sa185_If_Action_Subsystem1 Sa186_If_Action_Subsystem Sa187_If_Action_Subsystem1 Sa188_If_Action_Subsystem Sa189_If_Action_Subsystem1 Sa190_If_Action_Subsystem Sa191_If_Action_Subsystem1 Sa192_If_Action_Subsystem Sa193_If_Action_Subsystem1 Sa194_If_Action_Subsystem Sa195_If_Action_Subsystem1 Sa196_If_Action_Subsystem Sa197_If_Action_Subsystem1 Sa198_If_Action_Subsystem Sa199_If_Action_Subsystem1 Sa200_If_Action_Subsystem Sa201_If_Action_Subsystem1 Sa202_If_Action_Subsystem Sa203_If_Action_Subsystem1 Sa214_If_Action_Subsystem Sa215_If_Action_Subsystem1 Sa216_If_Action_Subsystem Sa217_If_Action_Subsystem1 Sa218_If_Action_Subsystem Sa219_If_Action_Subsystem1 Sa220_If_Action_Subsystem Sa221_If_Action_Subsystem1 Sa222_If_Action_Subsystem Sa223_If_Action_Subsystem1 Sa224_If_Action_Subsystem Sa225_If_Action_Subsystem1 Sa226_If_Action_Subsystem Sa227_If_Action_Subsystem1 Sa228_If_Action_Subsystem Sa229_If_Action_Subsystem1 Sa230_If_Action_Subsystem Sa231_If_Action_Subsystem1 Sa232_If_Action_Subsystem Sa233_If_Action_Subsystem1 Sa244_If_Action_Subsystem Sa245_If_Action_Subsystem1 Sa246_If_Action_Subsystem Sa247_If_Action_Subsystem1 Sa248_If_Action_Subsystem Sa249_If_Action_Subsystem1 Sa250_If_Action_Subsystem Sa251_If_Action_Subsystem1 Sa252_If_Action_Subsystem Sa253_If_Action_Subsystem1 Sa254_If_Action_Subsystem Sa255_If_Action_Subsystem1 Sa256_If_Action_Subsystem Sa257_If_Action_Subsystem1 Sa258_If_Action_Subsystem Sa259_If_Action_Subsystem1 Sa260_If_Action_Subsystem Sa261_If_Action_Subsystem1 Sa262_If_Action_Subsystem Sa263_If_Action_Subsystem1 Sa274_If_Action_Subsystem Sa275_If_Action_Subsystem1 Sa276_If_Action_Subsystem Sa277_If_Action_Subsystem1 Sa278_If_Action_Subsystem Sa279_If_Action_Subsystem1 Sa280_If_Action_Subsystem Sa281_If_Action_Subsystem1 Sa282_If_Action_Subsystem Sa283_If_Action_Subsystem1 Sa284_If_Action_Subsystem Sa285_If_Action_Subsystem1 Sa286_If_Action_Subsystem Sa287_If_Action_Subsystem1 Sa288_If_Action_Subsystem Sa289_If_Action_Subsystem1 Sa290_If_Action_Subsystem Sa291_If_Action_Subsystem1 Sa292_If_Action_Subsystem Sa293_If_Action_Subsystem1 Sa295_If_Action_Subsystem Sa296_If_Action_Subsystem1 Sa338_If_Action_Subsystem Sa339_If_Action_Subsystem1 Sa340_If_Action_Subsystem Sa341_If_Action_Subsystem1 Sa342_If_Action_Subsystem Sa343_If_Action_Subsystem1 Sa344_If_Action_Subsystem Sa345_If_Action_Subsystem1 Sa346_If_Action_Subsystem Sa347_If_Action_Subsystem1 Sa348_If_Action_Subsystem Sa349_If_Action_Subsystem1 Sa350_If_Action_Subsystem Sa351_If_Action_Subsystem1 Sa352_If_Action_Subsystem Sa353_If_Action_Subsystem1 Sa354_If_Action_Subsystem Sa355_If_Action_Subsystem1 Sa356_If_Action_Subsystem Sa357_If_Action_Subsystem1 Sa358_If_Action_Subsystem Sa359_If_Action_Subsystem1 Sa360_If_Action_Subsystem Sa361_If_Action_Subsystem1 Sa362_If_Action_Subsystem Sa363_If_Action_Subsystem1 Sa364_If_Action_Subsystem Sa365_If_Action_Subsystem1 Sa366_If_Action_Subsystem Sa367_If_Action_Subsystem1 Sa368_If_Action_Subsystem Sa369_If_Action_Subsystem1 Sa370_If_Action_Subsystem Sa371_If_Action_Subsystem1 Sa372_If_Action_Subsystem Sa373_If_Action_Subsystem1 Sa374_If_Action_Subsystem Sa375_If_Action_Subsystem1 Sa376_If_Action_Subsystem Sa377_If_Action_Subsystem1 Sa378_If_Action_Subsystem Sa379_If_Action_Subsystem1 Sa380_If_Action_Subsystem Sa381_If_Action_Subsystem1 Sa382_If_Action_Subsystem Sa383_If_Action_Subsystem1 Sa384_If_Action_Subsystem Sa385_If_Action_Subsystem1 Sa386_If_Action_Subsystem Sa387_If_Action_Subsystem1 Sa388_If_Action_Subsystem Sa389_If_Action_Subsystem1 Sa390_If_Action_Subsystem Sa391_If_Action_Subsystem1 Sa392_If_Action_Subsystem Sa393_If_Action_Subsystem1 Sa394_If_Action_Subsystem Sa395_If_Action_Subsystem1 Sa396_If_Action_Subsystem Sa397_If_Action_Subsystem1 Sa398_If_Action_Subsystem Sa399_If_Action_Subsystem1 Sa400_If_Action_Subsystem Sa401_If_Action_Subsystem1 Sa402_If_Action_Subsystem Sa403_If_Action_Subsystem1 Sa404_If_Action_Subsystem Sa405_If_Action_Subsystem1 Sa406_If_Action_Subsystem Sa407_If_Action_Subsystem1 Sa408_If_Action_Subsystem Sa409_If_Action_Subsystem1 Sa410_If_Action_Subsystem Sa411_If_Action_Subsystem1 Sa412_If_Action_Subsystem Sa413_If_Action_Subsystem1 Sa414_If_Action_Subsystem Sa415_If_Action_Subsystem1 Sa416_If_Action_Subsystem Sa417_If_Action_Subsystem1 Sa418_If_Action_Subsystem Sa419_If_Action_Subsystem1 Sa503_If_Action_Subsystem Sa504_If_Action_Subsystem1 Sa505_If_Action_Subsystem Sa506_If_Action_Subsystem1 Sa507_If_Action_Subsystem Sa508_If_Action_Subsystem1 Sa509_If_Action_Subsystem Sa510_If_Action_Subsystem1 Sa511_If_Action_Subsystem Sa512_If_Action_Subsystem1 Sa513_If_Action_Subsystem Sa514_If_Action_Subsystem1 Sa515_If_Action_Subsystem Sa516_If_Action_Subsystem1 Sa517_If_Action_Subsystem Sa518_If_Action_Subsystem1 Sa519_If_Action_Subsystem Sa520_If_Action_Subsystem1 /end SUB_FUNCTION
/end FUNCTION
/begin RECORD_LAYOUT UBYTE_COL_DIRECT FNC_VALUES 1 UBYTE COLUMN_DIR DIRECT /end RECORD_LAYOUT
/end MODULE
/end PROJECT
