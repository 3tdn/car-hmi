ASAP2_VERSION 1 61
/begin PROJECT AL_Mainfunction_PANTHER ""
/begin HEADER "ASAP2 File for PANTHER" /* Comment */ VERSION "2026-08-21 20:40:07" PROJECT_NO PRJ1 /end HEADER
/begin MODULE PANTHER "Prototyping unit for modelbased application"
/begin MOD_COMMON "" ALIGNMENT_BYTE 1 ALIGNMENT_WORD 2 ALIGNMENT_LONG 4 ALIGNMENT_FLOAT32_IEEE 4 ALIGNMENT_FLOAT64_IEEE 8 BYTE_ORDER MSB_LAST DEPOSIT ABSOLUTE /end MOD_COMMON
/begin CHARACTERISTIC BackfromOfferPosition_s "" VALUE 0x240004a8 UWORD_COL_DIRECT 0 NO_COMPU_METHOD 0 65535 /end CHARACTERISTIC
/begin CHARACTERISTIC BackTo_WakeUp_s "" VALUE 0x240004d2 UWORD_COL_DIRECT 0 NO_COMPU_METHOD 0 65535 /end CHARACTERISTIC
/begin CHARACTERISTIC DEBUGIN_ALO_COM_Status_PumaFLCan "" VALUE 0x24000162 SWORD_COL_DIRECT 0 NO_COMPU_METHOD -32768 32767 /end CHARACTERISTIC
/begin CHARACTERISTIC DEBUGIN_ALO_COM_Status_PumaFRCan "" VALUE 0x2400015c SWORD_COL_DIRECT 0 NO_COMPU_METHOD -32768 32767 /end CHARACTERISTIC
/begin CHARACTERISTIC DEBUGIN_ALO_COM_Status_PumaRL1Can "" VALUE 0x24000156 SWORD_COL_DIRECT 0 NO_COMPU_METHOD -32768 32767 /end CHARACTERISTIC
/begin CHARACTERISTIC DEBUGIN_ALO_COM_Status_PumaRL2Can "" VALUE 0x24000150 SWORD_COL_DIRECT 0 NO_COMPU_METHOD -32768 32767 /end CHARACTERISTIC
/begin CHARACTERISTIC DEBUGIN_ALO_COM_Status_PumaRR1Can "" VALUE 0x2400014a SWORD_COL_DIRECT 0 NO_COMPU_METHOD -32768 32767 /end CHARACTERISTIC
/begin CHARACTERISTIC DEBUGIN_ALO_HB_State_FR "" VALUE 0x24000144 SWORD_COL_DIRECT 0 NO_COMPU_METHOD -32768 32767 /end CHARACTERISTIC
/begin CHARACTERISTIC DEBUGIN_ALO_HB_State_RL1 "" VALUE 0x2400013e SWORD_COL_DIRECT 0 NO_COMPU_METHOD -32768 32767 /end CHARACTERISTIC
/begin CHARACTERISTIC DEBUGIN_ALO_HB_State_RL2 "" VALUE 0x24000138 SWORD_COL_DIRECT 0 NO_COMPU_METHOD -32768 32767 /end CHARACTERISTIC
/begin CHARACTERISTIC DEBUGIN_ALO_HB_State_RR1 "" VALUE 0x24000132 SWORD_COL_DIRECT 0 NO_COMPU_METHOD -32768 32767 /end CHARACTERISTIC
/begin CHARACTERISTIC DEBUGIN_ELK_Algo_Status_RL1 "" VALUE 0x240001ac SWORD_COL_DIRECT 0 NO_COMPU_METHOD -32768 32767 /end CHARACTERISTIC
/begin CHARACTERISTIC DEBUGIN_ELK_Algo_Status_RL2 "" VALUE 0x240001b2 SWORD_COL_DIRECT 0 NO_COMPU_METHOD -32768 32767 /end CHARACTERISTIC
/begin CHARACTERISTIC DEBUGIN_ELK_Algo_Status_RR1 "" VALUE 0x240001b8 SWORD_COL_DIRECT 0 NO_COMPU_METHOD -32768 32767 /end CHARACTERISTIC
/begin CHARACTERISTIC DEBUGIN_ELK_ECU_Status_RL1 "" VALUE 0x240001be SWORD_COL_DIRECT 0 NO_COMPU_METHOD -32768 32767 /end CHARACTERISTIC
/begin CHARACTERISTIC DEBUGIN_ELK_ECU_Status_RL2 "" VALUE 0x240001c4 SWORD_COL_DIRECT 0 NO_COMPU_METHOD -32768 32767 /end CHARACTERISTIC
/begin CHARACTERISTIC DEBUGIN_ELK_ECU_Status_RR1 "" VALUE 0x240001ca SWORD_COL_DIRECT 0 NO_COMPU_METHOD -32768 32767 /end CHARACTERISTIC
/begin CHARACTERISTIC DEBUGIN_ELK_Lock_Status_RL1 "" VALUE 0x2400019a SWORD_COL_DIRECT 0 NO_COMPU_METHOD -32768 32767 /end CHARACTERISTIC
/begin CHARACTERISTIC DEBUGIN_ELK_Lock_Status_RL2 "" VALUE 0x240001a0 SWORD_COL_DIRECT 0 NO_COMPU_METHOD -32768 32767 /end CHARACTERISTIC
/begin CHARACTERISTIC DEBUGIN_ELK_Lock_Status_RR1 "" VALUE 0x240001a6 SWORD_COL_DIRECT 0 NO_COMPU_METHOD -32768 32767 /end CHARACTERISTIC
/begin CHARACTERISTIC DEBUGIN_ELK_WriteErrorCounter_RL1_Int16 "" VALUE 0x24015f12 SWORD_COL_DIRECT 0 NO_COMPU_METHOD -32768 32767 /end CHARACTERISTIC
/begin CHARACTERISTIC DEBUGIN_ELK_WriteErrorCounter_RL2_Int16 "" VALUE 0x24015f0c SWORD_COL_DIRECT 0 NO_COMPU_METHOD -32768 32767 /end CHARACTERISTIC
/begin CHARACTERISTIC DEBUGIN_ELK_WriteErrorCounter_RR1_Int16 "" VALUE 0x24015f06 SWORD_COL_DIRECT 0 NO_COMPU_METHOD -32768 32767 /end CHARACTERISTIC
/begin CHARACTERISTIC DEBUGIN_ELK_WriteMemotyRequest_RL1_bool "" VALUE 0x24015ef4 SWORD_COL_DIRECT 0 NO_COMPU_METHOD -32768 32767 /end CHARACTERISTIC
/begin CHARACTERISTIC DEBUGIN_ELK_WriteMemotyRequest_RL2_bool "" VALUE 0x24015efa SWORD_COL_DIRECT 0 NO_COMPU_METHOD -32768 32767 /end CHARACTERISTIC
/begin CHARACTERISTIC DEBUGIN_ELK_WriteMemotyRequest_RR1_bool "" VALUE 0x24015f00 SWORD_COL_DIRECT 0 NO_COMPU_METHOD -32768 32767 /end CHARACTERISTIC
/begin CHARACTERISTIC DEBUGIN_HMI_ABL_FL_RetractRequest "" VALUE 0x240001fa SWORD_COL_DIRECT 0 NO_COMPU_METHOD -32768 32767 /end CHARACTERISTIC
/begin CHARACTERISTIC DEBUGIN_HMI_ABL_FR_RetractRequest "" VALUE 0x24000200 SWORD_COL_DIRECT 0 NO_COMPU_METHOD -32768 32767 /end CHARACTERISTIC
/begin CHARACTERISTIC DEBUGIN_HMI_ABL_RL1_RetractRequest "" VALUE 0x24000206 SWORD_COL_DIRECT 0 NO_COMPU_METHOD -32768 32767 /end CHARACTERISTIC
/begin CHARACTERISTIC DEBUGIN_HMI_ABL_Rx_Status "" VALUE 0x240001f4 SWORD_COL_DIRECT 0 NO_COMPU_METHOD -32768 32767 /end CHARACTERISTIC
/begin CHARACTERISTIC DEBUGIN_HMI_ISB_RL1_GroupOrModule "" VALUE 0x240002e4 SWORD_COL_DIRECT 0 NO_COMPU_METHOD -32768 32767 /end CHARACTERISTIC
/begin CHARACTERISTIC DEBUGIN_HMI_ISB_RL2_AddressByte0 "" VALUE 0x24000326 SWORD_COL_DIRECT 0 NO_COMPU_METHOD -32768 32767 /end CHARACTERISTIC
/begin CHARACTERISTIC DEBUGIN_HMI_ISB_RL2_AddressByte1 "" VALUE 0x2400032c SWORD_COL_DIRECT 0 NO_COMPU_METHOD -32768 32767 /end CHARACTERISTIC
/begin CHARACTERISTIC DEBUGIN_HMI_ISB_RL2_ColorBlue "" VALUE 0x24000302 SWORD_COL_DIRECT 0 NO_COMPU_METHOD -32768 32767 /end CHARACTERISTIC
/begin CHARACTERISTIC DEBUGIN_HMI_ISB_RL2_ColorGreen "" VALUE 0x240002fc SWORD_COL_DIRECT 0 NO_COMPU_METHOD -32768 32767 /end CHARACTERISTIC
/begin CHARACTERISTIC DEBUGIN_HMI_ISB_RL2_ColorRed "" VALUE 0x24000308 SWORD_COL_DIRECT 0 NO_COMPU_METHOD -32768 32767 /end CHARACTERISTIC
/begin CHARACTERISTIC DEBUGIN_HMI_ISB_RL2_GroupOrModule "" VALUE 0x24000320 SWORD_COL_DIRECT 0 NO_COMPU_METHOD -32768 32767 /end CHARACTERISTIC
/begin CHARACTERISTIC DEBUGIN_HMI_ISB_RL2_Intensity "" VALUE 0x2400030e SWORD_COL_DIRECT 0 NO_COMPU_METHOD -32768 32767 /end CHARACTERISTIC
/begin CHARACTERISTIC DEBUGIN_HMI_ISB_RL2_Normalization "" VALUE 0x24000314 SWORD_COL_DIRECT 0 NO_COMPU_METHOD -32768 32767 /end CHARACTERISTIC
/begin CHARACTERISTIC DEBUGIN_HMI_ISB_RL2_Rx_Status "" VALUE 0x240002f6 SWORD_COL_DIRECT 0 NO_COMPU_METHOD -32768 32767 /end CHARACTERISTIC
/begin CHARACTERISTIC DEBUGIN_HMI_ISB_RL2_Transitionspeed "" VALUE 0x2400031a SWORD_COL_DIRECT 0 NO_COMPU_METHOD -32768 32767 /end CHARACTERISTIC
/begin CHARACTERISTIC DEBUGIN_HMI_ISB_RR1_AddressByte0 "" VALUE 0x24000362 SWORD_COL_DIRECT 0 NO_COMPU_METHOD -32768 32767 /end CHARACTERISTIC
/begin CHARACTERISTIC DEBUGIN_HMI_ISB_RR1_AddressByte1 "" VALUE 0x24000368 SWORD_COL_DIRECT 0 NO_COMPU_METHOD -32768 32767 /end CHARACTERISTIC
/begin CHARACTERISTIC DEBUGIN_HMI_ISB_RR1_ColorBlue "" VALUE 0x2400033e SWORD_COL_DIRECT 0 NO_COMPU_METHOD -32768 32767 /end CHARACTERISTIC
/begin CHARACTERISTIC DEBUGIN_HMI_ISB_RR1_ColorGreen "" VALUE 0x24000338 SWORD_COL_DIRECT 0 NO_COMPU_METHOD -32768 32767 /end CHARACTERISTIC
/begin CHARACTERISTIC DEBUGIN_HMI_ISB_RR1_ColorRed "" VALUE 0x24000344 SWORD_COL_DIRECT 0 NO_COMPU_METHOD -32768 32767 /end CHARACTERISTIC
/begin CHARACTERISTIC DEBUGIN_HMI_ISB_RR1_GroupOrModule "" VALUE 0x2400035c SWORD_COL_DIRECT 0 NO_COMPU_METHOD -32768 32767 /end CHARACTERISTIC
/begin CHARACTERISTIC DEBUGIN_HMI_ISB_RR1_Intensity "" VALUE 0x2400034a SWORD_COL_DIRECT 0 NO_COMPU_METHOD -32768 32767 /end CHARACTERISTIC
/begin CHARACTERISTIC DEBUGIN_HMI_ISB_RR1_Normalization "" VALUE 0x24000350 SWORD_COL_DIRECT 0 NO_COMPU_METHOD -32768 32767 /end CHARACTERISTIC
/begin CHARACTERISTIC DEBUGIN_HMI_ISB_RR1_Rx_Status "" VALUE 0x24000332 SWORD_COL_DIRECT 0 NO_COMPU_METHOD -32768 32767 /end CHARACTERISTIC
/begin CHARACTERISTIC DEBUGIN_HMI_ISB_RR1_Transitionspeed "" VALUE 0x24000356 SWORD_COL_DIRECT 0 NO_COMPU_METHOD -32768 32767 /end CHARACTERISTIC
/begin CHARACTERISTIC DEBUGIN_HMI_SEAL_ActivationRequest "" VALUE 0x2400036e SWORD_COL_DIRECT 0 NO_COMPU_METHOD -32768 32767 /end CHARACTERISTIC
/begin CHARACTERISTIC DEBUGIN_OMS_FL_HandsOnWheel "" VALUE 0x24000392 SWORD_COL_DIRECT 0 NO_COMPU_METHOD -32768 32767 /end CHARACTERISTIC
/begin CHARACTERISTIC DEBUGIN_OMS_FL_OccupantClassification "" VALUE 0x24000398 SWORD_COL_DIRECT 0 NO_COMPU_METHOD -32768 32767 /end CHARACTERISTIC
/begin CHARACTERISTIC DEBUGIN_OMS_FL_OccupantHeightMean_cm "" VALUE 0x24000434 SWORD_COL_DIRECT 0 NO_COMPU_METHOD -32768 32767 /end CHARACTERISTIC
/begin CHARACTERISTIC DEBUGIN_OMS_FL_OccupantHeightStd_cm "" VALUE 0x2400042e SWORD_COL_DIRECT 0 NO_COMPU_METHOD -32768 32767 /end CHARACTERISTIC
/begin CHARACTERISTIC DEBUGIN_OMS_FL_OccupantPresence "" VALUE 0x240003b6 SWORD_COL_DIRECT 0 NO_COMPU_METHOD -32768 32767 /end CHARACTERISTIC
/begin CHARACTERISTIC DEBUGIN_OMS_FL_OccupantWeightMean_kg "" VALUE 0x240003f8 SWORD_COL_DIRECT 0 NO_COMPU_METHOD -32768 32767 /end CHARACTERISTIC
/begin CHARACTERISTIC DEBUGIN_OMS_FL_OccupantWeightStd_kg "" VALUE 0x240003f2 SWORD_COL_DIRECT 0 NO_COMPU_METHOD -32768 32767 /end CHARACTERISTIC
/begin CHARACTERISTIC DEBUGIN_OMS_FL_OutOfPosition "" VALUE 0x240003d4 SWORD_COL_DIRECT 0 NO_COMPU_METHOD -32768 32767 /end CHARACTERISTIC
/begin CHARACTERISTIC DEBUGIN_OMS_FL_Rx_Status "" VALUE 0x24000374 SWORD_COL_DIRECT 0 NO_COMPU_METHOD -32768 32767 /end CHARACTERISTIC
/begin CHARACTERISTIC DEBUGIN_OMS_FR_OccupantClassification "" VALUE 0x2400039e SWORD_COL_DIRECT 0 NO_COMPU_METHOD -32768 32767 /end CHARACTERISTIC
/begin CHARACTERISTIC DEBUGIN_OMS_FR_OccupantHeightMean_cm "" VALUE 0x24000440 SWORD_COL_DIRECT 0 NO_COMPU_METHOD -32768 32767 /end CHARACTERISTIC
/begin CHARACTERISTIC DEBUGIN_OMS_FR_OccupantHeightStd_cm "" VALUE 0x2400043a SWORD_COL_DIRECT 0 NO_COMPU_METHOD -32768 32767 /end CHARACTERISTIC
/begin CHARACTERISTIC DEBUGIN_OMS_FR_OccupantPresence "" VALUE 0x240003bc SWORD_COL_DIRECT 0 NO_COMPU_METHOD -32768 32767 /end CHARACTERISTIC
/begin CHARACTERISTIC DEBUGIN_OMS_FR_OccupantWeightMean_kg "" VALUE 0x24000404 SWORD_COL_DIRECT 0 NO_COMPU_METHOD -32768 32767 /end CHARACTERISTIC
/begin CHARACTERISTIC DEBUGIN_OMS_FR_OccupantWeightStd_kg "" VALUE 0x240003fe SWORD_COL_DIRECT 0 NO_COMPU_METHOD -32768 32767 /end CHARACTERISTIC
/begin CHARACTERISTIC DEBUGIN_OMS_FR_OutOfPosition "" VALUE 0x240003da SWORD_COL_DIRECT 0 NO_COMPU_METHOD -32768 32767 /end CHARACTERISTIC
/begin CHARACTERISTIC DEBUGIN_OMS_FR_Rx_Status "" VALUE 0x2400037a SWORD_COL_DIRECT 0 NO_COMPU_METHOD -32768 32767 /end CHARACTERISTIC
/begin CHARACTERISTIC DEBUGIN_OMS_RL1_OccupantClassification "" VALUE 0x240003a4 SWORD_COL_DIRECT 0 NO_COMPU_METHOD -32768 32767 /end CHARACTERISTIC
/begin CHARACTERISTIC DEBUGIN_OMS_RL1_OccupantHeightMean_cm "" VALUE 0x2400044c SWORD_COL_DIRECT 0 NO_COMPU_METHOD -32768 32767 /end CHARACTERISTIC
/begin CHARACTERISTIC DEBUGIN_OMS_RL1_OccupantHeightStd_cm "" VALUE 0x24000446 SWORD_COL_DIRECT 0 NO_COMPU_METHOD -32768 32767 /end CHARACTERISTIC
/begin CHARACTERISTIC DEBUGIN_OMS_RL1_OccupantPresence "" VALUE 0x240003c2 SWORD_COL_DIRECT 0 NO_COMPU_METHOD -32768 32767 /end CHARACTERISTIC
/begin CHARACTERISTIC DEBUGIN_OMS_RL1_OccupantWeightMean_kg "" VALUE 0x24000410 SWORD_COL_DIRECT 0 NO_COMPU_METHOD -32768 32767 /end CHARACTERISTIC
/begin CHARACTERISTIC DEBUGIN_OMS_RL1_OccupantWeightStd_kg "" VALUE 0x2400040a SWORD_COL_DIRECT 0 NO_COMPU_METHOD -32768 32767 /end CHARACTERISTIC
/begin CHARACTERISTIC DEBUGIN_OMS_RL1_OutOfPosition "" VALUE 0x240003e0 SWORD_COL_DIRECT 0 NO_COMPU_METHOD -32768 32767 /end CHARACTERISTIC
/begin CHARACTERISTIC DEBUGIN_OMS_RL1_Rx_Status "" VALUE 0x24000380 SWORD_COL_DIRECT 0 NO_COMPU_METHOD -32768 32767 /end CHARACTERISTIC
/begin CHARACTERISTIC DEBUGIN_OMS_RL2_OccupantClassification "" VALUE 0x240003aa SWORD_COL_DIRECT 0 NO_COMPU_METHOD -32768 32767 /end CHARACTERISTIC
/begin CHARACTERISTIC DEBUGIN_OMS_RL2_OccupantHeightMean_cm "" VALUE 0x24000458 SWORD_COL_DIRECT 0 NO_COMPU_METHOD -32768 32767 /end CHARACTERISTIC
/begin CHARACTERISTIC DEBUGIN_OMS_RL2_OccupantHeightStd_cm "" VALUE 0x24000452 SWORD_COL_DIRECT 0 NO_COMPU_METHOD -32768 32767 /end CHARACTERISTIC
/begin CHARACTERISTIC DEBUGIN_OMS_RL2_OccupantPresence "" VALUE 0x240003c8 SWORD_COL_DIRECT 0 NO_COMPU_METHOD -32768 32767 /end CHARACTERISTIC
/begin CHARACTERISTIC DEBUGIN_OMS_RL2_OccupantWeightMean_kg "" VALUE 0x2400041c SWORD_COL_DIRECT 0 NO_COMPU_METHOD -32768 32767 /end CHARACTERISTIC
/begin CHARACTERISTIC DEBUGIN_OMS_RL2_OccupantWeightStd_kg "" VALUE 0x24000416 SWORD_COL_DIRECT 0 NO_COMPU_METHOD -32768 32767 /end CHARACTERISTIC
/begin CHARACTERISTIC DEBUGIN_OMS_RL2_OutOfPosition "" VALUE 0x240003e6 SWORD_COL_DIRECT 0 NO_COMPU_METHOD -32768 32767 /end CHARACTERISTIC
/begin CHARACTERISTIC DEBUGIN_OMS_RL2_Rx_Status "" VALUE 0x24000386 SWORD_COL_DIRECT 0 NO_COMPU_METHOD -32768 32767 /end CHARACTERISTIC
/begin CHARACTERISTIC DEBUGIN_OMS_RR1_OccupantClassification "" VALUE 0x240003b0 SWORD_COL_DIRECT 0 NO_COMPU_METHOD -32768 32767 /end CHARACTERISTIC
/begin CHARACTERISTIC DEBUGIN_OMS_RR1_OccupantHeightMean_cm "" VALUE 0x24000464 SWORD_COL_DIRECT 0 NO_COMPU_METHOD -32768 32767 /end CHARACTERISTIC
/begin CHARACTERISTIC DEBUGIN_OMS_RR1_OccupantHeightStd_cm "" VALUE 0x2400045e SWORD_COL_DIRECT 0 NO_COMPU_METHOD -32768 32767 /end CHARACTERISTIC
/begin CHARACTERISTIC DEBUGIN_OMS_RR1_OccupantPresence "" VALUE 0x240003ce SWORD_COL_DIRECT 0 NO_COMPU_METHOD -32768 32767 /end CHARACTERISTIC
/begin CHARACTERISTIC DEBUGIN_OMS_RR1_OccupantWeightMean_kg "" VALUE 0x24000428 SWORD_COL_DIRECT 0 NO_COMPU_METHOD -32768 32767 /end CHARACTERISTIC
/begin CHARACTERISTIC DEBUGIN_OMS_RR1_OccupantWeightStd_kg "" VALUE 0x24000422 SWORD_COL_DIRECT 0 NO_COMPU_METHOD -32768 32767 /end CHARACTERISTIC
/begin CHARACTERISTIC DEBUGIN_OMS_RR1_OutOfPosition "" VALUE 0x240003ec SWORD_COL_DIRECT 0 NO_COMPU_METHOD -32768 32767 /end CHARACTERISTIC
/begin CHARACTERISTIC DEBUGIN_OMS_RR1_Rx_Status "" VALUE 0x2400038c SWORD_COL_DIRECT 0 NO_COMPU_METHOD -32768 32767 /end CHARACTERISTIC
/begin CHARACTERISTIC Enable_RetractReq_ADAS_Curv "" VALUE 0x24015dd8 UBYTE_COL_DIRECT 0 NO_COMPU_METHOD 0 1 /end CHARACTERISTIC
/begin CHARACTERISTIC Enable_RetractReq_ADAS_Junc "" VALUE 0x24015dd9 UBYTE_COL_DIRECT 0 NO_COMPU_METHOD 0 1 /end CHARACTERISTIC
/begin CHARACTERISTIC Enable_RetractRequest_ADAS "" VALUE 0x24015dda UBYTE_COL_DIRECT 0 NO_COMPU_METHOD 0 1 /end CHARACTERISTIC
/begin CHARACTERISTIC Enable_RetractRequest_AY "" VALUE 0x24015ddc UBYTE_COL_DIRECT 0 NO_COMPU_METHOD 0 1 /end CHARACTERISTIC
/begin CHARACTERISTIC Enable_RetractRequest_CAM "" VALUE 0x240160c8 UBYTE_COL_DIRECT 0 NO_COMPU_METHOD 0 1 /end CHARACTERISTIC
/begin CHARACTERISTIC ISB_PARAM_BlinkOffBeforeBuckle_ms "" VALUE 0x24016170 UWORD_COL_DIRECT 0 NO_COMPU_METHOD 0 65535 /end CHARACTERISTIC
/begin CHARACTERISTIC ISB_PARAM_BlinkOffBuckleBeginDrive_ms "" VALUE 0x2401616e UWORD_COL_DIRECT 0 NO_COMPU_METHOD 0 65535 /end CHARACTERISTIC
/begin CHARACTERISTIC ISB_PARAM_BlinkOffBuckleDuringDrive_ms "" VALUE 0x2401616c UWORD_COL_DIRECT 0 NO_COMPU_METHOD 0 65535 /end CHARACTERISTIC
/begin CHARACTERISTIC ISB_PARAM_BlinkOnBeforeBuckle_ms "" VALUE 0x2401616a UWORD_COL_DIRECT 0 NO_COMPU_METHOD 0 65535 /end CHARACTERISTIC
/begin CHARACTERISTIC ISB_PARAM_BlinkOnBuckleBeginDrive_ms "" VALUE 0x24016168 UWORD_COL_DIRECT 0 NO_COMPU_METHOD 0 65535 /end CHARACTERISTIC
/begin CHARACTERISTIC ISB_PARAM_BlinkOnBuckleDuringDrive_ms "" VALUE 0x24016166 UWORD_COL_DIRECT 0 NO_COMPU_METHOD 0 65535 /end CHARACTERISTIC
/begin CHARACTERISTIC ISB_PARAM_SwitchOffAfterBuckle_ms "" VALUE 0x24016164 UWORD_COL_DIRECT 0 NO_COMPU_METHOD 0 65535 /end CHARACTERISTIC
/begin CHARACTERISTIC ISB_PARAM_SwitchOffOpenDoor_ms "" VALUE 0x24016162 UWORD_COL_DIRECT 0 NO_COMPU_METHOD 0 65535 /end CHARACTERISTIC
/begin CHARACTERISTIC ISB_PARAM_SwitchOffStandStill_ms "" VALUE 0x24016160 UWORD_COL_DIRECT 0 NO_COMPU_METHOD 0 65535 /end CHARACTERISTIC
/begin CHARACTERISTIC ISB_PARAM_SwitchOffUnlock_ms "" VALUE 0x2401615e UWORD_COL_DIRECT 0 NO_COMPU_METHOD 0 65535 /end CHARACTERISTIC
/begin CHARACTERISTIC PARAM_AirbagClose_Qualitime_msec "" VALUE 0x24015e88 UWORD_COL_DIRECT 0 NO_COMPU_METHOD 0 65535 /end CHARACTERISTIC
/begin CHARACTERISTIC PARAM_Delay_AirbagClose "" VALUE 0x24015e96 UWORD_COL_DIRECT 0 NO_COMPU_METHOD 0 65535 /end CHARACTERISTIC
/begin CHARACTERISTIC PARAM_Delay_BentBackward "" VALUE 0x24015e06 UWORD_COL_DIRECT 0 NO_COMPU_METHOD 0 65535 /end CHARACTERISTIC
/begin CHARACTERISTIC PARAM_Delay_LeanedLeft "" VALUE 0x24015e46 UWORD_COL_DIRECT 0 NO_COMPU_METHOD 0 65535 /end CHARACTERISTIC
/begin CHARACTERISTIC PARAM_Delay_LeanedRight "" VALUE 0x24015e6e UWORD_COL_DIRECT 0 NO_COMPU_METHOD 0 65535 /end CHARACTERISTIC
/begin CHARACTERISTIC PARAM_leanedForward_Qualitime_msec "" VALUE 0x24015e20 UWORD_COL_DIRECT 0 NO_COMPU_METHOD 0 65535 /end CHARACTERISTIC
/begin CHARACTERISTIC PARAM_leanedLeft_Qualitime_msec "" VALUE 0x24015e38 UWORD_COL_DIRECT 0 NO_COMPU_METHOD 0 65535 /end CHARACTERISTIC
/begin CHARACTERISTIC PARAM_leanedRight_Qualitime_msec "" VALUE 0x24015e60 UWORD_COL_DIRECT 0 NO_COMPU_METHOD 0 65535 /end CHARACTERISTIC
/begin CHARACTERISTIC PARAM_tiltedBack_Qualitime_msec "" VALUE 0x24015df8 UWORD_COL_DIRECT 0 NO_COMPU_METHOD 0 65535 /end CHARACTERISTIC
/begin CHARACTERISTIC PARAM_VS_REL_Cons_Requests "" VALUE 0x240160ed UBYTE_COL_DIRECT 0 NO_COMPU_METHOD 0 255 /end CHARACTERISTIC
/begin CHARACTERISTIC PARAM_VS_REL_Request_Del_msec_1 "" VALUE 0x240160e6 UBYTE_COL_DIRECT 0 EQ_LSB_1 0 255 /end CHARACTERISTIC
/begin CHARACTERISTIC SELK_Manager14_DEBUGIN_Error_detected "" VALUE 0x24015ee0 UBYTE_COL_DIRECT 0 NO_COMPU_METHOD 0 1 /end CHARACTERISTIC
/begin CHARACTERISTIC SELK_Manager25_DEBUGIN_Error_detected "" VALUE 0x24015ee8 UBYTE_COL_DIRECT 0 NO_COMPU_METHOD 0 1 /end CHARACTERISTIC
/begin CHARACTERISTIC SELK_Manager36_DEBUGIN_Error_detected "" VALUE 0x24015ef0 UBYTE_COL_DIRECT 0 NO_COMPU_METHOD 0 1 /end CHARACTERISTIC
/begin CHARACTERISTIC SVSMA_HPW2_AEB_L1_Enable "" VALUE 0x240162f3 UBYTE_COL_DIRECT 0 NO_COMPU_METHOD 0 1 /end CHARACTERISTIC
/begin CHARACTERISTIC SVSMA_HPW2_AEB_L2_Enable "" VALUE 0x240162f2 UBYTE_COL_DIRECT 0 NO_COMPU_METHOD 0 1 /end CHARACTERISTIC
/begin CHARACTERISTIC XCP_in_ACB_CAN_Awake_Sa534 "" VALUE 0x240004d0 UBYTE_COL_DIRECT 0 NO_COMPU_METHOD 0 1 /end CHARACTERISTIC
/begin CHARACTERISTIC XCP_in_ACB_CAN_Awake_Sa535 "" VALUE 0x24000500 UBYTE_COL_DIRECT 0 NO_COMPU_METHOD 0 1 /end CHARACTERISTIC
/begin CHARACTERISTIC XCP_in_ACB_CAN_Awake_Sa536 "" VALUE 0x24000530 UBYTE_COL_DIRECT 0 NO_COMPU_METHOD 0 1 /end CHARACTERISTIC
/begin CHARACTERISTIC XCP_in_ACB_CAN_Awake_Sa537 "" VALUE 0x24000560 UBYTE_COL_DIRECT 0 NO_COMPU_METHOD 0 1 /end CHARACTERISTIC
/begin CHARACTERISTIC XCP_in_ACB_CAN_Awake_Sa538 "" VALUE 0x24000590 UBYTE_COL_DIRECT 0 NO_COMPU_METHOD 0 1 /end CHARACTERISTIC
/begin CHARACTERISTIC XCP_in_ACB_CarSpeed_Sa534 "" VALUE 0x240004b1 UBYTE_COL_DIRECT 0 NO_COMPU_METHOD 0 255 /end CHARACTERISTIC
/begin CHARACTERISTIC XCP_in_ACB_CarSpeed_Sa535 "" VALUE 0x240004e1 UBYTE_COL_DIRECT 0 NO_COMPU_METHOD 0 255 /end CHARACTERISTIC
/begin CHARACTERISTIC XCP_in_ACB_CarSpeed_Sa536 "" VALUE 0x24000511 UBYTE_COL_DIRECT 0 NO_COMPU_METHOD 0 255 /end CHARACTERISTIC
/begin CHARACTERISTIC XCP_in_ACB_CarSpeed_Sa537 "" VALUE 0x24000541 UBYTE_COL_DIRECT 0 NO_COMPU_METHOD 0 255 /end CHARACTERISTIC
/begin CHARACTERISTIC XCP_in_ACB_CarSpeed_Sa538 "" VALUE 0x24000571 UBYTE_COL_DIRECT 0 NO_COMPU_METHOD 0 255 /end CHARACTERISTIC
/begin CHARACTERISTIC XCP_in_ACB_CLkS_LK_Sa534 "" VALUE 0x240004c8 UBYTE_COL_DIRECT 0 NO_COMPU_METHOD 0 1 /end CHARACTERISTIC
/begin CHARACTERISTIC XCP_in_ACB_CLkS_LK_Sa535 "" VALUE 0x240004f8 UBYTE_COL_DIRECT 0 NO_COMPU_METHOD 0 1 /end CHARACTERISTIC
/begin CHARACTERISTIC XCP_in_ACB_CLkS_LK_Sa536 "" VALUE 0x24000528 UBYTE_COL_DIRECT 0 NO_COMPU_METHOD 0 1 /end CHARACTERISTIC
/begin CHARACTERISTIC XCP_in_ACB_CLkS_LK_Sa537 "" VALUE 0x24000558 UBYTE_COL_DIRECT 0 NO_COMPU_METHOD 0 1 /end CHARACTERISTIC
/begin CHARACTERISTIC XCP_in_ACB_CLkS_LK_Sa538 "" VALUE 0x24000588 UBYTE_COL_DIRECT 0 NO_COMPU_METHOD 0 1 /end CHARACTERISTIC
/begin CHARACTERISTIC XCP_in_ACB_ISw_Stat_Sa534 "" VALUE 0x240004b0 UBYTE_COL_DIRECT 0 NO_COMPU_METHOD 0 255 /end CHARACTERISTIC
/begin CHARACTERISTIC XCP_in_ACB_ISw_Stat_Sa535 "" VALUE 0x240004e0 UBYTE_COL_DIRECT 0 NO_COMPU_METHOD 0 255 /end CHARACTERISTIC
/begin CHARACTERISTIC XCP_in_ACB_ISw_Stat_Sa536 "" VALUE 0x24000510 UBYTE_COL_DIRECT 0 NO_COMPU_METHOD 0 255 /end CHARACTERISTIC
/begin CHARACTERISTIC XCP_in_ACB_ISw_Stat_Sa537 "" VALUE 0x24000540 UBYTE_COL_DIRECT 0 NO_COMPU_METHOD 0 255 /end CHARACTERISTIC
/begin CHARACTERISTIC XCP_in_ACB_ISw_Stat_Sa538 "" VALUE 0x24000570 UBYTE_COL_DIRECT 0 NO_COMPU_METHOD 0 255 /end CHARACTERISTIC
/begin CHARACTERISTIC XCP_in_ACB_Open_Door_Sa534 "" VALUE 0x240004c9 UBYTE_COL_DIRECT 0 NO_COMPU_METHOD 0 1 /end CHARACTERISTIC
/begin CHARACTERISTIC XCP_in_ACB_Open_Door_Sa535 "" VALUE 0x240004f9 UBYTE_COL_DIRECT 0 NO_COMPU_METHOD 0 1 /end CHARACTERISTIC
/begin CHARACTERISTIC XCP_in_ACB_Open_Door_Sa536 "" VALUE 0x24000529 UBYTE_COL_DIRECT 0 NO_COMPU_METHOD 0 1 /end CHARACTERISTIC
/begin CHARACTERISTIC XCP_in_ACB_Open_Door_Sa537 "" VALUE 0x24000559 UBYTE_COL_DIRECT 0 NO_COMPU_METHOD 0 1 /end CHARACTERISTIC
/begin CHARACTERISTIC XCP_in_ACB_Open_Door_Sa538 "" VALUE 0x24000589 UBYTE_COL_DIRECT 0 NO_COMPU_METHOD 0 1 /end CHARACTERISTIC
/begin MEASUREMENT AEB_Level1 "" UBYTE NO_COMPU_METHOD 1 100 0 1 ECU_ADDRESS 0x24027113 /end MEASUREMENT
/begin MEASUREMENT AEB_Level2 "" UBYTE NO_COMPU_METHOD 1 100 0 1 ECU_ADDRESS 0x24027112 /end MEASUREMENT
/begin MEASUREMENT ALI_AEB_Brk_Request "" UBYTE NO_COMPU_METHOD 1 100 0 255 ECU_ADDRESS 0x24026dd0 /end MEASUREMENT
/begin MEASUREMENT ALI_BrakePressCalc "" UWORD EQ_LSB_0_01 1 100 0 655.35 ECU_ADDRESS 0x24026c6c /end MEASUREMENT
/begin MEASUREMENT ALI_YawRate_Z_degs "Yaw Rate" SWORD SMA_FNC_YawRate_Z 1 100 -327.68 327.67 ECU_ADDRESS 0x24026d9c /end MEASUREMENT
/begin MEASUREMENT ay_Requested "" UBYTE NO_COMPU_METHOD 1 100 0 1 ECU_ADDRESS 0x24015ddb /end MEASUREMENT
/begin MEASUREMENT Debug_ABL_ComfortActivation_FL "" SWORD NO_COMPU_METHOD 1 100 -32768 32767 ECU_ADDRESS 0x24026c48 /end MEASUREMENT
/begin MEASUREMENT Debug_ABL_ComfortActivation_FR "" SWORD NO_COMPU_METHOD 1 100 -32768 32767 ECU_ADDRESS 0x24026c52 /end MEASUREMENT
/begin MEASUREMENT Debug_ABL_ComfortActivation_RL1 "" SWORD NO_COMPU_METHOD 1 100 -32768 32767 ECU_ADDRESS 0x24026c0a /end MEASUREMENT
/begin MEASUREMENT Debug_ABL_ComfortActivation_RL2 "" SWORD NO_COMPU_METHOD 1 100 -32768 32767 ECU_ADDRESS 0x24026c06 /end MEASUREMENT
/begin MEASUREMENT Debug_ABL_ComfortActivation_RR1 "" SWORD NO_COMPU_METHOD 1 100 -32768 32767 ECU_ADDRESS 0x24026d18 /end MEASUREMENT
/begin MEASUREMENT Debug_ABL_StateControl_FL "" SWORD NO_COMPU_METHOD 1 100 -32768 32767 ECU_ADDRESS 0x24026c28 /end MEASUREMENT
/begin MEASUREMENT Debug_ABL_StateControl_FR "" SWORD NO_COMPU_METHOD 1 100 -32768 32767 ECU_ADDRESS 0x24026c26 /end MEASUREMENT
/begin MEASUREMENT Debug_ABL_StateControl_RL1 "" SWORD NO_COMPU_METHOD 1 100 -32768 32767 ECU_ADDRESS 0x24026ca0 /end MEASUREMENT
/begin MEASUREMENT Debug_ABL_StateControl_RL2 "" SWORD NO_COMPU_METHOD 1 100 -32768 32767 ECU_ADDRESS 0x24026c96 /end MEASUREMENT
/begin MEASUREMENT Debug_ABL_StateControl_RR1 "" SWORD NO_COMPU_METHOD 1 100 -32768 32767 ECU_ADDRESS 0x24026c4a /end MEASUREMENT
/begin MEASUREMENT Debug_AibagClose_True "" UBYTE NO_COMPU_METHOD 1 100 0 255 ECU_ADDRESS 0x24026d16 /end MEASUREMENT
/begin MEASUREMENT Debug_ALI_ISw_Stat "" UBYTE NO_COMPU_METHOD 1 100 0 255 ECU_ADDRESS 0x24026d60 /end MEASUREMENT
/begin MEASUREMENT Debug_CAN_Awake "" UBYTE NO_COMPU_METHOD 1 100 0 255 ECU_ADDRESS 0x24026c77 /end MEASUREMENT
/begin MEASUREMENT Debug_DB_ReleaseActivation_State "" UBYTE NO_COMPU_METHOD 1 100 0 255 ECU_ADDRESS 0x24026cb6 /end MEASUREMENT
/begin MEASUREMENT Debug_DynamicBelt_activated "" UBYTE NO_COMPU_METHOD 1 100 0 255 ECU_ADDRESS 0x24026c55 /end MEASUREMENT
/begin MEASUREMENT Debug_E_classVersion "" UBYTE NO_COMPU_METHOD 1 100 0 255 ECU_ADDRESS 0x24026c7e /end MEASUREMENT
/begin MEASUREMENT Debug_FNCActivationLevel "" UBYTE NO_COMPU_METHOD 1 100 0 255 ECU_ADDRESS 0x24026bf6 /end MEASUREMENT
/begin MEASUREMENT Debug_LeanedForward_True "" UBYTE NO_COMPU_METHOD 1 100 0 255 ECU_ADDRESS 0x24026c32 /end MEASUREMENT
/begin MEASUREMENT Debug_LeanLeft_True "" UBYTE NO_COMPU_METHOD 1 100 0 255 ECU_ADDRESS 0x24026c03 /end MEASUREMENT
/begin MEASUREMENT Debug_LeanRight_True "" UBYTE NO_COMPU_METHOD 1 100 0 255 ECU_ADDRESS 0x24026c7d /end MEASUREMENT
/begin MEASUREMENT Debug_TiltedBack_True "" UBYTE NO_COMPU_METHOD 1 100 0 255 ECU_ADDRESS 0x24026c8e /end MEASUREMENT
/begin MEASUREMENT Debug_TOF_OccupantClass_FL "" UBYTE NO_COMPU_METHOD 1 100 0 255 ECU_ADDRESS 0x24026c7c /end MEASUREMENT
/begin MEASUREMENT Debug_TOF_OccupantClass_FP "" UBYTE NO_COMPU_METHOD 1 100 0 255 ECU_ADDRESS 0x24026c7f /end MEASUREMENT
/begin MEASUREMENT Debug_TOF_OccupantClass_RL1 "" UBYTE NO_COMPU_METHOD 1 100 0 255 ECU_ADDRESS 0x24026bfb /end MEASUREMENT
/begin MEASUREMENT Debug_TOF_OccupantClass_RL2 "" UBYTE NO_COMPU_METHOD 1 100 0 255 ECU_ADDRESS 0x24026bfe /end MEASUREMENT
/begin MEASUREMENT Debug_TOF_OccupantClass_RR "" UBYTE NO_COMPU_METHOD 1 100 0 255 ECU_ADDRESS 0x24026c67 /end MEASUREMENT
/begin MEASUREMENT Debug_TOF_OccupantWeight_FL "" UBYTE NO_COMPU_METHOD 1 100 0 255 ECU_ADDRESS 0x24026c33 /end MEASUREMENT
/begin MEASUREMENT Debug_TOF_OccupantWeight_FR "" UBYTE NO_COMPU_METHOD 1 100 0 255 ECU_ADDRESS 0x24026c08 /end MEASUREMENT
/begin MEASUREMENT Debug_TOF_OccupantWeight_RL "" UBYTE NO_COMPU_METHOD 1 100 0 255 ECU_ADDRESS 0x24026c04 /end MEASUREMENT
/begin MEASUREMENT Debug_TOF_OccupantWeight_RR "" UBYTE NO_COMPU_METHOD 1 100 0 255 ECU_ADDRESS 0x24026bf9 /end MEASUREMENT
/begin MEASUREMENT Debug_TOF_OutOfPostion_FL "" UWORD NO_COMPU_METHOD 1 100 0 65535 ECU_ADDRESS 0x24026cb4 /end MEASUREMENT
/begin MEASUREMENT Debug_TOF_OutOfPostion_FP "" UWORD NO_COMPU_METHOD 1 100 0 65535 ECU_ADDRESS 0x24026c98 /end MEASUREMENT
/begin MEASUREMENT Debug_TOF_OutOfPostion_RL1 "" UWORD NO_COMPU_METHOD 1 100 0 65535 ECU_ADDRESS 0x24026c88 /end MEASUREMENT
/begin MEASUREMENT Debug_TOF_OutOfPostion_RL2 "" UWORD NO_COMPU_METHOD 1 100 0 65535 ECU_ADDRESS 0x24026c9c /end MEASUREMENT
/begin MEASUREMENT Debug_TOF_OutOfPostion_RR "" UWORD NO_COMPU_METHOD 1 100 0 65535 ECU_ADDRESS 0x24026c84 /end MEASUREMENT
/begin MEASUREMENT Debug_VehAccel_X "" SWORD EQ_LSB_0_02 1 100 -655.36 655.34 ECU_ADDRESS 0x24026c8c /end MEASUREMENT
/begin MEASUREMENT Debug_VehAccel_Y "" SWORD EQ_LSB_0_02 1 100 -655.36 655.34 ECU_ADDRESS 0x24026c92 /end MEASUREMENT
/begin MEASUREMENT DEBUGOUT_ALI_OffroadSport_activated "" UBYTE NO_COMPU_METHOD 1 100 0 1 ECU_ADDRESS 0x24026cf8 /end MEASUREMENT
/begin MEASUREMENT DEBUGOUT_ALO_COM_Status_PumaFLCan "" SWORD NO_COMPU_METHOD 1 100 -32768 32767 ECU_ADDRESS 0x24000164 /end MEASUREMENT
/begin MEASUREMENT DEBUGOUT_ALO_COM_Status_PumaFRCan "" SWORD NO_COMPU_METHOD 1 100 -32768 32767 ECU_ADDRESS 0x2400015e /end MEASUREMENT
/begin MEASUREMENT DEBUGOUT_ALO_COM_Status_PumaRL1Can "" SWORD NO_COMPU_METHOD 1 100 -32768 32767 ECU_ADDRESS 0x24000158 /end MEASUREMENT
/begin MEASUREMENT DEBUGOUT_ALO_COM_Status_PumaRL2Can "" SWORD NO_COMPU_METHOD 1 100 -32768 32767 ECU_ADDRESS 0x24000152 /end MEASUREMENT
/begin MEASUREMENT DEBUGOUT_ALO_COM_Status_PumaRR1Can "" SWORD NO_COMPU_METHOD 1 100 -32768 32767 ECU_ADDRESS 0x2400014c /end MEASUREMENT
/begin MEASUREMENT DEBUGOUT_ALO_HB_State_FR "" SWORD NO_COMPU_METHOD 1 100 -32768 32767 ECU_ADDRESS 0x24000146 /end MEASUREMENT
/begin MEASUREMENT DEBUGOUT_ALO_HB_State_RL1 "" SWORD NO_COMPU_METHOD 1 100 -32768 32767 ECU_ADDRESS 0x24000140 /end MEASUREMENT
/begin MEASUREMENT DEBUGOUT_ALO_HB_State_RL2 "" SWORD NO_COMPU_METHOD 1 100 -32768 32767 ECU_ADDRESS 0x2400013a /end MEASUREMENT
/begin MEASUREMENT DEBUGOUT_ALO_HB_State_RR1 "" SWORD NO_COMPU_METHOD 1 100 -32768 32767 ECU_ADDRESS 0x24000134 /end MEASUREMENT
/begin MEASUREMENT DEBUGOUT_criticality_index_sum "" UWORD EQ_LSB_0_1 1 100 0 6553.5 ECU_ADDRESS 0x240161e6 /end MEASUREMENT
/begin MEASUREMENT DEBUGOUT_ELK_Algo_Status_RL1 "" SWORD NO_COMPU_METHOD 1 100 -32768 32767 ECU_ADDRESS 0x240001ae /end MEASUREMENT
/begin MEASUREMENT DEBUGOUT_ELK_Algo_Status_RL2 "" SWORD NO_COMPU_METHOD 1 100 -32768 32767 ECU_ADDRESS 0x240001b4 /end MEASUREMENT
/begin MEASUREMENT DEBUGOUT_ELK_Algo_Status_RR1 "" SWORD NO_COMPU_METHOD 1 100 -32768 32767 ECU_ADDRESS 0x240001ba /end MEASUREMENT
/begin MEASUREMENT DEBUGOUT_ELK_ECU_Status_RL1 "" SWORD NO_COMPU_METHOD 1 100 -32768 32767 ECU_ADDRESS 0x240001c0 /end MEASUREMENT
/begin MEASUREMENT DEBUGOUT_ELK_ECU_Status_RL2 "" SWORD NO_COMPU_METHOD 1 100 -32768 32767 ECU_ADDRESS 0x240001c6 /end MEASUREMENT
/begin MEASUREMENT DEBUGOUT_ELK_ECU_Status_RR1 "" SWORD NO_COMPU_METHOD 1 100 -32768 32767 ECU_ADDRESS 0x240001cc /end MEASUREMENT
/begin MEASUREMENT DEBUGOUT_ELK_Lock_Status_RL1 "" SWORD NO_COMPU_METHOD 1 100 -32768 32767 ECU_ADDRESS 0x2400019c /end MEASUREMENT
/begin MEASUREMENT DEBUGOUT_ELK_Lock_Status_RL2 "" SWORD NO_COMPU_METHOD 1 100 -32768 32767 ECU_ADDRESS 0x240001a2 /end MEASUREMENT
/begin MEASUREMENT DEBUGOUT_ELK_Lock_Status_RR1 "" SWORD NO_COMPU_METHOD 1 100 -32768 32767 ECU_ADDRESS 0x240001a8 /end MEASUREMENT
/begin MEASUREMENT DEBUGOUT_ELK_WriteErrorCounter_RL1_Int16 "" SWORD NO_COMPU_METHOD 1 100 -32768 32767 ECU_ADDRESS 0x24015f14 /end MEASUREMENT
/begin MEASUREMENT DEBUGOUT_ELK_WriteErrorCounter_RL2_Int16 "" SWORD NO_COMPU_METHOD 1 100 -32768 32767 ECU_ADDRESS 0x24015f0e /end MEASUREMENT
/begin MEASUREMENT DEBUGOUT_ELK_WriteErrorCounter_RR1_Int16 "" SWORD NO_COMPU_METHOD 1 100 -32768 32767 ECU_ADDRESS 0x24015f08 /end MEASUREMENT
/begin MEASUREMENT DEBUGOUT_ELK_WriteMemotyRequest_RL1_bool "" SWORD NO_COMPU_METHOD 1 100 -32768 32767 ECU_ADDRESS 0x24015ef6 /end MEASUREMENT
/begin MEASUREMENT DEBUGOUT_ELK_WriteMemotyRequest_RL2_bool "" SWORD NO_COMPU_METHOD 1 100 -32768 32767 ECU_ADDRESS 0x24015efc /end MEASUREMENT
/begin MEASUREMENT DEBUGOUT_ELK_WriteMemotyRequest_RR1_bool "" SWORD NO_COMPU_METHOD 1 100 -32768 32767 ECU_ADDRESS 0x24015f02 /end MEASUREMENT
/begin MEASUREMENT DEBUGOUT_HMI_ABL_FL_RetractRequest "" SWORD NO_COMPU_METHOD 1 100 -32768 32767 ECU_ADDRESS 0x240001fc /end MEASUREMENT
/begin MEASUREMENT DEBUGOUT_HMI_ABL_FR_RetractRequest "" SWORD NO_COMPU_METHOD 1 100 -32768 32767 ECU_ADDRESS 0x24000202 /end MEASUREMENT
/begin MEASUREMENT DEBUGOUT_HMI_ABL_RL1_RetractRequest "" SWORD NO_COMPU_METHOD 1 100 -32768 32767 ECU_ADDRESS 0x24000208 /end MEASUREMENT
/begin MEASUREMENT DEBUGOUT_HMI_ABL_RL2_RetractRequest "" SWORD NO_COMPU_METHOD 1 100 -32768 32767 ECU_ADDRESS 0x2400020e /end MEASUREMENT
/begin MEASUREMENT DEBUGOUT_HMI_ABL_RR1_RetractRequest "" SWORD NO_COMPU_METHOD 1 100 -32768 32767 ECU_ADDRESS 0x24000214 /end MEASUREMENT
/begin MEASUREMENT DEBUGOUT_HMI_ABL_Rx_Status "" SWORD NO_COMPU_METHOD 1 100 -32768 32767 ECU_ADDRESS 0x240001f6 /end MEASUREMENT
/begin MEASUREMENT DEBUGOUT_HMI_ACR_FL_RetractRequest "" SWORD NO_COMPU_METHOD 1 100 -32768 32767 ECU_ADDRESS 0x240001d8 /end MEASUREMENT
/begin MEASUREMENT DEBUGOUT_HMI_ACR_FR_RetractRequest "" SWORD NO_COMPU_METHOD 1 100 -32768 32767 ECU_ADDRESS 0x240001de /end MEASUREMENT
/begin MEASUREMENT DEBUGOUT_HMI_ACR_RL1_RetractRequest "" SWORD NO_COMPU_METHOD 1 100 -32768 32767 ECU_ADDRESS 0x240001e4 /end MEASUREMENT
/begin MEASUREMENT DEBUGOUT_HMI_ACR_RL2_RetractRequest "" SWORD NO_COMPU_METHOD 1 100 -32768 32767 ECU_ADDRESS 0x240001ea /end MEASUREMENT
/begin MEASUREMENT DEBUGOUT_HMI_ACR_RR1_RetractRequest "" SWORD NO_COMPU_METHOD 1 100 -32768 32767 ECU_ADDRESS 0x240001f0 /end MEASUREMENT
/begin MEASUREMENT DEBUGOUT_HMI_ACR_Rx_Status "" SWORD NO_COMPU_METHOD 1 100 -32768 32767 ECU_ADDRESS 0x240001d2 /end MEASUREMENT
/begin MEASUREMENT DEBUGOUT_HMI_ELK_FL_LockingRequest "" SWORD NO_COMPU_METHOD 1 100 -32768 32767 ECU_ADDRESS 0x2400022c /end MEASUREMENT
/begin MEASUREMENT DEBUGOUT_HMI_ELK_FR_LockingRequest "" SWORD NO_COMPU_METHOD 1 100 -32768 32767 ECU_ADDRESS 0x24000220 /end MEASUREMENT
/begin MEASUREMENT DEBUGOUT_HMI_ELK_ResetErrorFlags "" SWORD NO_COMPU_METHOD 1 100 -32768 32767 ECU_ADDRESS 0x2400023e /end MEASUREMENT
/begin MEASUREMENT DEBUGOUT_HMI_ELK_RL1_LockingRequest "" SWORD NO_COMPU_METHOD 1 100 -32768 32767 ECU_ADDRESS 0x24000226 /end MEASUREMENT
/begin MEASUREMENT DEBUGOUT_HMI_ELK_RL2_LockingRequest "" SWORD NO_COMPU_METHOD 1 100 -32768 32767 ECU_ADDRESS 0x24000232 /end MEASUREMENT
/begin MEASUREMENT DEBUGOUT_HMI_ELK_RR1_LockingRequest "" SWORD NO_COMPU_METHOD 1 100 -32768 32767 ECU_ADDRESS 0x24000238 /end MEASUREMENT
/begin MEASUREMENT DEBUGOUT_HMI_ELK_Rx_Status "" SWORD NO_COMPU_METHOD 1 100 -32768 32767 ECU_ADDRESS 0x2400021a /end MEASUREMENT
/begin MEASUREMENT DEBUGOUT_HMI_ISB_FL_AddressByte0_byte "" SWORD NO_COMPU_METHOD 1 100 -32768 32767 ECU_ADDRESS 0x24000274 /end MEASUREMENT
/begin MEASUREMENT DEBUGOUT_HMI_ISB_FL_AddressByte1_byte "" SWORD NO_COMPU_METHOD 1 100 -32768 32767 ECU_ADDRESS 0x2400027a /end MEASUREMENT
/begin MEASUREMENT DEBUGOUT_HMI_ISB_FL_ColorBlue_byte "" SWORD NO_COMPU_METHOD 1 100 -32768 32767 ECU_ADDRESS 0x24000250 /end MEASUREMENT
/begin MEASUREMENT DEBUGOUT_HMI_ISB_FL_ColorGreen_byte "" SWORD NO_COMPU_METHOD 1 100 -32768 32767 ECU_ADDRESS 0x2400024a /end MEASUREMENT
/begin MEASUREMENT DEBUGOUT_HMI_ISB_FL_ColorRed_byte "" SWORD NO_COMPU_METHOD 1 100 -32768 32767 ECU_ADDRESS 0x24000256 /end MEASUREMENT
/begin MEASUREMENT DEBUGOUT_HMI_ISB_FL_GroupOrModule_bool "" SWORD NO_COMPU_METHOD 1 100 -32768 32767 ECU_ADDRESS 0x2400026e /end MEASUREMENT
/begin MEASUREMENT DEBUGOUT_HMI_ISB_FL_Intensity_perc "" SWORD NO_COMPU_METHOD 1 100 -32768 32767 ECU_ADDRESS 0x2400025c /end MEASUREMENT
/begin MEASUREMENT DEBUGOUT_HMI_ISB_FL_Normalization_bool "" SWORD NO_COMPU_METHOD 1 100 -32768 32767 ECU_ADDRESS 0x24000262 /end MEASUREMENT
/begin MEASUREMENT DEBUGOUT_HMI_ISB_FL_Rx_Status "" SWORD NO_COMPU_METHOD 1 100 -32768 32767 ECU_ADDRESS 0x24000244 /end MEASUREMENT
/begin MEASUREMENT DEBUGOUT_HMI_ISB_FL_Transitionspeed_nibble "" SWORD NO_COMPU_METHOD 1 100 -32768 32767 ECU_ADDRESS 0x24000268 /end MEASUREMENT
/begin MEASUREMENT DEBUGOUT_HMI_ISB_FR_AddressByte0 "" SWORD NO_COMPU_METHOD 1 100 -32768 32767 ECU_ADDRESS 0x240002b0 /end MEASUREMENT
/begin MEASUREMENT DEBUGOUT_HMI_ISB_FR_AddressByte1 "" SWORD NO_COMPU_METHOD 1 100 -32768 32767 ECU_ADDRESS 0x240002b6 /end MEASUREMENT
/begin MEASUREMENT DEBUGOUT_HMI_ISB_FR_ColorBlue "" SWORD NO_COMPU_METHOD 1 100 -32768 32767 ECU_ADDRESS 0x2400028c /end MEASUREMENT
/begin MEASUREMENT DEBUGOUT_HMI_ISB_FR_ColorGreen "" SWORD NO_COMPU_METHOD 1 100 -32768 32767 ECU_ADDRESS 0x24000286 /end MEASUREMENT
/begin MEASUREMENT DEBUGOUT_HMI_ISB_FR_ColorRed "" SWORD NO_COMPU_METHOD 1 100 -32768 32767 ECU_ADDRESS 0x24000292 /end MEASUREMENT
/begin MEASUREMENT DEBUGOUT_HMI_ISB_FR_GroupOrModule "" SWORD NO_COMPU_METHOD 1 100 -32768 32767 ECU_ADDRESS 0x240002aa /end MEASUREMENT
/begin MEASUREMENT DEBUGOUT_HMI_ISB_FR_Intensity_perc "" SWORD NO_COMPU_METHOD 1 100 -32768 32767 ECU_ADDRESS 0x24000298 /end MEASUREMENT
/begin MEASUREMENT DEBUGOUT_HMI_ISB_FR_Normalization "" SWORD NO_COMPU_METHOD 1 100 -32768 32767 ECU_ADDRESS 0x2400029e /end MEASUREMENT
/begin MEASUREMENT DEBUGOUT_HMI_ISB_FR_Rx_Status "" SWORD NO_COMPU_METHOD 1 100 -32768 32767 ECU_ADDRESS 0x24000280 /end MEASUREMENT
/begin MEASUREMENT DEBUGOUT_HMI_ISB_FR_Transitionspeed "" SWORD NO_COMPU_METHOD 1 100 -32768 32767 ECU_ADDRESS 0x240002a4 /end MEASUREMENT
/begin MEASUREMENT DEBUGOUT_HMI_ISB_RL1_AddressByte0 "" SWORD NO_COMPU_METHOD 1 100 -32768 32767 ECU_ADDRESS 0x240002ec /end MEASUREMENT
/begin MEASUREMENT DEBUGOUT_HMI_ISB_RL1_AddressByte1 "" SWORD NO_COMPU_METHOD 1 100 -32768 32767 ECU_ADDRESS 0x240002f2 /end MEASUREMENT
/begin MEASUREMENT DEBUGOUT_HMI_ISB_RL1_ColorBlue "" SWORD NO_COMPU_METHOD 1 100 -32768 32767 ECU_ADDRESS 0x240002c8 /end MEASUREMENT
/begin MEASUREMENT DEBUGOUT_HMI_ISB_RL1_ColorGreen "" SWORD NO_COMPU_METHOD 1 100 -32768 32767 ECU_ADDRESS 0x240002c2 /end MEASUREMENT
/begin MEASUREMENT DEBUGOUT_HMI_ISB_RL1_ColorRed "" SWORD NO_COMPU_METHOD 1 100 -32768 32767 ECU_ADDRESS 0x240002ce /end MEASUREMENT
/begin MEASUREMENT DEBUGOUT_HMI_ISB_RL1_GroupOrModule "" SWORD NO_COMPU_METHOD 1 100 -32768 32767 ECU_ADDRESS 0x240002e6 /end MEASUREMENT
/begin MEASUREMENT DEBUGOUT_HMI_ISB_RL1_Intensity "" SWORD NO_COMPU_METHOD 1 100 -32768 32767 ECU_ADDRESS 0x240002d4 /end MEASUREMENT
/begin MEASUREMENT DEBUGOUT_HMI_ISB_RL1_Normalization "" SWORD NO_COMPU_METHOD 1 100 -32768 32767 ECU_ADDRESS 0x240002da /end MEASUREMENT
/begin MEASUREMENT DEBUGOUT_HMI_ISB_RL1_Rx_Status "" SWORD NO_COMPU_METHOD 1 100 -32768 32767 ECU_ADDRESS 0x240002bc /end MEASUREMENT
/begin MEASUREMENT DEBUGOUT_HMI_ISB_RL1_Transitionspeed "" SWORD NO_COMPU_METHOD 1 100 -32768 32767 ECU_ADDRESS 0x240002e0 /end MEASUREMENT
/begin MEASUREMENT DEBUGOUT_HMI_ISB_RL2_AddressByte0 "" SWORD NO_COMPU_METHOD 1 100 -32768 32767 ECU_ADDRESS 0x24000328 /end MEASUREMENT
/begin MEASUREMENT DEBUGOUT_HMI_ISB_RL2_AddressByte1 "" SWORD NO_COMPU_METHOD 1 100 -32768 32767 ECU_ADDRESS 0x2400032e /end MEASUREMENT
/begin MEASUREMENT DEBUGOUT_HMI_ISB_RL2_ColorBlue "" SWORD NO_COMPU_METHOD 1 100 -32768 32767 ECU_ADDRESS 0x24000304 /end MEASUREMENT
/begin MEASUREMENT DEBUGOUT_HMI_ISB_RL2_ColorGreen "" SWORD NO_COMPU_METHOD 1 100 -32768 32767 ECU_ADDRESS 0x240002fe /end MEASUREMENT
/begin MEASUREMENT DEBUGOUT_HMI_ISB_RL2_ColorRed "" SWORD NO_COMPU_METHOD 1 100 -32768 32767 ECU_ADDRESS 0x2400030a /end MEASUREMENT
/begin MEASUREMENT DEBUGOUT_HMI_ISB_RL2_GroupOrModule "" SWORD NO_COMPU_METHOD 1 100 -32768 32767 ECU_ADDRESS 0x24000322 /end MEASUREMENT
/begin MEASUREMENT DEBUGOUT_HMI_ISB_RL2_Intensity "" SWORD NO_COMPU_METHOD 1 100 -32768 32767 ECU_ADDRESS 0x24000310 /end MEASUREMENT
/begin MEASUREMENT DEBUGOUT_HMI_ISB_RL2_Normalization "" SWORD NO_COMPU_METHOD 1 100 -32768 32767 ECU_ADDRESS 0x24000316 /end MEASUREMENT
/begin MEASUREMENT DEBUGOUT_HMI_ISB_RL2_Rx_Status "" SWORD NO_COMPU_METHOD 1 100 -32768 32767 ECU_ADDRESS 0x240002f8 /end MEASUREMENT
/begin MEASUREMENT DEBUGOUT_HMI_ISB_RL2_Transitionspeed "" SWORD NO_COMPU_METHOD 1 100 -32768 32767 ECU_ADDRESS 0x2400031c /end MEASUREMENT
/begin MEASUREMENT DEBUGOUT_HMI_ISB_RR1_AddressByte0 "" SWORD NO_COMPU_METHOD 1 100 -32768 32767 ECU_ADDRESS 0x24000364 /end MEASUREMENT
/begin MEASUREMENT DEBUGOUT_HMI_ISB_RR1_AddressByte1 "" SWORD NO_COMPU_METHOD 1 100 -32768 32767 ECU_ADDRESS 0x2400036a /end MEASUREMENT
/begin MEASUREMENT DEBUGOUT_HMI_ISB_RR1_ColorBlue "" SWORD NO_COMPU_METHOD 1 100 -32768 32767 ECU_ADDRESS 0x24000340 /end MEASUREMENT
/begin MEASUREMENT DEBUGOUT_HMI_ISB_RR1_ColorGreen "" SWORD NO_COMPU_METHOD 1 100 -32768 32767 ECU_ADDRESS 0x2400033a /end MEASUREMENT
/begin MEASUREMENT DEBUGOUT_HMI_ISB_RR1_ColorRed "" SWORD NO_COMPU_METHOD 1 100 -32768 32767 ECU_ADDRESS 0x24000346 /end MEASUREMENT
/begin MEASUREMENT DEBUGOUT_HMI_ISB_RR1_GroupOrModule "" SWORD NO_COMPU_METHOD 1 100 -32768 32767 ECU_ADDRESS 0x2400035e /end MEASUREMENT
/begin MEASUREMENT DEBUGOUT_HMI_ISB_RR1_Intensity "" SWORD NO_COMPU_METHOD 1 100 -32768 32767 ECU_ADDRESS 0x2400034c /end MEASUREMENT
/begin MEASUREMENT DEBUGOUT_HMI_ISB_RR1_Normalization "" SWORD NO_COMPU_METHOD 1 100 -32768 32767 ECU_ADDRESS 0x24000352 /end MEASUREMENT
/begin MEASUREMENT DEBUGOUT_HMI_ISB_RR1_Rx_Status "" SWORD NO_COMPU_METHOD 1 100 -32768 32767 ECU_ADDRESS 0x24000334 /end MEASUREMENT
/begin MEASUREMENT DEBUGOUT_HMI_ISB_RR1_Transitionspeed "" SWORD NO_COMPU_METHOD 1 100 -32768 32767 ECU_ADDRESS 0x24000358 /end MEASUREMENT
/begin MEASUREMENT DEBUGOUT_HMI_SEAL_ActivationRequest "" SWORD NO_COMPU_METHOD 1 100 -32768 32767 ECU_ADDRESS 0x24000370 /end MEASUREMENT
/begin MEASUREMENT DEBUGOUT_OMS_FL_HandsOnWheel "" SWORD NO_COMPU_METHOD 1 100 -32768 32767 ECU_ADDRESS 0x24000394 /end MEASUREMENT
/begin MEASUREMENT DEBUGOUT_OMS_FL_OccupantClassification "" SWORD NO_COMPU_METHOD 1 100 -32768 32767 ECU_ADDRESS 0x2400039a /end MEASUREMENT
/begin MEASUREMENT DEBUGOUT_OMS_FL_OccupantHeightMean_cm "" SWORD NO_COMPU_METHOD 1 100 -32768 32767 ECU_ADDRESS 0x24000436 /end MEASUREMENT
/begin MEASUREMENT DEBUGOUT_OMS_FL_OccupantHeightStd_cm "" SWORD NO_COMPU_METHOD 1 100 -32768 32767 ECU_ADDRESS 0x24000430 /end MEASUREMENT
/begin MEASUREMENT DEBUGOUT_OMS_FL_OccupantPresence "" SWORD NO_COMPU_METHOD 1 100 -32768 32767 ECU_ADDRESS 0x240003b8 /end MEASUREMENT
/begin MEASUREMENT DEBUGOUT_OMS_FL_OccupantWeightMean_kg "" SWORD NO_COMPU_METHOD 1 100 -32768 32767 ECU_ADDRESS 0x240003fa /end MEASUREMENT
/begin MEASUREMENT DEBUGOUT_OMS_FL_OccupantWeightStd_kg "" SWORD NO_COMPU_METHOD 1 100 -32768 32767 ECU_ADDRESS 0x240003f4 /end MEASUREMENT
/begin MEASUREMENT DEBUGOUT_OMS_FL_OutOfPosition "" SWORD NO_COMPU_METHOD 1 100 -32768 32767 ECU_ADDRESS 0x240003d6 /end MEASUREMENT
/begin MEASUREMENT DEBUGOUT_OMS_FL_Rx_Status "" SWORD NO_COMPU_METHOD 1 100 -32768 32767 ECU_ADDRESS 0x24000376 /end MEASUREMENT
/begin MEASUREMENT DEBUGOUT_OMS_FR_OccupantClassification "" SWORD NO_COMPU_METHOD 1 100 -32768 32767 ECU_ADDRESS 0x240003a0 /end MEASUREMENT
/begin MEASUREMENT DEBUGOUT_OMS_FR_OccupantHeightMean_cm "" SWORD NO_COMPU_METHOD 1 100 -32768 32767 ECU_ADDRESS 0x24000442 /end MEASUREMENT
/begin MEASUREMENT DEBUGOUT_OMS_FR_OccupantHeightStd_cm "" SWORD NO_COMPU_METHOD 1 100 -32768 32767 ECU_ADDRESS 0x2400043c /end MEASUREMENT
/begin MEASUREMENT DEBUGOUT_OMS_FR_OccupantPresence "" SWORD NO_COMPU_METHOD 1 100 -32768 32767 ECU_ADDRESS 0x240003be /end MEASUREMENT
/begin MEASUREMENT DEBUGOUT_OMS_FR_OccupantWeightMean_kg "" SWORD NO_COMPU_METHOD 1 100 -32768 32767 ECU_ADDRESS 0x24000406 /end MEASUREMENT
/begin MEASUREMENT DEBUGOUT_OMS_FR_OccupantWeightStd_kg "" SWORD NO_COMPU_METHOD 1 100 -32768 32767 ECU_ADDRESS 0x24000400 /end MEASUREMENT
/begin MEASUREMENT DEBUGOUT_OMS_FR_OutOfPosition "" SWORD NO_COMPU_METHOD 1 100 -32768 32767 ECU_ADDRESS 0x240003dc /end MEASUREMENT
/begin MEASUREMENT DEBUGOUT_OMS_FR_Rx_Status "" SWORD NO_COMPU_METHOD 1 100 -32768 32767 ECU_ADDRESS 0x2400037c /end MEASUREMENT
/begin MEASUREMENT DEBUGOUT_OMS_RL1_OccupantClassification "" SWORD NO_COMPU_METHOD 1 100 -32768 32767 ECU_ADDRESS 0x240003a6 /end MEASUREMENT
/begin MEASUREMENT DEBUGOUT_OMS_RL1_OccupantHeightMean_cm "" SWORD NO_COMPU_METHOD 1 100 -32768 32767 ECU_ADDRESS 0x2400044e /end MEASUREMENT
/begin MEASUREMENT DEBUGOUT_OMS_RL1_OccupantHeightStd_cm "" SWORD NO_COMPU_METHOD 1 100 -32768 32767 ECU_ADDRESS 0x24000448 /end MEASUREMENT
/begin MEASUREMENT DEBUGOUT_OMS_RL1_OccupantPresence "" SWORD NO_COMPU_METHOD 1 100 -32768 32767 ECU_ADDRESS 0x240003c4 /end MEASUREMENT
/begin MEASUREMENT DEBUGOUT_OMS_RL1_OccupantWeightMean_kg "" SWORD NO_COMPU_METHOD 1 100 -32768 32767 ECU_ADDRESS 0x24000412 /end MEASUREMENT
/begin MEASUREMENT DEBUGOUT_OMS_RL1_OccupantWeightStd_kg "" SWORD NO_COMPU_METHOD 1 100 -32768 32767 ECU_ADDRESS 0x2400040c /end MEASUREMENT
/begin MEASUREMENT DEBUGOUT_OMS_RL1_OutOfPosition "" SWORD NO_COMPU_METHOD 1 100 -32768 32767 ECU_ADDRESS 0x240003e2 /end MEASUREMENT
/begin MEASUREMENT DEBUGOUT_OMS_RL1_Rx_Status "" SWORD NO_COMPU_METHOD 1 100 -32768 32767 ECU_ADDRESS 0x24000382 /end MEASUREMENT
/begin MEASUREMENT DEBUGOUT_OMS_RL2_OccupantClassification "" SWORD NO_COMPU_METHOD 1 100 -32768 32767 ECU_ADDRESS 0x240003ac /end MEASUREMENT
/begin MEASUREMENT DEBUGOUT_OMS_RL2_OccupantHeightMean_cm "" SWORD NO_COMPU_METHOD 1 100 -32768 32767 ECU_ADDRESS 0x2400045a /end MEASUREMENT
/begin MEASUREMENT DEBUGOUT_OMS_RL2_OccupantHeightStd_cm "" SWORD NO_COMPU_METHOD 1 100 -32768 32767 ECU_ADDRESS 0x24000454 /end MEASUREMENT
/begin MEASUREMENT DEBUGOUT_OMS_RL2_OccupantPresence "" SWORD NO_COMPU_METHOD 1 100 -32768 32767 ECU_ADDRESS 0x240003ca /end MEASUREMENT
/begin MEASUREMENT DEBUGOUT_OMS_RL2_OccupantWeightMean_kg "" SWORD NO_COMPU_METHOD 1 100 -32768 32767 ECU_ADDRESS 0x2400041e /end MEASUREMENT
/begin MEASUREMENT DEBUGOUT_OMS_RL2_OccupantWeightStd_kg "" SWORD NO_COMPU_METHOD 1 100 -32768 32767 ECU_ADDRESS 0x24000418 /end MEASUREMENT
/begin MEASUREMENT DEBUGOUT_OMS_RL2_OutOfPosition "" SWORD NO_COMPU_METHOD 1 100 -32768 32767 ECU_ADDRESS 0x240003e8 /end MEASUREMENT
/begin MEASUREMENT DEBUGOUT_OMS_RL2_Rx_Status "" SWORD NO_COMPU_METHOD 1 100 -32768 32767 ECU_ADDRESS 0x24000388 /end MEASUREMENT
/begin MEASUREMENT DEBUGOUT_OMS_RR1_OccupantClassification "" SWORD NO_COMPU_METHOD 1 100 -32768 32767 ECU_ADDRESS 0x240003b2 /end MEASUREMENT
/begin MEASUREMENT DEBUGOUT_OMS_RR1_OccupantHeightMean_cm "" SWORD NO_COMPU_METHOD 1 100 -32768 32767 ECU_ADDRESS 0x24000466 /end MEASUREMENT
/begin MEASUREMENT DEBUGOUT_OMS_RR1_OccupantHeightStd_cm "" SWORD NO_COMPU_METHOD 1 100 -32768 32767 ECU_ADDRESS 0x24000460 /end MEASUREMENT
/begin MEASUREMENT DEBUGOUT_OMS_RR1_OccupantPresence "" SWORD NO_COMPU_METHOD 1 100 -32768 32767 ECU_ADDRESS 0x240003d0 /end MEASUREMENT
/begin MEASUREMENT DEBUGOUT_OMS_RR1_OccupantWeightMean_kg "" SWORD NO_COMPU_METHOD 1 100 -32768 32767 ECU_ADDRESS 0x2400042a /end MEASUREMENT
/begin MEASUREMENT DEBUGOUT_OMS_RR1_OccupantWeightStd_kg "" SWORD NO_COMPU_METHOD 1 100 -32768 32767 ECU_ADDRESS 0x24000424 /end MEASUREMENT
/begin MEASUREMENT DEBUGOUT_OMS_RR1_OutOfPosition "" SWORD NO_COMPU_METHOD 1 100 -32768 32767 ECU_ADDRESS 0x240003ee /end MEASUREMENT
/begin MEASUREMENT DEBUGOUT_OMS_RR1_Rx_Status "" SWORD NO_COMPU_METHOD 1 100 -32768 32767 ECU_ADDRESS 0x2400038e /end MEASUREMENT
/begin MEASUREMENT DEBUGOUT_Release_Kugel_stabil_Invert "" UBYTE NO_COMPU_METHOD 1 100 0 1 ECU_ADDRESS 0x24016185 /end MEASUREMENT
/begin MEASUREMENT DEBUGOUT_Release_Stable_Invert "" UBYTE NO_COMPU_METHOD 1 100 0 1 ECU_ADDRESS 0x2401617e /end MEASUREMENT
/begin MEASUREMENT DEBUGOUT_Release_task_Stable_Bitfield "" UBYTE NO_COMPU_METHOD 1 100 0 255 ECU_ADDRESS 0x24016178 /end MEASUREMENT
/begin MEASUREMENT DEBUGOUT_RLS_DG_Cons_Req_BRK_f "" UBYTE NO_COMPU_METHOD 1 100 0 1 ECU_ADDRESS 0x24016193 /end MEASUREMENT
/begin MEASUREMENT DEBUGOUT_RLS_DG_Cons_Req_CD_f "" UBYTE NO_COMPU_METHOD 1 100 0 1 ECU_ADDRESS 0x24016192 /end MEASUREMENT
/begin MEASUREMENT DEBUGOUT_RLS_DG_Cons_Req_HPW_f "" UBYTE NO_COMPU_METHOD 1 100 0 1 ECU_ADDRESS 0x24016191 /end MEASUREMENT
/begin MEASUREMENT DEBUGOUT_RLS_DG_No_Request_f "" UBYTE NO_COMPU_METHOD 1 100 0 1 ECU_ADDRESS 0x24016190 /end MEASUREMENT
/begin MEASUREMENT DEBUGOUT_RLS_DG_Request_Timer_run "" UBYTE NO_COMPU_METHOD 1 100 0 1 ECU_ADDRESS 0x24026bb1 /end MEASUREMENT
/begin MEASUREMENT DEBUGOUT_RLS_DG_Request_Timer_set_f "" UBYTE NO_COMPU_METHOD 1 100 0 1 ECU_ADDRESS 0x2401618f /end MEASUREMENT
/begin MEASUREMENT DEBUGOUT_RLS_VSMA_Request_f "" UBYTE NO_COMPU_METHOD 1 100 0 1 ECU_ADDRESS 0x2401618e /end MEASUREMENT
/begin MEASUREMENT DS_AY_LimitExceeds "" UBYTE NO_COMPU_METHOD 1 100 0 1 ECU_ADDRESS 0x24026bc4 /end MEASUREMENT
/begin MEASUREMENT DS_ayLimit_Calculated "" UWORD EQ_LSB_0_002_b 1 100 0 131.07 ECU_ADDRESS 0x24026bec /end MEASUREMENT
/begin MEASUREMENT DS_ayLimit_Release_Calculated "" SWORD EQ_LSB_0_002 1 100 -65.536 65.534 ECU_ADDRESS 0x24026d14 /end MEASUREMENT
/begin MEASUREMENT DynamicSupport_Request_bitfield "" UWORD NO_COMPU_METHOD 1 100 0 65535 ECU_ADDRESS 0x24026ce2 /end MEASUREMENT
/begin MEASUREMENT ELK_WriteErrorCounter_RL1_Int16 "" SWORD NO_COMPU_METHOD 1 100 -32768 32767 ECU_ADDRESS 0x24026c5c /end MEASUREMENT
/begin MEASUREMENT ELK_WriteErrorCounter_RL2_Int16 "" SWORD NO_COMPU_METHOD 1 100 -32768 32767 ECU_ADDRESS 0x24026d30 /end MEASUREMENT
/begin MEASUREMENT ELK_WriteErrorCounter_RR1_Int16 "" SWORD NO_COMPU_METHOD 1 100 -32768 32767 ECU_ADDRESS 0x24026cc2 /end MEASUREMENT
/begin MEASUREMENT ELK_WriteMemotyRequest_RL1_bool "" SWORD NO_COMPU_METHOD 1 100 -32768 32767 ECU_ADDRESS 0x24026cac /end MEASUREMENT
/begin MEASUREMENT ELK_WriteMemotyRequest_RL2_bool "" SWORD NO_COMPU_METHOD 1 100 -32768 32767 ECU_ADDRESS 0x24026bd2 /end MEASUREMENT
/begin MEASUREMENT ELK_WriteMemotyRequest_RR1_bool "" SWORD NO_COMPU_METHOD 1 100 -32768 32767 ECU_ADDRESS 0x24026bfc /end MEASUREMENT
/begin MEASUREMENT ISB_FunctionLogic_FL_Debug_ISB_BuckleSignal "" UBYTE NO_COMPU_METHOD 1 100 0 1 ECU_ADDRESS 0x24026d49 /end MEASUREMENT
/begin MEASUREMENT ISB_FunctionLogic_FL_Debug_ISB_Colour "" UBYTE NO_COMPU_METHOD 1 100 0 255 ECU_ADDRESS 0x24026cf4 /end MEASUREMENT
/begin MEASUREMENT ISB_FunctionLogic_FL_Debug_ISB_OtherOpenDoor "" UBYTE NO_COMPU_METHOD 1 100 0 1 ECU_ADDRESS 0x24026bfa /end MEASUREMENT
/begin MEASUREMENT ISB_FunctionLogic_FL_Debug_ISB_StateControl "" UBYTE NO_COMPU_METHOD 1 100 0 255 ECU_ADDRESS 0x24026d48 /end MEASUREMENT
/begin MEASUREMENT ISB_FunctionLogic_FL_Debug_ISB_TransitionSpeed "" UBYTE NO_COMPU_METHOD 1 100 0 255 ECU_ADDRESS 0x24026c66 /end MEASUREMENT
/begin MEASUREMENT ISB_FunctionLogic_FL_Debug_Open_Door "" UBYTE NO_COMPU_METHOD 1 100 0 1 ECU_ADDRESS 0x24026d29 /end MEASUREMENT
/begin MEASUREMENT ISB_FunctionLogic_FL_Debug_PARAM_BlinkOnBuckleBeginDrive_ms "" UBYTE NO_COMPU_METHOD 1 100 0 255 ECU_ADDRESS 0x24026d2a /end MEASUREMENT
/begin MEASUREMENT ISB_FunctionLogic_FR_Debug_ISB_BuckleSignal "" UBYTE NO_COMPU_METHOD 1 100 0 1 ECU_ADDRESS 0x24026d32 /end MEASUREMENT
/begin MEASUREMENT ISB_FunctionLogic_FR_Debug_ISB_Colour "" UBYTE NO_COMPU_METHOD 1 100 0 255 ECU_ADDRESS 0x24026d61 /end MEASUREMENT
/begin MEASUREMENT ISB_FunctionLogic_FR_Debug_ISB_OtherOpenDoor "" UBYTE NO_COMPU_METHOD 1 100 0 1 ECU_ADDRESS 0x24026bb6 /end MEASUREMENT
/begin MEASUREMENT ISB_FunctionLogic_FR_Debug_ISB_StateControl "" UBYTE NO_COMPU_METHOD 1 100 0 255 ECU_ADDRESS 0x24026bf0 /end MEASUREMENT
/begin MEASUREMENT ISB_FunctionLogic_FR_Debug_ISB_TransitionSpeed "" UBYTE NO_COMPU_METHOD 1 100 0 255 ECU_ADDRESS 0x24026bdd /end MEASUREMENT
/begin MEASUREMENT ISB_FunctionLogic_FR_Debug_Open_Door "" UBYTE NO_COMPU_METHOD 1 100 0 1 ECU_ADDRESS 0x24026c1a /end MEASUREMENT
/begin MEASUREMENT ISB_FunctionLogic_FR_Debug_PARAM_BlinkOnBuckleBeginDrive_ms "" UBYTE NO_COMPU_METHOD 1 100 0 255 ECU_ADDRESS 0x24026d54 /end MEASUREMENT
/begin MEASUREMENT ISB_FunctionLogic_RL1_Debug_ISB_BuckleSignal "" UBYTE NO_COMPU_METHOD 1 100 0 1 ECU_ADDRESS 0x24026cfe /end MEASUREMENT
/begin MEASUREMENT ISB_FunctionLogic_RL1_Debug_ISB_Colour "" UBYTE NO_COMPU_METHOD 1 100 0 255 ECU_ADDRESS 0x24026c09 /end MEASUREMENT
/begin MEASUREMENT ISB_FunctionLogic_RL1_Debug_ISB_OtherOpenDoor "" UBYTE NO_COMPU_METHOD 1 100 0 1 ECU_ADDRESS 0x24026d6e /end MEASUREMENT
/begin MEASUREMENT ISB_FunctionLogic_RL1_Debug_ISB_StateControl "" UBYTE NO_COMPU_METHOD 1 100 0 255 ECU_ADDRESS 0x24026cd4 /end MEASUREMENT
/begin MEASUREMENT ISB_FunctionLogic_RL1_Debug_ISB_TransitionSpeed "" UBYTE NO_COMPU_METHOD 1 100 0 255 ECU_ADDRESS 0x24026c74 /end MEASUREMENT
/begin MEASUREMENT ISB_FunctionLogic_RL1_Debug_Open_Door "" UBYTE NO_COMPU_METHOD 1 100 0 1 ECU_ADDRESS 0x24026c12 /end MEASUREMENT
/begin MEASUREMENT ISB_FunctionLogic_RL1_Debug_PARAM_BlinkOnBuckleBeginDrive_ms "" UBYTE NO_COMPU_METHOD 1 100 0 255 ECU_ADDRESS 0x24026c9e /end MEASUREMENT
/begin MEASUREMENT ISB_FunctionLogic_RL2_Debug_ISB_BuckleSignal "" UBYTE NO_COMPU_METHOD 1 100 0 1 ECU_ADDRESS 0x24026bf5 /end MEASUREMENT
/begin MEASUREMENT ISB_FunctionLogic_RL2_Debug_ISB_Colour "" UBYTE NO_COMPU_METHOD 1 100 0 255 ECU_ADDRESS 0x24026d28 /end MEASUREMENT
/begin MEASUREMENT ISB_FunctionLogic_RL2_Debug_ISB_OtherOpenDoor "" UBYTE NO_COMPU_METHOD 1 100 0 1 ECU_ADDRESS 0x24026c75 /end MEASUREMENT
/begin MEASUREMENT ISB_FunctionLogic_RL2_Debug_ISB_StateControl "" UBYTE NO_COMPU_METHOD 1 100 0 255 ECU_ADDRESS 0x24026c76 /end MEASUREMENT
/begin MEASUREMENT ISB_FunctionLogic_RL2_Debug_ISB_TransitionSpeed "" UBYTE NO_COMPU_METHOD 1 100 0 255 ECU_ADDRESS 0x24026ccc /end MEASUREMENT
/begin MEASUREMENT ISB_FunctionLogic_RL2_Debug_Open_Door "" UBYTE NO_COMPU_METHOD 1 100 0 1 ECU_ADDRESS 0x24026c6a /end MEASUREMENT
/begin MEASUREMENT ISB_FunctionLogic_RL2_Debug_PARAM_BlinkOnBuckleBeginDrive_ms "" UBYTE NO_COMPU_METHOD 1 100 0 255 ECU_ADDRESS 0x24026c8a /end MEASUREMENT
/begin MEASUREMENT ISB_FunctionLogic_RR1_Debug_ISB_BuckleSignal "" UBYTE NO_COMPU_METHOD 1 100 0 1 ECU_ADDRESS 0x24026d0c /end MEASUREMENT
/begin MEASUREMENT ISB_FunctionLogic_RR1_Debug_ISB_Colour "" UBYTE NO_COMPU_METHOD 1 100 0 255 ECU_ADDRESS 0x24026bb2 /end MEASUREMENT
/begin MEASUREMENT ISB_FunctionLogic_RR1_Debug_ISB_OtherOpenDoor "" UBYTE NO_COMPU_METHOD 1 100 0 1 ECU_ADDRESS 0x24026cff /end MEASUREMENT
/begin MEASUREMENT ISB_FunctionLogic_RR1_Debug_ISB_StateControl "" UBYTE NO_COMPU_METHOD 1 100 0 255 ECU_ADDRESS 0x24026bef /end MEASUREMENT
/begin MEASUREMENT ISB_FunctionLogic_RR1_Debug_ISB_TransitionSpeed "" UBYTE NO_COMPU_METHOD 1 100 0 255 ECU_ADDRESS 0x24026d7c /end MEASUREMENT
/begin MEASUREMENT ISB_FunctionLogic_RR1_Debug_Open_Door "" UBYTE NO_COMPU_METHOD 1 100 0 1 ECU_ADDRESS 0x24026d55 /end MEASUREMENT
/begin MEASUREMENT ISB_FunctionLogic_RR1_Debug_PARAM_BlinkOnBuckleBeginDrive_ms "" UBYTE NO_COMPU_METHOD 1 100 0 255 ECU_ADDRESS 0x24026c82 /end MEASUREMENT
/begin MEASUREMENT panther_can1_in.asw_in_can1_0x20_VCLASS_CentrLockSys_Status "CAN1 receive signal 15" UBYTE NO_COMPU_METHOD 1 100 0 4 ECU_ADDRESS 0x24026fa4 SYMBOL_LINK "panther_can1_in" 64 /end MEASUREMENT
/begin MEASUREMENT panther_can1_in.asw_in_can1_0x20_VCLASS_FL_DoorHndlStatus "CAN1 receive signal 5" UBYTE NO_COMPU_METHOD 1 100 0 1 ECU_ADDRESS 0x24026f9a SYMBOL_LINK "panther_can1_in" 54 /end MEASUREMENT
/begin MEASUREMENT panther_can1_in.asw_in_can1_0x20_VCLASS_FR_DoorHndlStatus "CAN1 receive signal 6" UBYTE NO_COMPU_METHOD 1 100 0 1 ECU_ADDRESS 0x24026f9b SYMBOL_LINK "panther_can1_in" 55 /end MEASUREMENT
/begin MEASUREMENT panther_can1_in.asw_in_can1_0x20_VCLASS_Lt_BlindSpWarn_on "CAN1 receive signal 13" UBYTE NO_COMPU_METHOD 1 100 0 2 ECU_ADDRESS 0x24026fa2 SYMBOL_LINK "panther_can1_in" 62 /end MEASUREMENT
/begin MEASUREMENT panther_can1_in.asw_in_can1_0x20_VCLASS_Lt_TurnIndicator_on "CAN1 receive signal 9" UBYTE NO_COMPU_METHOD 1 100 0 1 ECU_ADDRESS 0x24026f9e SYMBOL_LINK "panther_can1_in" 58 /end MEASUREMENT
/begin MEASUREMENT panther_can1_in.asw_in_can1_0x20_VCLASS_RL_DoorHndlStatus "CAN1 receive signal 7" UBYTE NO_COMPU_METHOD 1 100 0 1 ECU_ADDRESS 0x24026f9c SYMBOL_LINK "panther_can1_in" 56 /end MEASUREMENT
/begin MEASUREMENT panther_can1_in.asw_in_can1_0x20_VCLASS_RR_DoorHndlStatus "CAN1 receive signal 8" UBYTE NO_COMPU_METHOD 1 100 0 1 ECU_ADDRESS 0x24026f9d SYMBOL_LINK "panther_can1_in" 57 /end MEASUREMENT
/begin MEASUREMENT panther_can1_in.asw_in_can1_0x20_VCLASS_Rt_BlindSpWarn_on "CAN1 receive signal 14" UBYTE NO_COMPU_METHOD 1 100 0 2 ECU_ADDRESS 0x24026fa3 SYMBOL_LINK "panther_can1_in" 63 /end MEASUREMENT
/begin MEASUREMENT panther_can1_in.asw_in_can1_0x20_VCLASS_Rt_TurnIndicator_on "CAN1 receive signal 10" UBYTE NO_COMPU_METHOD 1 100 0 1 ECU_ADDRESS 0x24026f9f SYMBOL_LINK "panther_can1_in" 59 /end MEASUREMENT
/begin MEASUREMENT panther_can2_in.asw_in_can2_0x188_ACR_FL_ActivationLevelStatus "CAN2 receive signal 1" UBYTE NO_COMPU_METHOD 1 100 0 255 ECU_ADDRESS 0x24027018 SYMBOL_LINK "panther_can2_in" 48 /end MEASUREMENT
/begin MEASUREMENT panther_can2_in.asw_in_can2_0x188_ACR_FL_ActivationPhase "CAN2 receive signal 2" UBYTE NO_COMPU_METHOD 1 100 0 255 ECU_ADDRESS 0x24027019 SYMBOL_LINK "panther_can2_in" 49 /end MEASUREMENT
/begin MEASUREMENT panther_can2_in.asw_in_can2_0x189_ACR_FR_ActivationLevelStatus "CAN2 receive signal 1" UBYTE NO_COMPU_METHOD 1 100 0 255 ECU_ADDRESS 0x24027014 SYMBOL_LINK "panther_can2_in" 44 /end MEASUREMENT
/begin MEASUREMENT panther_can2_in.asw_in_can2_0x189_ACR_FR_ActivationPhase "CAN2 receive signal 2" UBYTE NO_COMPU_METHOD 1 100 0 255 ECU_ADDRESS 0x24027015 SYMBOL_LINK "panther_can2_in" 45 /end MEASUREMENT
/begin MEASUREMENT panther_can2_in.asw_in_can2_0x18A_ACR_RL1_ActivationLevelStatus "CAN2 receive signal 1" UBYTE NO_COMPU_METHOD 1 100 0 255 ECU_ADDRESS 0x24027010 SYMBOL_LINK "panther_can2_in" 40 /end MEASUREMENT
/begin MEASUREMENT panther_can2_in.asw_in_can2_0x18A_ACR_RL1_ActivationPhase "CAN2 receive signal 2" UBYTE NO_COMPU_METHOD 1 100 0 255 ECU_ADDRESS 0x24027011 SYMBOL_LINK "panther_can2_in" 41 /end MEASUREMENT
/begin MEASUREMENT panther_can2_in.asw_in_can2_0x18B_ACR_RL2_ActivationLevelStatus "CAN2 receive signal 1" UBYTE NO_COMPU_METHOD 1 100 0 255 ECU_ADDRESS 0x2402700c SYMBOL_LINK "panther_can2_in" 36 /end MEASUREMENT
/begin MEASUREMENT panther_can2_in.asw_in_can2_0x18B_ACR_RL2_ActivationPhase "CAN2 receive signal 2" UBYTE NO_COMPU_METHOD 1 100 0 255 ECU_ADDRESS 0x2402700d SYMBOL_LINK "panther_can2_in" 37 /end MEASUREMENT
/begin MEASUREMENT panther_can2_in.asw_in_can2_0x18C_ACR_RR1_ActivationLevelStatus "CAN2 receive signal 1" UBYTE NO_COMPU_METHOD 1 100 0 255 ECU_ADDRESS 0x24027008 SYMBOL_LINK "panther_can2_in" 32 /end MEASUREMENT
/begin MEASUREMENT panther_can2_in.asw_in_can2_0x18C_ACR_RR1_ActivationPhase "CAN2 receive signal 2" UBYTE NO_COMPU_METHOD 1 100 0 255 ECU_ADDRESS 0x24027009 SYMBOL_LINK "panther_can2_in" 33 /end MEASUREMENT
/begin MEASUREMENT panther_can2_in.asw_in_can2_0x190_WMS_FL_SensorStatus_bool "CAN2 receive signal 3" UBYTE NO_COMPU_METHOD 1 100 0 7 ECU_ADDRESS 0x24027006 SYMBOL_LINK "panther_can2_in" 30 /end MEASUREMENT
/begin MEASUREMENT panther_can2_in.asw_in_can2_0x190_WMS_FL_SpoolAngle_deg "CAN2 receive signal 2" UWORD NO_COMPU_METHOD 1 100 0 16383 ECU_ADDRESS 0x24027004 SYMBOL_LINK "panther_can2_in" 28 /end MEASUREMENT
/begin MEASUREMENT panther_can2_in.asw_in_can2_0x190_WMS_FL_WebbingMovement "CAN2 receive signal 1" UWORD NO_COMPU_METHOD 1 100 0 8191 ECU_ADDRESS 0x24027002 SYMBOL_LINK "panther_can2_in" 26 /end MEASUREMENT
/begin MEASUREMENT panther_can2_in.asw_in_can2_0x191_WMS_FR_SensorStatus "CAN2 receive signal 3" UBYTE NO_COMPU_METHOD 1 100 0 7 ECU_ADDRESS 0x24027000 SYMBOL_LINK "panther_can2_in" 24 /end MEASUREMENT
/begin MEASUREMENT panther_can2_in.asw_in_can2_0x191_WMS_FR_SpoolAngle "CAN2 receive signal 2" UWORD NO_COMPU_METHOD 1 100 0 16383 ECU_ADDRESS 0x24026ffe SYMBOL_LINK "panther_can2_in" 22 /end MEASUREMENT
/begin MEASUREMENT panther_can2_in.asw_in_can2_0x191_WMS_FR_WebbingMovement "CAN2 receive signal 1" UWORD NO_COMPU_METHOD 1 100 0 8191 ECU_ADDRESS 0x24026ffc SYMBOL_LINK "panther_can2_in" 20 /end MEASUREMENT
/begin MEASUREMENT panther_can2_in.asw_in_can2_0x192_WMS_RL1_SensorStatus "CAN2 receive signal 3" UBYTE NO_COMPU_METHOD 1 100 0 7 ECU_ADDRESS 0x24026ffa SYMBOL_LINK "panther_can2_in" 18 /end MEASUREMENT
/begin MEASUREMENT panther_can2_in.asw_in_can2_0x192_WMS_RL1_SpoolAngle "CAN2 receive signal 2" UWORD NO_COMPU_METHOD 1 100 0 16383 ECU_ADDRESS 0x24026ff8 SYMBOL_LINK "panther_can2_in" 16 /end MEASUREMENT
/begin MEASUREMENT panther_can2_in.asw_in_can2_0x192_WMS_RL1_WebbingMovement "CAN2 receive signal 1" UWORD NO_COMPU_METHOD 1 100 0 8191 ECU_ADDRESS 0x24026ff6 SYMBOL_LINK "panther_can2_in" 14 /end MEASUREMENT
/begin MEASUREMENT panther_can2_in.asw_in_can2_0x193_WMS_RL2_SensorStatus "CAN2 receive signal 3" UBYTE NO_COMPU_METHOD 1 100 0 7 ECU_ADDRESS 0x24026ff4 SYMBOL_LINK "panther_can2_in" 12 /end MEASUREMENT
/begin MEASUREMENT panther_can2_in.asw_in_can2_0x193_WMS_RL2_SpoolAngle "CAN2 receive signal 2" UWORD NO_COMPU_METHOD 1 100 0 16383 ECU_ADDRESS 0x24026ff2 SYMBOL_LINK "panther_can2_in" 10 /end MEASUREMENT
/begin MEASUREMENT panther_can2_in.asw_in_can2_0x193_WMS_RL2_WebbingMovement "CAN2 receive signal 1" UWORD NO_COMPU_METHOD 1 100 0 8191 ECU_ADDRESS 0x24026ff0 SYMBOL_LINK "panther_can2_in" 8 /end MEASUREMENT
/begin MEASUREMENT panther_can2_in.asw_in_can2_0x194_WMS_RR1_SensorStatus "CAN2 receive signal 3" UBYTE NO_COMPU_METHOD 1 100 0 7 ECU_ADDRESS 0x24026fee SYMBOL_LINK "panther_can2_in" 6 /end MEASUREMENT
/begin MEASUREMENT panther_can2_in.asw_in_can2_0x194_WMS_RR1_SpoolAngle "CAN2 receive signal 2" UWORD NO_COMPU_METHOD 1 100 0 16383 ECU_ADDRESS 0x24026fec SYMBOL_LINK "panther_can2_in" 4 /end MEASUREMENT
/begin MEASUREMENT panther_can2_in.asw_in_can2_0x194_WMS_RR1_WebbingMovement "CAN2 receive signal 1" UWORD NO_COMPU_METHOD 1 100 0 8191 ECU_ADDRESS 0x24026fea SYMBOL_LINK "panther_can2_in" 2 /end MEASUREMENT
/begin MEASUREMENT panther_can2_in.asw_in_can2_0x199_BSW_FL_BuckleStatus "CAN2 receive signal 1" UBYTE NO_COMPU_METHOD 1 100 0 1 ECU_ADDRESS 0x24027030 SYMBOL_LINK "panther_can2_in" 72 /end MEASUREMENT
/begin MEASUREMENT panther_can2_in.asw_in_can2_0x199_BSW_FR_BuckleStatus "CAN2 receive signal 2" UBYTE NO_COMPU_METHOD 1 100 0 1 ECU_ADDRESS 0x24027031 SYMBOL_LINK "panther_can2_in" 73 /end MEASUREMENT
/begin MEASUREMENT panther_can2_in.asw_in_can2_0x199_BSW_RL1_BuckleStatus "CAN2 receive signal 3" UBYTE NO_COMPU_METHOD 1 100 0 1 ECU_ADDRESS 0x24027032 SYMBOL_LINK "panther_can2_in" 74 /end MEASUREMENT
/begin MEASUREMENT panther_can2_in.asw_in_can2_0x199_BSW_RL2_BuckleStatus "CAN2 receive signal 4" UBYTE NO_COMPU_METHOD 1 100 0 1 ECU_ADDRESS 0x24027033 SYMBOL_LINK "panther_can2_in" 75 /end MEASUREMENT
/begin MEASUREMENT panther_can2_in.asw_in_can2_0x199_BSW_RR1_BuckleStatus "CAN2 receive signal 5" UBYTE NO_COMPU_METHOD 1 100 0 1 ECU_ADDRESS 0x24027034 SYMBOL_LINK "panther_can2_in" 76 /end MEASUREMENT
/begin MEASUREMENT panther_can2_in.asw_in_can2_0xC1_STS_BDS_FL_DataByte1 "CAN2 receive signal 1" UBYTE NO_COMPU_METHOD 1 100 0 255 ECU_ADDRESS 0x24027037 SYMBOL_LINK "panther_can2_in" 79 /end MEASUREMENT
/begin MEASUREMENT panther_can2_in.asw_in_can2_0xC1_STS_BDS_FL_DataByte2 "CAN2 receive signal 2" UBYTE NO_COMPU_METHOD 1 100 0 255 ECU_ADDRESS 0x24027038 SYMBOL_LINK "panther_can2_in" 80 /end MEASUREMENT
/begin MEASUREMENT panther_can2_in.asw_in_can2_0xC1_STS_BDS_FL_DataByte3 "CAN2 receive signal 3" UBYTE NO_COMPU_METHOD 1 100 0 255 ECU_ADDRESS 0x24027039 SYMBOL_LINK "panther_can2_in" 81 /end MEASUREMENT
/begin MEASUREMENT panther_can2_in.asw_in_can2_0xC1_STS_BDS_FL_DataByte4 "CAN2 receive signal 4" UBYTE NO_COMPU_METHOD 1 100 0 255 ECU_ADDRESS 0x2402703a SYMBOL_LINK "panther_can2_in" 82 /end MEASUREMENT
/begin MEASUREMENT panther_can2_in.asw_in_can2_0xC1_STS_BDS_FL_DataByte5 "CAN2 receive signal 5" UBYTE NO_COMPU_METHOD 1 100 0 255 ECU_ADDRESS 0x2402703b SYMBOL_LINK "panther_can2_in" 83 /end MEASUREMENT
/begin MEASUREMENT panther_can2_in.asw_in_can2_0xC1_STS_BDS_FL_DataByte6 "CAN2 receive signal 6" UBYTE NO_COMPU_METHOD 1 100 0 255 ECU_ADDRESS 0x2402703c SYMBOL_LINK "panther_can2_in" 84 /end MEASUREMENT
/begin MEASUREMENT panther_can2_in.asw_in_can2_0xC1_STS_BDS_FL_DataByte7 "CAN2 receive signal 7" UBYTE NO_COMPU_METHOD 1 100 0 255 ECU_ADDRESS 0x2402703d SYMBOL_LINK "panther_can2_in" 85 /end MEASUREMENT
/begin MEASUREMENT panther_can2_in.asw_in_can2_0xC1_STS_BDS_FL_DataByte8 "CAN2 receive signal 8" UBYTE NO_COMPU_METHOD 1 100 0 255 ECU_ADDRESS 0x2402703e SYMBOL_LINK "panther_can2_in" 86 /end MEASUREMENT
/begin MEASUREMENT panther_can2_in.asw_in_can2_0xC2_STS_BDS_FL_DataByte10 "CAN2 receive signal 2" UBYTE NO_COMPU_METHOD 1 100 0 255 ECU_ADDRESS 0x24027041 SYMBOL_LINK "panther_can2_in" 89 /end MEASUREMENT
/begin MEASUREMENT panther_can2_in.asw_in_can2_0xC2_STS_BDS_FL_DataByte11 "CAN2 receive signal 3" UBYTE NO_COMPU_METHOD 1 100 0 255 ECU_ADDRESS 0x24027042 SYMBOL_LINK "panther_can2_in" 90 /end MEASUREMENT
/begin MEASUREMENT panther_can2_in.asw_in_can2_0xC2_STS_BDS_FL_DataByte12 "CAN2 receive signal 4" UBYTE NO_COMPU_METHOD 1 100 0 255 ECU_ADDRESS 0x24027043 SYMBOL_LINK "panther_can2_in" 91 /end MEASUREMENT
/begin MEASUREMENT panther_can2_in.asw_in_can2_0xC2_STS_BDS_FL_DataByte13 "CAN2 receive signal 5" UBYTE NO_COMPU_METHOD 1 100 0 255 ECU_ADDRESS 0x24027044 SYMBOL_LINK "panther_can2_in" 92 /end MEASUREMENT
/begin MEASUREMENT panther_can2_in.asw_in_can2_0xC2_STS_BDS_FL_DataByte14 "CAN2 receive signal 6" UBYTE NO_COMPU_METHOD 1 100 0 255 ECU_ADDRESS 0x24027045 SYMBOL_LINK "panther_can2_in" 93 /end MEASUREMENT
/begin MEASUREMENT panther_can2_in.asw_in_can2_0xC2_STS_BDS_FL_DataByte15 "CAN2 receive signal 7" UBYTE NO_COMPU_METHOD 1 100 0 255 ECU_ADDRESS 0x24027046 SYMBOL_LINK "panther_can2_in" 94 /end MEASUREMENT
/begin MEASUREMENT panther_can2_in.asw_in_can2_0xC2_STS_BDS_FL_DataByte16 "CAN2 receive signal 8" UBYTE NO_COMPU_METHOD 1 100 0 255 ECU_ADDRESS 0x24027047 SYMBOL_LINK "panther_can2_in" 95 /end MEASUREMENT
/begin MEASUREMENT panther_can2_in.asw_in_can2_0xC2_STS_BDS_FL_DataByte9 "CAN2 receive signal 1" UBYTE NO_COMPU_METHOD 1 100 0 255 ECU_ADDRESS 0x24027040 SYMBOL_LINK "panther_can2_in" 88 /end MEASUREMENT
/begin MEASUREMENT panther_can2_in.asw_in_can2_0xC3_STS_BDS_FR_DataByte1 "CAN2 receive signal 1" UBYTE NO_COMPU_METHOD 1 100 0 255 ECU_ADDRESS 0x24027049 SYMBOL_LINK "panther_can2_in" 97 /end MEASUREMENT
/begin MEASUREMENT panther_can2_in.asw_in_can2_0xC3_STS_BDS_FR_DataByte2 "CAN2 receive signal 2" UBYTE NO_COMPU_METHOD 1 100 0 255 ECU_ADDRESS 0x2402704a SYMBOL_LINK "panther_can2_in" 98 /end MEASUREMENT
/begin MEASUREMENT panther_can2_in.asw_in_can2_0xC3_STS_BDS_FR_DataByte3 "CAN2 receive signal 3" UBYTE NO_COMPU_METHOD 1 100 0 255 ECU_ADDRESS 0x2402704b SYMBOL_LINK "panther_can2_in" 99 /end MEASUREMENT
/begin MEASUREMENT panther_can2_in.asw_in_can2_0xC3_STS_BDS_FR_DataByte4 "CAN2 receive signal 4" UBYTE NO_COMPU_METHOD 1 100 0 255 ECU_ADDRESS 0x2402704c SYMBOL_LINK "panther_can2_in" 100 /end MEASUREMENT
/begin MEASUREMENT panther_can2_in.asw_in_can2_0xC3_STS_BDS_FR_DataByte5 "CAN2 receive signal 5" UBYTE NO_COMPU_METHOD 1 100 0 255 ECU_ADDRESS 0x2402704d SYMBOL_LINK "panther_can2_in" 101 /end MEASUREMENT
/begin MEASUREMENT panther_can2_in.asw_in_can2_0xC3_STS_BDS_FR_DataByte6 "CAN2 receive signal 6" UBYTE NO_COMPU_METHOD 1 100 0 255 ECU_ADDRESS 0x2402704e SYMBOL_LINK "panther_can2_in" 102 /end MEASUREMENT
/begin MEASUREMENT panther_can2_in.asw_in_can2_0xC3_STS_BDS_FR_DataByte7 "CAN2 receive signal 7" UBYTE NO_COMPU_METHOD 1 100 0 255 ECU_ADDRESS 0x2402704f SYMBOL_LINK "panther_can2_in" 103 /end MEASUREMENT
/begin MEASUREMENT panther_can2_in.asw_in_can2_0xC3_STS_BDS_FR_DataByte8 "CAN2 receive signal 8" UBYTE NO_COMPU_METHOD 1 100 0 255 ECU_ADDRESS 0x24027050 SYMBOL_LINK "panther_can2_in" 104 /end MEASUREMENT
/begin MEASUREMENT panther_can2_in.asw_in_can2_0xC4_STS_BDS_FR_DataByte10 "CAN2 receive signal 2" UBYTE NO_COMPU_METHOD 1 100 0 255 ECU_ADDRESS 0x24027053 SYMBOL_LINK "panther_can2_in" 107 /end MEASUREMENT
/begin MEASUREMENT panther_can2_in.asw_in_can2_0xC4_STS_BDS_FR_DataByte11 "CAN2 receive signal 3" UBYTE NO_COMPU_METHOD 1 100 0 255 ECU_ADDRESS 0x24027054 SYMBOL_LINK "panther_can2_in" 108 /end MEASUREMENT
/begin MEASUREMENT panther_can2_in.asw_in_can2_0xC4_STS_BDS_FR_DataByte12 "CAN2 receive signal 4" UBYTE NO_COMPU_METHOD 1 100 0 255 ECU_ADDRESS 0x24027055 SYMBOL_LINK "panther_can2_in" 109 /end MEASUREMENT
/begin MEASUREMENT panther_can2_in.asw_in_can2_0xC4_STS_BDS_FR_DataByte13 "CAN2 receive signal 5" UBYTE NO_COMPU_METHOD 1 100 0 255 ECU_ADDRESS 0x24027056 SYMBOL_LINK "panther_can2_in" 110 /end MEASUREMENT
/begin MEASUREMENT panther_can2_in.asw_in_can2_0xC4_STS_BDS_FR_DataByte14 "CAN2 receive signal 6" UBYTE NO_COMPU_METHOD 1 100 0 255 ECU_ADDRESS 0x24027057 SYMBOL_LINK "panther_can2_in" 111 /end MEASUREMENT
/begin MEASUREMENT panther_can2_in.asw_in_can2_0xC4_STS_BDS_FR_DataByte15 "CAN2 receive signal 7" UBYTE NO_COMPU_METHOD 1 100 0 255 ECU_ADDRESS 0x24027058 SYMBOL_LINK "panther_can2_in" 112 /end MEASUREMENT
/begin MEASUREMENT panther_can2_in.asw_in_can2_0xC4_STS_BDS_FR_DataByte16 "CAN2 receive signal 8" UBYTE NO_COMPU_METHOD 1 100 0 255 ECU_ADDRESS 0x24027059 SYMBOL_LINK "panther_can2_in" 113 /end MEASUREMENT
/begin MEASUREMENT panther_can2_in.asw_in_can2_0xC4_STS_BDS_FR_DataByte9 "CAN2 receive signal 1" UBYTE NO_COMPU_METHOD 1 100 0 255 ECU_ADDRESS 0x24027052 SYMBOL_LINK "panther_can2_in" 106 /end MEASUREMENT
/begin MEASUREMENT panther_can3_in.asw_in_can3_0x150_Algo_Status_FL "CAN3 receive signal 2" UBYTE NO_COMPU_METHOD 1 100 0 1 ECU_ADDRESS 0x24026f4a SYMBOL_LINK "panther_can3_in" 2 /end MEASUREMENT
/begin MEASUREMENT panther_can3_in.asw_in_can3_0x150_Algo_Status_FR "CAN3 receive signal 7" UBYTE NO_COMPU_METHOD 1 100 0 1 ECU_ADDRESS 0x24026f4f SYMBOL_LINK "panther_can3_in" 7 /end MEASUREMENT
/begin MEASUREMENT panther_can3_in.asw_in_can3_0x150_Algo_Status_RL "CAN3 receive signal 8" UBYTE NO_COMPU_METHOD 1 100 0 1 ECU_ADDRESS 0x24026f50 SYMBOL_LINK "panther_can3_in" 8 /end MEASUREMENT
/begin MEASUREMENT panther_can3_in.asw_in_can3_0x150_Lock_Status_FL "CAN3 receive signal 1" UBYTE NO_COMPU_METHOD 1 100 0 1 ECU_ADDRESS 0x24026f49 SYMBOL_LINK "panther_can3_in" 1 /end MEASUREMENT
/begin MEASUREMENT panther_can3_in.asw_in_can3_0x150_Lock_Status_FR "CAN3 receive signal 4" UBYTE NO_COMPU_METHOD 1 100 0 1 ECU_ADDRESS 0x24026f4c SYMBOL_LINK "panther_can3_in" 4 /end MEASUREMENT
/begin MEASUREMENT panther_can3_in.asw_in_can3_0x150_Lock_Status_RL "CAN3 receive signal 5" UBYTE NO_COMPU_METHOD 1 100 0 1 ECU_ADDRESS 0x24026f4d SYMBOL_LINK "panther_can3_in" 5 /end MEASUREMENT
/begin MEASUREMENT panther_can3_in.asw_in_can3_0x160_ECU_Status_Act_1 "CAN3 receive signal 1" SBYTE NO_COMPU_METHOD 1 100 0 8 ECU_ADDRESS 0x24026f5d SYMBOL_LINK "panther_can3_in" 21 /end MEASUREMENT
/begin MEASUREMENT panther_can3_in.asw_in_can3_0x160_ECU_Status_Act_2 "CAN3 receive signal 2" SBYTE NO_COMPU_METHOD 1 100 0 8 ECU_ADDRESS 0x24026f5e SYMBOL_LINK "panther_can3_in" 22 /end MEASUREMENT
/begin MEASUREMENT panther_can3_in.asw_in_can3_0x160_ECU_Status_Act_3 "CAN3 receive signal 3" SBYTE NO_COMPU_METHOD 1 100 0 8 ECU_ADDRESS 0x24026f5f SYMBOL_LINK "panther_can3_in" 23 /end MEASUREMENT
/begin MEASUREMENT panther_can6_in.asw_in_can6_0x81_HMI_SEAL_ActivationRequest "CAN6 receive signal 1" UBYTE NO_COMPU_METHOD 1 100 0 3 ECU_ADDRESS 0x24026e9c SYMBOL_LINK "panther_can6_in" 132 /end MEASUREMENT
/begin MEASUREMENT panther_can6_in.asw_in_can6_0x90_ABL_FL_RetractRequest "CAN6 receive signal 1" UBYTE NO_COMPU_METHOD 1 100 0 255 ECU_ADDRESS 0x24026e57 SYMBOL_LINK "panther_can6_in" 63 /end MEASUREMENT
/begin MEASUREMENT panther_can6_in.asw_in_can6_0x90_ABL_FR_RetractRequest "CAN6 receive signal 2" UBYTE NO_COMPU_METHOD 1 100 0 255 ECU_ADDRESS 0x24026e58 SYMBOL_LINK "panther_can6_in" 64 /end MEASUREMENT
/begin MEASUREMENT panther_can6_in.asw_in_can6_0x90_rx_status "CAN6 Receive Status" UBYTE NO_COMPU_METHOD 1 100 0 1 ECU_ADDRESS 0x24026e56 SYMBOL_LINK "panther_can6_in" 62 /end MEASUREMENT
/begin MEASUREMENT panther_can6_in.asw_in_can6_0xA2_ISB_RL1_GroupOrModule "CAN6 receive signal 7" UBYTE NO_COMPU_METHOD 1 100 0 1 ECU_ADDRESS 0x24026e33 SYMBOL_LINK "panther_can6_in" 27 /end MEASUREMENT
/begin MEASUREMENT panther_can6_in.asw_in_can6_0xA3_ISB_RL2_AddressByte0 "CAN6 receive signal 8" UBYTE NO_COMPU_METHOD 1 100 0 255 ECU_ADDRESS 0x24026e2a SYMBOL_LINK "panther_can6_in" 18 /end MEASUREMENT
/begin MEASUREMENT panther_can6_in.asw_in_can6_0xA3_ISB_RL2_AddressByte1 "CAN6 receive signal 9" UBYTE NO_COMPU_METHOD 1 100 0 255 ECU_ADDRESS 0x24026e2b SYMBOL_LINK "panther_can6_in" 19 /end MEASUREMENT
/begin MEASUREMENT panther_can6_in.asw_in_can6_0xA3_ISB_RL2_ColorBlue "CAN6 receive signal 2" UBYTE NO_COMPU_METHOD 1 100 0 255 ECU_ADDRESS 0x24026e24 SYMBOL_LINK "panther_can6_in" 12 /end MEASUREMENT
/begin MEASUREMENT panther_can6_in.asw_in_can6_0xA3_ISB_RL2_ColorGreen "CAN6 receive signal 1" UBYTE NO_COMPU_METHOD 1 100 0 255 ECU_ADDRESS 0x24026e23 SYMBOL_LINK "panther_can6_in" 11 /end MEASUREMENT
/begin MEASUREMENT panther_can6_in.asw_in_can6_0xA3_ISB_RL2_ColorRed "CAN6 receive signal 3" UBYTE NO_COMPU_METHOD 1 100 0 255 ECU_ADDRESS 0x24026e25 SYMBOL_LINK "panther_can6_in" 13 /end MEASUREMENT
/begin MEASUREMENT panther_can6_in.asw_in_can6_0xA3_ISB_RL2_GroupOrModule "CAN6 receive signal 7" UBYTE NO_COMPU_METHOD 1 100 0 1 ECU_ADDRESS 0x24026e29 SYMBOL_LINK "panther_can6_in" 17 /end MEASUREMENT
/begin MEASUREMENT panther_can6_in.asw_in_can6_0xA3_ISB_RL2_Intensity "CAN6 receive signal 4" UBYTE NO_COMPU_METHOD 1 100 0 127 ECU_ADDRESS 0x24026e26 SYMBOL_LINK "panther_can6_in" 14 /end MEASUREMENT
/begin MEASUREMENT panther_can6_in.asw_in_can6_0xA3_ISB_RL2_Normalization "CAN6 receive signal 5" UBYTE NO_COMPU_METHOD 1 100 0 1 ECU_ADDRESS 0x24026e27 SYMBOL_LINK "panther_can6_in" 15 /end MEASUREMENT
/begin MEASUREMENT panther_can6_in.asw_in_can6_0xA3_ISB_RL2_Transitionspeed "CAN6 receive signal 6" UBYTE NO_COMPU_METHOD 1 100 0 15 ECU_ADDRESS 0x24026e28 SYMBOL_LINK "panther_can6_in" 16 /end MEASUREMENT
/begin MEASUREMENT panther_can6_in.asw_in_can6_0xA3_rx_status "CAN6 Receive Status" UBYTE NO_COMPU_METHOD 1 100 0 1 ECU_ADDRESS 0x24026e22 SYMBOL_LINK "panther_can6_in" 10 /end MEASUREMENT
/begin MEASUREMENT panther_can6_in.asw_in_can6_0xA4_ISB_RR1_AddressByte0 "CAN6 receive signal 8" UBYTE NO_COMPU_METHOD 1 100 0 255 ECU_ADDRESS 0x24026e20 SYMBOL_LINK "panther_can6_in" 8 /end MEASUREMENT
/begin MEASUREMENT panther_can6_in.asw_in_can6_0xA4_ISB_RR1_AddressByte1 "CAN6 receive signal 9" UBYTE NO_COMPU_METHOD 1 100 0 255 ECU_ADDRESS 0x24026e21 SYMBOL_LINK "panther_can6_in" 9 /end MEASUREMENT
/begin MEASUREMENT panther_can6_in.asw_in_can6_0xA4_ISB_RR1_ColorBlue "CAN6 receive signal 2" UBYTE NO_COMPU_METHOD 1 100 0 255 ECU_ADDRESS 0x24026e1a SYMBOL_LINK "panther_can6_in" 2 /end MEASUREMENT
/begin MEASUREMENT panther_can6_in.asw_in_can6_0xA4_ISB_RR1_ColorGreen "CAN6 receive signal 1" UBYTE NO_COMPU_METHOD 1 100 0 255 ECU_ADDRESS 0x24026e19 SYMBOL_LINK "panther_can6_in" 1 /end MEASUREMENT
/begin MEASUREMENT panther_can6_in.asw_in_can6_0xA4_ISB_RR1_ColorRed "CAN6 receive signal 3" UBYTE NO_COMPU_METHOD 1 100 0 255 ECU_ADDRESS 0x24026e1b SYMBOL_LINK "panther_can6_in" 3 /end MEASUREMENT
/begin MEASUREMENT panther_can6_in.asw_in_can6_0xA4_ISB_RR1_GroupOrModule "CAN6 receive signal 7" UBYTE NO_COMPU_METHOD 1 100 0 1 ECU_ADDRESS 0x24026e1f SYMBOL_LINK "panther_can6_in" 7 /end MEASUREMENT
/begin MEASUREMENT panther_can6_in.asw_in_can6_0xA4_ISB_RR1_Intensity "CAN6 receive signal 4" UBYTE NO_COMPU_METHOD 1 100 0 127 ECU_ADDRESS 0x24026e1c SYMBOL_LINK "panther_can6_in" 4 /end MEASUREMENT
/begin MEASUREMENT panther_can6_in.asw_in_can6_0xA4_ISB_RR1_Normalization "CAN6 receive signal 5" UBYTE NO_COMPU_METHOD 1 100 0 1 ECU_ADDRESS 0x24026e1d SYMBOL_LINK "panther_can6_in" 5 /end MEASUREMENT
/begin MEASUREMENT panther_can6_in.asw_in_can6_0xA4_ISB_RR1_Transitionspeed "CAN6 receive signal 6" UBYTE NO_COMPU_METHOD 1 100 0 15 ECU_ADDRESS 0x24026e1e SYMBOL_LINK "panther_can6_in" 6 /end MEASUREMENT
/begin MEASUREMENT panther_can6_in.asw_in_can6_0xA4_rx_status "CAN6 Receive Status" UBYTE NO_COMPU_METHOD 1 100 0 1 ECU_ADDRESS 0x24026e18 SYMBOL_LINK "panther_can6_in" 0 /end MEASUREMENT
/begin MEASUREMENT panther_can6_in.asw_in_can6_0xB3_OMS_FL_HandsOnWheel "CAN6 receive signal 1" UBYTE NO_COMPU_METHOD 1 100 0 3 ECU_ADDRESS 0x24026e69 SYMBOL_LINK "panther_can6_in" 81 /end MEASUREMENT
/begin MEASUREMENT panther_can6_in.asw_in_can6_0xB3_OMS_FL_OccupantClassification "CAN6 receive signal 2" UBYTE NO_COMPU_METHOD 1 100 0 7 ECU_ADDRESS 0x24026e6a SYMBOL_LINK "panther_can6_in" 82 /end MEASUREMENT
/begin MEASUREMENT panther_can6_in.asw_in_can6_0xB3_OMS_FL_OccupantHeightMean_cm "CAN6 receive signal 6" UBYTE NO_COMPU_METHOD 1 100 0 255 ECU_ADDRESS 0x24026e70 SYMBOL_LINK "panther_can6_in" 88 /end MEASUREMENT
/begin MEASUREMENT panther_can6_in.asw_in_can6_0xB3_OMS_FL_OccupantHeightStd_cm "CAN6 receive signal 7" UBYTE NO_COMPU_METHOD 1 100 0 255 ECU_ADDRESS 0x24026e71 SYMBOL_LINK "panther_can6_in" 89 /end MEASUREMENT
/begin MEASUREMENT panther_can6_in.asw_in_can6_0xB3_OMS_FL_OccupantPresence_bool "CAN6 receive signal 10" UBYTE NO_COMPU_METHOD 1 100 0 1 ECU_ADDRESS 0x24026e74 SYMBOL_LINK "panther_can6_in" 92 /end MEASUREMENT
/begin MEASUREMENT panther_can6_in.asw_in_can6_0xB3_OMS_FL_OccupantWeightMean_kg "CAN6 receive signal 4" UBYTE NO_COMPU_METHOD 1 100 0 255 ECU_ADDRESS 0x24026e6e SYMBOL_LINK "panther_can6_in" 86 /end MEASUREMENT
/begin MEASUREMENT panther_can6_in.asw_in_can6_0xB3_OMS_FL_OccupantWeightStd_kg "CAN6 receive signal 5" UBYTE NO_COMPU_METHOD 1 100 0 255 ECU_ADDRESS 0x24026e6f SYMBOL_LINK "panther_can6_in" 87 /end MEASUREMENT
/begin MEASUREMENT panther_can6_in.asw_in_can6_0xB3_OMS_FL_OutOfPosition "CAN6 receive signal 3" UWORD NO_COMPU_METHOD 1 100 0 4095 ECU_ADDRESS 0x24026e6c SYMBOL_LINK "panther_can6_in" 84 /end MEASUREMENT
/begin MEASUREMENT panther_can6_in.asw_in_can6_0xB3_rx_status "CAN6 Receive Status" UBYTE NO_COMPU_METHOD 1 100 0 1 ECU_ADDRESS 0x24026e68 SYMBOL_LINK "panther_can6_in" 80 /end MEASUREMENT
/begin MEASUREMENT panther_can6_in.asw_in_can6_0xB4_OMS_FR_OccupantClassification "CAN6 receive signal 1" UBYTE NO_COMPU_METHOD 1 100 0 7 ECU_ADDRESS 0x24026e5d SYMBOL_LINK "panther_can6_in" 69 /end MEASUREMENT
/begin MEASUREMENT panther_can6_in.asw_in_can6_0xB4_OMS_FR_OccupantHeightMean_cm "CAN6 receive signal 5" UBYTE NO_COMPU_METHOD 1 100 0 255 ECU_ADDRESS 0x24026e62 SYMBOL_LINK "panther_can6_in" 74 /end MEASUREMENT
/begin MEASUREMENT panther_can6_in.asw_in_can6_0xB4_OMS_FR_OccupantHeightStd_cm "CAN6 receive signal 6" UBYTE NO_COMPU_METHOD 1 100 0 255 ECU_ADDRESS 0x24026e63 SYMBOL_LINK "panther_can6_in" 75 /end MEASUREMENT
/begin MEASUREMENT panther_can6_in.asw_in_can6_0xB4_OMS_FR_OccupantPresence_bool "CAN6 receive signal 10" UBYTE NO_COMPU_METHOD 1 100 0 1 ECU_ADDRESS 0x24026e67 SYMBOL_LINK "panther_can6_in" 79 /end MEASUREMENT
/begin MEASUREMENT panther_can6_in.asw_in_can6_0xB4_OMS_FR_OccupantWeightMean_kg "CAN6 receive signal 3" UBYTE NO_COMPU_METHOD 1 100 0 255 ECU_ADDRESS 0x24026e60 SYMBOL_LINK "panther_can6_in" 72 /end MEASUREMENT
/begin MEASUREMENT panther_can6_in.asw_in_can6_0xB4_OMS_FR_OccupantWeightStd_kg "CAN6 receive signal 4" UBYTE NO_COMPU_METHOD 1 100 0 255 ECU_ADDRESS 0x24026e61 SYMBOL_LINK "panther_can6_in" 73 /end MEASUREMENT
/begin MEASUREMENT panther_can6_in.asw_in_can6_0xB4_OMS_FR_OutOfPosition "CAN6 receive signal 2" UWORD NO_COMPU_METHOD 1 100 0 4095 ECU_ADDRESS 0x24026e5e SYMBOL_LINK "panther_can6_in" 70 /end MEASUREMENT
/begin MEASUREMENT panther_can6_in.asw_in_can6_0xB4_rx_status "CAN6 Receive Status" UBYTE NO_COMPU_METHOD 1 100 0 1 ECU_ADDRESS 0x24026e5c SYMBOL_LINK "panther_can6_in" 68 /end MEASUREMENT
/begin MEASUREMENT panther_can6_in.asw_in_can6_0xB5_OMS_RL1_OccupantClassification "CAN6 receive signal 1" UBYTE NO_COMPU_METHOD 1 100 0 7 ECU_ADDRESS 0x24026e8e SYMBOL_LINK "panther_can6_in" 118 /end MEASUREMENT
/begin MEASUREMENT panther_can6_in.asw_in_can6_0xB5_OMS_RL1_OccupantHeightMean_cm "CAN6 receive signal 5" UBYTE NO_COMPU_METHOD 1 100 0 255 ECU_ADDRESS 0x24026e94 SYMBOL_LINK "panther_can6_in" 124 /end MEASUREMENT
/begin MEASUREMENT panther_can6_in.asw_in_can6_0xB5_OMS_RL1_OccupantHeightStd_cm "CAN6 receive signal 6" UBYTE NO_COMPU_METHOD 1 100 0 255 ECU_ADDRESS 0x24026e95 SYMBOL_LINK "panther_can6_in" 125 /end MEASUREMENT
/begin MEASUREMENT panther_can6_in.asw_in_can6_0xB5_OMS_RL1_OccupantPresence_bool "CAN6 receive signal 7" UBYTE NO_COMPU_METHOD 1 100 0 1 ECU_ADDRESS 0x24026e96 SYMBOL_LINK "panther_can6_in" 126 /end MEASUREMENT
/begin MEASUREMENT panther_can6_in.asw_in_can6_0xB5_OMS_RL1_OccupantWeightMean_kg "CAN6 receive signal 8" UBYTE NO_COMPU_METHOD 1 100 0 255 ECU_ADDRESS 0x24026e97 SYMBOL_LINK "panther_can6_in" 127 /end MEASUREMENT
/begin MEASUREMENT panther_can6_in.asw_in_can6_0xB5_OMS_RL1_OccupantWeightStd_kg "CAN6 receive signal 9" UBYTE NO_COMPU_METHOD 1 100 0 255 ECU_ADDRESS 0x24026e98 SYMBOL_LINK "panther_can6_in" 128 /end MEASUREMENT
/begin MEASUREMENT panther_can6_in.asw_in_can6_0xB5_OMS_RL1_OutOfPosition "CAN6 receive signal 2" UWORD NO_COMPU_METHOD 1 100 0 4095 ECU_ADDRESS 0x24026e90 SYMBOL_LINK "panther_can6_in" 120 /end MEASUREMENT
/begin MEASUREMENT panther_can6_in.asw_in_can6_0xB5_rx_status "CAN6 Receive Status" UBYTE NO_COMPU_METHOD 1 100 0 1 ECU_ADDRESS 0x24026e8d SYMBOL_LINK "panther_can6_in" 117 /end MEASUREMENT
/begin MEASUREMENT panther_can6_in.asw_in_can6_0xB6_OMS_RL2_OccupantClassification "CAN6 receive signal 2" UBYTE NO_COMPU_METHOD 1 100 0 7 ECU_ADDRESS 0x24026e77 SYMBOL_LINK "panther_can6_in" 95 /end MEASUREMENT
/begin MEASUREMENT panther_can6_in.asw_in_can6_0xB6_OMS_RL2_OccupantHeightMean_cm "CAN6 receive signal 4" UBYTE NO_COMPU_METHOD 1 100 0 255 ECU_ADDRESS 0x24026e79 SYMBOL_LINK "panther_can6_in" 97 /end MEASUREMENT
/begin MEASUREMENT panther_can6_in.asw_in_can6_0xB6_OMS_RL2_OccupantHeightStd_cm "CAN6 receive signal 5" UBYTE NO_COMPU_METHOD 1 100 0 255 ECU_ADDRESS 0x24026e7a SYMBOL_LINK "panther_can6_in" 98 /end MEASUREMENT
/begin MEASUREMENT panther_can6_in.asw_in_can6_0xB6_OMS_RL2_OccupantPresence_bool "CAN6 receive signal 6" UBYTE NO_COMPU_METHOD 1 100 0 1 ECU_ADDRESS 0x24026e7b SYMBOL_LINK "panther_can6_in" 99 /end MEASUREMENT
/begin MEASUREMENT panther_can6_in.asw_in_can6_0xB6_OMS_RL2_OccupantWeightMean_kg "CAN6 receive signal 7" UBYTE NO_COMPU_METHOD 1 100 0 255 ECU_ADDRESS 0x24026e7c SYMBOL_LINK "panther_can6_in" 100 /end MEASUREMENT
/begin MEASUREMENT panther_can6_in.asw_in_can6_0xB6_OMS_RL2_OccupantWeightStd_kg "CAN6 receive signal 8" UBYTE NO_COMPU_METHOD 1 100 0 255 ECU_ADDRESS 0x24026e7d SYMBOL_LINK "panther_can6_in" 101 /end MEASUREMENT
/begin MEASUREMENT panther_can6_in.asw_in_can6_0xB6_OMS_RL2_OutOfPosition "CAN6 receive signal 9" UWORD NO_COMPU_METHOD 1 100 0 4095 ECU_ADDRESS 0x24026e7e SYMBOL_LINK "panther_can6_in" 102 /end MEASUREMENT
/begin MEASUREMENT panther_can6_in.asw_in_can6_0xB6_rx_status "CAN6 Receive Status" UBYTE NO_COMPU_METHOD 1 100 0 1 ECU_ADDRESS 0x24026e75 SYMBOL_LINK "panther_can6_in" 93 /end MEASUREMENT
/begin MEASUREMENT panther_can6_in.asw_in_can6_0xB7_OMS_RR1_OccupantClassification "CAN6 receive signal 2" UBYTE NO_COMPU_METHOD 1 100 0 7 ECU_ADDRESS 0x24026e83 SYMBOL_LINK "panther_can6_in" 107 /end MEASUREMENT
/begin MEASUREMENT panther_can6_in.asw_in_can6_0xB7_OMS_RR1_OccupantHeightMean_cm "CAN6 receive signal 4" UBYTE NO_COMPU_METHOD 1 100 0 255 ECU_ADDRESS 0x24026e85 SYMBOL_LINK "panther_can6_in" 109 /end MEASUREMENT
/begin MEASUREMENT panther_can6_in.asw_in_can6_0xB7_OMS_RR1_OccupantHeightStd_cm "CAN6 receive signal 5" UBYTE NO_COMPU_METHOD 1 100 0 255 ECU_ADDRESS 0x24026e86 SYMBOL_LINK "panther_can6_in" 110 /end MEASUREMENT
/begin MEASUREMENT panther_can6_in.asw_in_can6_0xB7_OMS_RR1_OccupantPresence_bool "CAN6 receive signal 6" UBYTE NO_COMPU_METHOD 1 100 0 1 ECU_ADDRESS 0x24026e87 SYMBOL_LINK "panther_can6_in" 111 /end MEASUREMENT
/begin MEASUREMENT panther_can6_in.asw_in_can6_0xB7_OMS_RR1_OccupantWeightMean_kg "CAN6 receive signal 7" UBYTE NO_COMPU_METHOD 1 100 0 255 ECU_ADDRESS 0x24026e88 SYMBOL_LINK "panther_can6_in" 112 /end MEASUREMENT
/begin MEASUREMENT panther_can6_in.asw_in_can6_0xB7_OMS_RR1_OccupantWeightStd_kg "CAN6 receive signal 8" UBYTE NO_COMPU_METHOD 1 100 0 255 ECU_ADDRESS 0x24026e89 SYMBOL_LINK "panther_can6_in" 113 /end MEASUREMENT
/begin MEASUREMENT panther_can6_in.asw_in_can6_0xB7_OMS_RR1_OutOfPosition "CAN6 receive signal 9" UWORD NO_COMPU_METHOD 1 100 0 4095 ECU_ADDRESS 0x24026e8a SYMBOL_LINK "panther_can6_in" 114 /end MEASUREMENT
/begin MEASUREMENT panther_can6_in.asw_in_can6_0xB7_rx_status "CAN6 Receive Status" UBYTE NO_COMPU_METHOD 1 100 0 1 ECU_ADDRESS 0x24026e81 SYMBOL_LINK "panther_can6_in" 105 /end MEASUREMENT
/begin MEASUREMENT RetractRequest_ADAS "" UBYTE NO_COMPU_METHOD 1 100 0 1 ECU_ADDRESS 0x24026bf4 /end MEASUREMENT
/begin MEASUREMENT RetractRequest_ADAS_Curv "" UBYTE NO_COMPU_METHOD 1 100 0 1 ECU_ADDRESS 0x24026c1b /end MEASUREMENT
/begin MEASUREMENT RetractRequest_ADAS_Junc "" UBYTE NO_COMPU_METHOD 1 100 0 1 ECU_ADDRESS 0x24026bb0 /end MEASUREMENT
/begin MEASUREMENT RetractRequest_AY "" UBYTE NO_COMPU_METHOD 1 100 0 1 ECU_ADDRESS 0x24026c9a /end MEASUREMENT
/begin MEASUREMENT RetractRequest_CAM "" UBYTE NO_COMPU_METHOD 1 100 0 1 ECU_ADDRESS 0x24026d3c /end MEASUREMENT
/begin MEASUREMENT Sa554_DS_AY_Rel_LimitExceeds "" UBYTE NO_COMPU_METHOD 1 100 0 1 ECU_ADDRESS 0x24026d42 /end MEASUREMENT
/begin MEASUREMENT SELK_Manager11_DEBUGOUT_Error_detected "" UBYTE NO_COMPU_METHOD 1 100 0 1 ECU_ADDRESS 0x24015ee1 /end MEASUREMENT
/begin MEASUREMENT SELK_Manager22_DEBUGOUT_Error_detected "" UBYTE NO_COMPU_METHOD 1 100 0 1 ECU_ADDRESS 0x24015ee9 /end MEASUREMENT
/begin MEASUREMENT SELK_Manager33_DEBUGOUT_Error_detected "" UBYTE NO_COMPU_METHOD 1 100 0 1 ECU_ADDRESS 0x24015ef1 /end MEASUREMENT
/begin MEASUREMENT Set_DB_Release_Stable "" UBYTE NO_COMPU_METHOD 1 100 0 1 ECU_ADDRESS 0x24026bdc /end MEASUREMENT
/begin MEASUREMENT Set_DB_Retraction_Release "" UBYTE NO_COMPU_METHOD 1 100 0 1 ECU_ADDRESS 0x24026d56 /end MEASUREMENT
/begin MEASUREMENT VS_ADAS_Junction_Requested "" UBYTE NO_COMPU_METHOD 1 100 0 255 ECU_ADDRESS 0x24026ba4 /end MEASUREMENT
/begin MEASUREMENT VS_RLS_Rating_Stable_f "rated vehicle stable.1 Stabel. 0 Instable." UBYTE NO_COMPU_METHOD 1 100 0 1 ECU_ADDRESS 0x24026dbe /end MEASUREMENT
/begin MEASUREMENT XCPOut_RearSeat_true_Sa534 "" UBYTE NO_COMPU_METHOD 1 100 0 1 ECU_ADDRESS 0x24026c02 /end MEASUREMENT
/begin MEASUREMENT XCPOut_RearSeat_true_Sa535 "" UBYTE NO_COMPU_METHOD 1 100 0 1 ECU_ADDRESS 0x24026bf7 /end MEASUREMENT
/begin MEASUREMENT XCPOut_RearSeat_true_Sa536 "" UBYTE NO_COMPU_METHOD 1 100 0 1 ECU_ADDRESS 0x24026bf8 /end MEASUREMENT
/begin MEASUREMENT XCPOut_RearSeat_true_Sa537 "" UBYTE NO_COMPU_METHOD 1 100 0 1 ECU_ADDRESS 0x24026be9 /end MEASUREMENT
/begin MEASUREMENT XCPOut_RearSeat_true_Sa538 "" UBYTE NO_COMPU_METHOD 1 100 0 1 ECU_ADDRESS 0x24026be8 /end MEASUREMENT
/begin MEASUREMENT XCPOut_Smaller1minus_Sa534 "" UBYTE NO_COMPU_METHOD 1 100 0 1 ECU_ADDRESS 0x24026c4c /end MEASUREMENT
/begin MEASUREMENT XCPOut_Smaller1minus_Sa535 "" UBYTE NO_COMPU_METHOD 1 100 0 1 ECU_ADDRESS 0x24026c46 /end MEASUREMENT
/begin MEASUREMENT XCPOut_Smaller1minus_Sa536 "" UBYTE NO_COMPU_METHOD 1 100 0 1 ECU_ADDRESS 0x24026c50 /end MEASUREMENT
/begin MEASUREMENT XCPOut_Smaller1minus_Sa537 "" UBYTE NO_COMPU_METHOD 1 100 0 1 ECU_ADDRESS 0x24026c51 /end MEASUREMENT
/begin MEASUREMENT XCPOut_Smaller1minus_Sa538 "" UBYTE NO_COMPU_METHOD 1 100 0 1 ECU_ADDRESS 0x24026d75 /end MEASUREMENT
/begin MEASUREMENT XCPOut_Webbing_Output_Sa534 "" UBYTE NO_COMPU_METHOD 1 100 0 1 ECU_ADDRESS 0x24026d34 /end MEASUREMENT
/begin MEASUREMENT XCPOut_Webbing_Output_Sa535 "" UBYTE NO_COMPU_METHOD 1 100 0 1 ECU_ADDRESS 0x24026d38 /end MEASUREMENT
/begin MEASUREMENT XCPOut_Webbing_Output_Sa536 "" UBYTE NO_COMPU_METHOD 1 100 0 1 ECU_ADDRESS 0x24026d43 /end MEASUREMENT
/begin MEASUREMENT XCPOut_Webbing_Output_Sa537 "" UBYTE NO_COMPU_METHOD 1 100 0 1 ECU_ADDRESS 0x24026d33 /end MEASUREMENT
/begin MEASUREMENT XCPOut_Webbing_Output_Sa538 "" UBYTE NO_COMPU_METHOD 1 100 0 1 ECU_ADDRESS 0x24026d44 /end MEASUREMENT
/begin COMPU_METHOD EQ_LSB_0_002 "" LINEAR "%6.3" "" COEFFS_LINEAR 0.002 0 /end COMPU_METHOD
/begin COMPU_METHOD EQ_LSB_0_002_b "" LINEAR "%7.3" "" COEFFS_LINEAR 0.002 0 /end COMPU_METHOD
/begin COMPU_METHOD EQ_LSB_0_01 "" LINEAR "%6.2" "" COEFFS_LINEAR 0.01 0 /end COMPU_METHOD
/begin COMPU_METHOD EQ_LSB_0_02 "" LINEAR "%6.2" "" COEFFS_LINEAR 0.02 0 /end COMPU_METHOD
/begin COMPU_METHOD EQ_LSB_0_1 "" LINEAR "%6.1" "" COEFFS_LINEAR 0.1 0 /end COMPU_METHOD
/begin COMPU_METHOD EQ_LSB_1 "" LINEAR "%3.0" "10ms" COEFFS_LINEAR 1 0 /end COMPU_METHOD
/begin COMPU_METHOD SMA_FNC_YawRate_Z "" LINEAR "%6.2" "deg/s" COEFFS_LINEAR 0.01 0 /end COMPU_METHOD
/begin FUNCTION Sa232_If_Action_Subsystem "" /begin DEF_CHARACTERISTIC DEBUGIN_HMI_ISB_RL1_GroupOrModule /end DEF_CHARACTERISTIC /begin LOC_MEASUREMENT DEBUGOUT_HMI_ISB_RL1_GroupOrModule /end LOC_MEASUREMENT /end FUNCTION
/begin FUNCTION Sa233_If_Action_Subsystem1 ""
 /begin LOC_MEASUREMENT DEBUGOUT_HMI_ISB_RL1_GroupOrModule panther_can6_in.asw_in_can6_0xA2_ISB_RL1_GroupOrModule /end LOC_MEASUREMENT
/end FUNCTION
/begin FUNCTION Sa244_If_Action_Subsystem "" /begin DEF_CHARACTERISTIC DEBUGIN_HMI_ISB_RL2_Rx_Status /end DEF_CHARACTERISTIC /begin LOC_MEASUREMENT DEBUGOUT_HMI_ISB_RL2_Rx_Status /end LOC_MEASUREMENT /end FUNCTION
/begin FUNCTION Sa245_If_Action_Subsystem1 ""
 /begin LOC_MEASUREMENT DEBUGOUT_HMI_ISB_RL2_Rx_Status panther_can6_in.asw_in_can6_0xA3_rx_status /end LOC_MEASUREMENT
/end FUNCTION
/begin FUNCTION Sa246_If_Action_Subsystem "" /begin DEF_CHARACTERISTIC DEBUGIN_HMI_ISB_RL2_AddressByte1 /end DEF_CHARACTERISTIC /begin LOC_MEASUREMENT DEBUGOUT_HMI_ISB_RL2_AddressByte1 /end LOC_MEASUREMENT /end FUNCTION
/begin FUNCTION Sa247_If_Action_Subsystem1 ""
 /begin LOC_MEASUREMENT DEBUGOUT_HMI_ISB_RL2_AddressByte1 panther_can6_in.asw_in_can6_0xA3_ISB_RL2_AddressByte1 /end LOC_MEASUREMENT
/end FUNCTION
/begin FUNCTION Sa248_If_Action_Subsystem "" /begin DEF_CHARACTERISTIC DEBUGIN_HMI_ISB_RL2_ColorBlue /end DEF_CHARACTERISTIC /begin LOC_MEASUREMENT DEBUGOUT_HMI_ISB_RL2_ColorBlue /end LOC_MEASUREMENT /end FUNCTION
/begin FUNCTION Sa249_If_Action_Subsystem1 ""
 /begin LOC_MEASUREMENT DEBUGOUT_HMI_ISB_RL2_ColorBlue panther_can6_in.asw_in_can6_0xA3_ISB_RL2_ColorBlue /end LOC_MEASUREMENT
/end FUNCTION
/begin FUNCTION Sa250_If_Action_Subsystem "" /begin DEF_CHARACTERISTIC DEBUGIN_HMI_ISB_RL2_ColorGreen /end DEF_CHARACTERISTIC /begin LOC_MEASUREMENT DEBUGOUT_HMI_ISB_RL2_ColorGreen /end LOC_MEASUREMENT /end FUNCTION
/begin FUNCTION Sa251_If_Action_Subsystem1 ""
 /begin LOC_MEASUREMENT DEBUGOUT_HMI_ISB_RL2_ColorGreen panther_can6_in.asw_in_can6_0xA3_ISB_RL2_ColorGreen /end LOC_MEASUREMENT
/end FUNCTION
/begin FUNCTION Sa252_If_Action_Subsystem "" /begin DEF_CHARACTERISTIC DEBUGIN_HMI_ISB_RL2_ColorRed /end DEF_CHARACTERISTIC /begin LOC_MEASUREMENT DEBUGOUT_HMI_ISB_RL2_ColorRed /end LOC_MEASUREMENT /end FUNCTION
/begin FUNCTION Sa253_If_Action_Subsystem1 ""
 /begin LOC_MEASUREMENT DEBUGOUT_HMI_ISB_RL2_ColorRed panther_can6_in.asw_in_can6_0xA3_ISB_RL2_ColorRed /end LOC_MEASUREMENT
/end FUNCTION
/begin FUNCTION Sa254_If_Action_Subsystem "" /begin DEF_CHARACTERISTIC DEBUGIN_HMI_ISB_RL2_Intensity /end DEF_CHARACTERISTIC /begin LOC_MEASUREMENT DEBUGOUT_HMI_ISB_RL2_Intensity /end LOC_MEASUREMENT /end FUNCTION
/begin FUNCTION Sa255_If_Action_Subsystem1 ""
 /begin LOC_MEASUREMENT DEBUGOUT_HMI_ISB_RL2_Intensity panther_can6_in.asw_in_can6_0xA3_ISB_RL2_Intensity /end LOC_MEASUREMENT
/end FUNCTION
/begin FUNCTION Sa256_If_Action_Subsystem "" /begin DEF_CHARACTERISTIC DEBUGIN_HMI_ISB_RL2_Normalization /end DEF_CHARACTERISTIC /begin LOC_MEASUREMENT DEBUGOUT_HMI_ISB_RL2_Normalization /end LOC_MEASUREMENT /end FUNCTION
/begin FUNCTION Sa257_If_Action_Subsystem1 ""
 /begin LOC_MEASUREMENT DEBUGOUT_HMI_ISB_RL2_Normalization panther_can6_in.asw_in_can6_0xA3_ISB_RL2_Normalization /end LOC_MEASUREMENT
/end FUNCTION
/begin FUNCTION Sa258_If_Action_Subsystem "" /begin DEF_CHARACTERISTIC DEBUGIN_HMI_ISB_RL2_Transitionspeed /end DEF_CHARACTERISTIC /begin LOC_MEASUREMENT DEBUGOUT_HMI_ISB_RL2_Transitionspeed /end LOC_MEASUREMENT /end FUNCTION
/begin FUNCTION Sa259_If_Action_Subsystem1 ""
 /begin LOC_MEASUREMENT DEBUGOUT_HMI_ISB_RL2_Transitionspeed panther_can6_in.asw_in_can6_0xA3_ISB_RL2_Transitionspeed /end LOC_MEASUREMENT
/end FUNCTION
/begin FUNCTION Sa260_If_Action_Subsystem "" /begin DEF_CHARACTERISTIC DEBUGIN_HMI_ISB_RL2_AddressByte0 /end DEF_CHARACTERISTIC /begin LOC_MEASUREMENT DEBUGOUT_HMI_ISB_RL2_AddressByte0 /end LOC_MEASUREMENT /end FUNCTION
/begin FUNCTION Sa261_If_Action_Subsystem1 ""
 /begin LOC_MEASUREMENT DEBUGOUT_HMI_ISB_RL2_AddressByte0 panther_can6_in.asw_in_can6_0xA3_ISB_RL2_AddressByte0 /end LOC_MEASUREMENT
/end FUNCTION
/begin FUNCTION Sa262_If_Action_Subsystem "" /begin DEF_CHARACTERISTIC DEBUGIN_HMI_ISB_RL2_GroupOrModule /end DEF_CHARACTERISTIC /begin LOC_MEASUREMENT DEBUGOUT_HMI_ISB_RL2_GroupOrModule /end LOC_MEASUREMENT /end FUNCTION
/begin FUNCTION Sa263_If_Action_Subsystem1 ""
 /begin LOC_MEASUREMENT DEBUGOUT_HMI_ISB_RL2_GroupOrModule panther_can6_in.asw_in_can6_0xA3_ISB_RL2_GroupOrModule /end LOC_MEASUREMENT
/end FUNCTION
/begin FUNCTION Sa274_If_Action_Subsystem "" /begin DEF_CHARACTERISTIC DEBUGIN_HMI_ISB_RR1_Rx_Status /end DEF_CHARACTERISTIC /begin LOC_MEASUREMENT DEBUGOUT_HMI_ISB_RR1_Rx_Status /end LOC_MEASUREMENT /end FUNCTION
/begin FUNCTION Sa275_If_Action_Subsystem1 ""
 /begin LOC_MEASUREMENT DEBUGOUT_HMI_ISB_RR1_Rx_Status panther_can6_in.asw_in_can6_0xA4_rx_status /end LOC_MEASUREMENT
/end FUNCTION
/begin FUNCTION Sa276_If_Action_Subsystem "" /begin DEF_CHARACTERISTIC DEBUGIN_HMI_ISB_RR1_AddressByte1 /end DEF_CHARACTERISTIC /begin LOC_MEASUREMENT DEBUGOUT_HMI_ISB_RR1_AddressByte1 /end LOC_MEASUREMENT /end FUNCTION
/begin FUNCTION Sa277_If_Action_Subsystem1 ""
 /begin LOC_MEASUREMENT DEBUGOUT_HMI_ISB_RR1_AddressByte1 panther_can6_in.asw_in_can6_0xA4_ISB_RR1_AddressByte1 /end LOC_MEASUREMENT
/end FUNCTION
/begin FUNCTION Sa278_If_Action_Subsystem "" /begin DEF_CHARACTERISTIC DEBUGIN_HMI_ISB_RR1_ColorBlue /end DEF_CHARACTERISTIC /begin LOC_MEASUREMENT DEBUGOUT_HMI_ISB_RR1_ColorBlue /end LOC_MEASUREMENT /end FUNCTION
/begin FUNCTION Sa279_If_Action_Subsystem1 ""
 /begin LOC_MEASUREMENT DEBUGOUT_HMI_ISB_RR1_ColorBlue panther_can6_in.asw_in_can6_0xA4_ISB_RR1_ColorBlue /end LOC_MEASUREMENT
/end FUNCTION
/begin FUNCTION Sa280_If_Action_Subsystem "" /begin DEF_CHARACTERISTIC DEBUGIN_HMI_ISB_RR1_ColorGreen /end DEF_CHARACTERISTIC /begin LOC_MEASUREMENT DEBUGOUT_HMI_ISB_RR1_ColorGreen /end LOC_MEASUREMENT /end FUNCTION
/begin FUNCTION Sa281_If_Action_Subsystem1 ""
 /begin LOC_MEASUREMENT DEBUGOUT_HMI_ISB_RR1_ColorGreen panther_can6_in.asw_in_can6_0xA4_ISB_RR1_ColorGreen /end LOC_MEASUREMENT
/end FUNCTION
/begin FUNCTION Sa282_If_Action_Subsystem "" /begin DEF_CHARACTERISTIC DEBUGIN_HMI_ISB_RR1_ColorRed /end DEF_CHARACTERISTIC /begin LOC_MEASUREMENT DEBUGOUT_HMI_ISB_RR1_ColorRed /end LOC_MEASUREMENT /end FUNCTION
/begin FUNCTION Sa283_If_Action_Subsystem1 ""
 /begin LOC_MEASUREMENT DEBUGOUT_HMI_ISB_RR1_ColorRed panther_can6_in.asw_in_can6_0xA4_ISB_RR1_ColorRed /end LOC_MEASUREMENT
/end FUNCTION
/begin FUNCTION Sa284_If_Action_Subsystem "" /begin DEF_CHARACTERISTIC DEBUGIN_HMI_ISB_RR1_Intensity /end DEF_CHARACTERISTIC /begin LOC_MEASUREMENT DEBUGOUT_HMI_ISB_RR1_Intensity /end LOC_MEASUREMENT /end FUNCTION
/begin FUNCTION Sa285_If_Action_Subsystem1 ""
 /begin LOC_MEASUREMENT DEBUGOUT_HMI_ISB_RR1_Intensity panther_can6_in.asw_in_can6_0xA4_ISB_RR1_Intensity /end LOC_MEASUREMENT
/end FUNCTION
/begin FUNCTION Sa286_If_Action_Subsystem "" /begin DEF_CHARACTERISTIC DEBUGIN_HMI_ISB_RR1_Normalization /end DEF_CHARACTERISTIC /begin LOC_MEASUREMENT DEBUGOUT_HMI_ISB_RR1_Normalization /end LOC_MEASUREMENT /end FUNCTION
/begin FUNCTION Sa287_If_Action_Subsystem1 ""
 /begin LOC_MEASUREMENT DEBUGOUT_HMI_ISB_RR1_Normalization panther_can6_in.asw_in_can6_0xA4_ISB_RR1_Normalization /end LOC_MEASUREMENT
/end FUNCTION
/begin FUNCTION Sa288_If_Action_Subsystem "" /begin DEF_CHARACTERISTIC DEBUGIN_HMI_ISB_RR1_Transitionspeed /end DEF_CHARACTERISTIC /begin LOC_MEASUREMENT DEBUGOUT_HMI_ISB_RR1_Transitionspeed /end LOC_MEASUREMENT /end FUNCTION
/begin FUNCTION Sa289_If_Action_Subsystem1 ""
 /begin LOC_MEASUREMENT DEBUGOUT_HMI_ISB_RR1_Transitionspeed panther_can6_in.asw_in_can6_0xA4_ISB_RR1_Transitionspeed /end LOC_MEASUREMENT
/end FUNCTION
/begin FUNCTION Sa290_If_Action_Subsystem "" /begin DEF_CHARACTERISTIC DEBUGIN_HMI_ISB_RR1_AddressByte0 /end DEF_CHARACTERISTIC /begin LOC_MEASUREMENT DEBUGOUT_HMI_ISB_RR1_AddressByte0 /end LOC_MEASUREMENT /end FUNCTION
/begin FUNCTION Sa291_If_Action_Subsystem1 ""
 /begin LOC_MEASUREMENT DEBUGOUT_HMI_ISB_RR1_AddressByte0 panther_can6_in.asw_in_can6_0xA4_ISB_RR1_AddressByte0 /end LOC_MEASUREMENT
/end FUNCTION
/begin FUNCTION Sa292_If_Action_Subsystem "" /begin DEF_CHARACTERISTIC DEBUGIN_HMI_ISB_RR1_GroupOrModule /end DEF_CHARACTERISTIC /begin LOC_MEASUREMENT DEBUGOUT_HMI_ISB_RR1_GroupOrModule /end LOC_MEASUREMENT /end FUNCTION
/begin FUNCTION Sa293_If_Action_Subsystem1 ""
 /begin LOC_MEASUREMENT DEBUGOUT_HMI_ISB_RR1_GroupOrModule panther_can6_in.asw_in_can6_0xA4_ISB_RR1_GroupOrModule /end LOC_MEASUREMENT
/end FUNCTION
/begin FUNCTION Sa295_If_Action_Subsystem "" /begin DEF_CHARACTERISTIC DEBUGIN_HMI_SEAL_ActivationRequest /end DEF_CHARACTERISTIC /begin LOC_MEASUREMENT DEBUGOUT_HMI_SEAL_ActivationRequest /end LOC_MEASUREMENT /end FUNCTION
/begin FUNCTION Sa296_If_Action_Subsystem1 ""
 /begin LOC_MEASUREMENT DEBUGOUT_HMI_SEAL_ActivationRequest panther_can6_in.asw_in_can6_0x81_HMI_SEAL_ActivationRequest /end LOC_MEASUREMENT
/end FUNCTION
/begin FUNCTION Sa338_If_Action_Subsystem "" /begin DEF_CHARACTERISTIC DEBUGIN_OMS_FL_Rx_Status /end DEF_CHARACTERISTIC /begin LOC_MEASUREMENT DEBUGOUT_OMS_FL_Rx_Status /end LOC_MEASUREMENT /end FUNCTION
/begin FUNCTION Sa339_If_Action_Subsystem1 ""
 /begin LOC_MEASUREMENT DEBUGOUT_OMS_FL_Rx_Status panther_can6_in.asw_in_can6_0xB3_rx_status /end LOC_MEASUREMENT
/end FUNCTION
/begin FUNCTION Sa340_If_Action_Subsystem "" /begin DEF_CHARACTERISTIC DEBUGIN_OMS_FL_OccupantClassification /end DEF_CHARACTERISTIC /begin LOC_MEASUREMENT DEBUGOUT_OMS_FL_OccupantClassification /end LOC_MEASUREMENT /end FUNCTION
/begin FUNCTION Sa341_If_Action_Subsystem1 ""
 /begin LOC_MEASUREMENT DEBUGOUT_OMS_FL_OccupantClassification panther_can6_in.asw_in_can6_0xB3_OMS_FL_OccupantClassification /end LOC_MEASUREMENT
/end FUNCTION
/begin FUNCTION Sa342_If_Action_Subsystem "" /begin DEF_CHARACTERISTIC DEBUGIN_OMS_RL2_OccupantClassification /end DEF_CHARACTERISTIC /begin LOC_MEASUREMENT DEBUGOUT_OMS_RL2_OccupantClassification /end LOC_MEASUREMENT /end FUNCTION
/begin FUNCTION Sa343_If_Action_Subsystem1 ""
 /begin LOC_MEASUREMENT DEBUGOUT_OMS_RL2_OccupantClassification panther_can6_in.asw_in_can6_0xB6_OMS_RL2_OccupantClassification /end LOC_MEASUREMENT
/end FUNCTION
/begin FUNCTION Sa344_If_Action_Subsystem "" /begin DEF_CHARACTERISTIC DEBUGIN_OMS_RR1_OccupantClassification /end DEF_CHARACTERISTIC /begin LOC_MEASUREMENT DEBUGOUT_OMS_RR1_OccupantClassification /end LOC_MEASUREMENT /end FUNCTION
/begin FUNCTION Sa345_If_Action_Subsystem1 ""
 /begin LOC_MEASUREMENT DEBUGOUT_OMS_RR1_OccupantClassification panther_can6_in.asw_in_can6_0xB7_OMS_RR1_OccupantClassification /end LOC_MEASUREMENT
/end FUNCTION
/begin FUNCTION Sa346_If_Action_Subsystem "" /begin DEF_CHARACTERISTIC DEBUGIN_OMS_FR_OccupantPresence /end DEF_CHARACTERISTIC /begin LOC_MEASUREMENT DEBUGOUT_OMS_FR_OccupantPresence /end LOC_MEASUREMENT /end FUNCTION
/begin FUNCTION Sa347_If_Action_Subsystem1 ""
 /begin LOC_MEASUREMENT DEBUGOUT_OMS_FR_OccupantPresence panther_can6_in.asw_in_can6_0xB4_OMS_FR_OccupantPresence_bool /end LOC_MEASUREMENT
/end FUNCTION
/begin FUNCTION Sa348_If_Action_Subsystem "" /begin DEF_CHARACTERISTIC DEBUGIN_OMS_RL1_OutOfPosition /end DEF_CHARACTERISTIC /begin LOC_MEASUREMENT DEBUGOUT_OMS_RL1_OutOfPosition /end LOC_MEASUREMENT /end FUNCTION
/begin FUNCTION Sa349_If_Action_Subsystem1 ""
 /begin LOC_MEASUREMENT DEBUGOUT_OMS_RL1_OutOfPosition panther_can6_in.asw_in_can6_0xB5_OMS_RL1_OutOfPosition /end LOC_MEASUREMENT
/end FUNCTION
/begin FUNCTION Sa350_If_Action_Subsystem "" /begin DEF_CHARACTERISTIC DEBUGIN_OMS_FL_OccupantWeightMean_kg /end DEF_CHARACTERISTIC /begin LOC_MEASUREMENT DEBUGOUT_OMS_FL_OccupantWeightMean_kg /end LOC_MEASUREMENT /end FUNCTION
/begin FUNCTION Sa351_If_Action_Subsystem1 ""
 /begin LOC_MEASUREMENT DEBUGOUT_OMS_FL_OccupantWeightMean_kg panther_can6_in.asw_in_can6_0xB3_OMS_FL_OccupantWeightMean_kg /end LOC_MEASUREMENT
/end FUNCTION
/begin FUNCTION Sa352_If_Action_Subsystem "" /begin DEF_CHARACTERISTIC DEBUGIN_OMS_FR_OccupantWeightStd_kg /end DEF_CHARACTERISTIC /begin LOC_MEASUREMENT DEBUGOUT_OMS_FR_OccupantWeightStd_kg /end LOC_MEASUREMENT /end FUNCTION
/begin FUNCTION Sa353_If_Action_Subsystem1 ""
 /begin LOC_MEASUREMENT DEBUGOUT_OMS_FR_OccupantWeightStd_kg panther_can6_in.asw_in_can6_0xB4_OMS_FR_OccupantWeightStd_kg /end LOC_MEASUREMENT
/end FUNCTION
/begin FUNCTION Sa354_If_Action_Subsystem "" /begin DEF_CHARACTERISTIC DEBUGIN_OMS_RR1_OccupantPresence /end DEF_CHARACTERISTIC /begin LOC_MEASUREMENT DEBUGOUT_OMS_RR1_OccupantPresence /end LOC_MEASUREMENT /end FUNCTION
/begin FUNCTION Sa355_If_Action_Subsystem1 ""
 /begin LOC_MEASUREMENT DEBUGOUT_OMS_RR1_OccupantPresence panther_can6_in.asw_in_can6_0xB7_OMS_RR1_OccupantPresence_bool /end LOC_MEASUREMENT
/end FUNCTION
/begin FUNCTION Sa356_If_Action_Subsystem "" /begin DEF_CHARACTERISTIC DEBUGIN_OMS_RL1_OccupantPresence /end DEF_CHARACTERISTIC /begin LOC_MEASUREMENT DEBUGOUT_OMS_RL1_OccupantPresence /end LOC_MEASUREMENT /end FUNCTION
/begin FUNCTION Sa357_If_Action_Subsystem1 ""
 /begin LOC_MEASUREMENT DEBUGOUT_OMS_RL1_OccupantPresence panther_can6_in.asw_in_can6_0xB5_OMS_RL1_OccupantPresence_bool /end LOC_MEASUREMENT
/end FUNCTION
/begin FUNCTION Sa358_If_Action_Subsystem "" /begin DEF_CHARACTERISTIC DEBUGIN_OMS_RL2_OccupantPresence /end DEF_CHARACTERISTIC /begin LOC_MEASUREMENT DEBUGOUT_OMS_RL2_OccupantPresence /end LOC_MEASUREMENT /end FUNCTION
/begin FUNCTION Sa359_If_Action_Subsystem1 ""
 /begin LOC_MEASUREMENT DEBUGOUT_OMS_RL2_OccupantPresence panther_can6_in.asw_in_can6_0xB6_OMS_RL2_OccupantPresence_bool /end LOC_MEASUREMENT
/end FUNCTION
/begin FUNCTION Sa360_If_Action_Subsystem "" /begin DEF_CHARACTERISTIC DEBUGIN_OMS_FL_OccupantPresence /end DEF_CHARACTERISTIC /begin LOC_MEASUREMENT DEBUGOUT_OMS_FL_OccupantPresence /end LOC_MEASUREMENT /end FUNCTION
/begin FUNCTION Sa361_If_Action_Subsystem1 ""
 /begin LOC_MEASUREMENT DEBUGOUT_OMS_FL_OccupantPresence panther_can6_in.asw_in_can6_0xB3_OMS_FL_OccupantPresence_bool /end LOC_MEASUREMENT
/end FUNCTION
/begin FUNCTION Sa362_If_Action_Subsystem "" /begin DEF_CHARACTERISTIC DEBUGIN_OMS_FR_OutOfPosition /end DEF_CHARACTERISTIC /begin LOC_MEASUREMENT DEBUGOUT_OMS_FR_OutOfPosition /end LOC_MEASUREMENT /end FUNCTION
/begin FUNCTION Sa363_If_Action_Subsystem1 ""
 /begin LOC_MEASUREMENT DEBUGOUT_OMS_FR_OutOfPosition panther_can6_in.asw_in_can6_0xB4_OMS_FR_OutOfPosition /end LOC_MEASUREMENT
/end FUNCTION
/begin FUNCTION Sa364_If_Action_Subsystem "" /begin DEF_CHARACTERISTIC DEBUGIN_OMS_RL2_OutOfPosition /end DEF_CHARACTERISTIC /begin LOC_MEASUREMENT DEBUGOUT_OMS_RL2_OutOfPosition /end LOC_MEASUREMENT /end FUNCTION
/begin FUNCTION Sa365_If_Action_Subsystem1 ""
 /begin LOC_MEASUREMENT DEBUGOUT_OMS_RL2_OutOfPosition panther_can6_in.asw_in_can6_0xB6_OMS_RL2_OutOfPosition /end LOC_MEASUREMENT
/end FUNCTION
/begin FUNCTION Sa366_If_Action_Subsystem "" /begin DEF_CHARACTERISTIC DEBUGIN_OMS_FL_OutOfPosition /end DEF_CHARACTERISTIC /begin LOC_MEASUREMENT DEBUGOUT_OMS_FL_OutOfPosition /end LOC_MEASUREMENT /end FUNCTION
/begin FUNCTION Sa367_If_Action_Subsystem1 ""
 /begin LOC_MEASUREMENT DEBUGOUT_OMS_FL_OutOfPosition panther_can6_in.asw_in_can6_0xB3_OMS_FL_OutOfPosition /end LOC_MEASUREMENT
/end FUNCTION
/begin FUNCTION Sa368_If_Action_Subsystem "" /begin DEF_CHARACTERISTIC DEBUGIN_OMS_FL_OccupantWeightStd_kg /end DEF_CHARACTERISTIC /begin LOC_MEASUREMENT DEBUGOUT_OMS_FL_OccupantWeightStd_kg /end LOC_MEASUREMENT /end FUNCTION
/begin FUNCTION Sa369_If_Action_Subsystem1 ""
 /begin LOC_MEASUREMENT DEBUGOUT_OMS_FL_OccupantWeightStd_kg panther_can6_in.asw_in_can6_0xB3_OMS_FL_OccupantWeightStd_kg /end LOC_MEASUREMENT
/end FUNCTION
/begin FUNCTION Sa370_If_Action_Subsystem "" /begin DEF_CHARACTERISTIC DEBUGIN_OMS_RR1_OutOfPosition /end DEF_CHARACTERISTIC /begin LOC_MEASUREMENT DEBUGOUT_OMS_RR1_OutOfPosition /end LOC_MEASUREMENT /end FUNCTION
/begin FUNCTION Sa371_If_Action_Subsystem1 ""
 /begin LOC_MEASUREMENT DEBUGOUT_OMS_RR1_OutOfPosition panther_can6_in.asw_in_can6_0xB7_OMS_RR1_OutOfPosition /end LOC_MEASUREMENT
/end FUNCTION
/begin FUNCTION Sa372_If_Action_Subsystem "" /begin DEF_CHARACTERISTIC DEBUGIN_OMS_FR_OccupantWeightMean_kg /end DEF_CHARACTERISTIC /begin LOC_MEASUREMENT DEBUGOUT_OMS_FR_OccupantWeightMean_kg /end LOC_MEASUREMENT /end FUNCTION
/begin FUNCTION Sa373_If_Action_Subsystem1 ""
 /begin LOC_MEASUREMENT DEBUGOUT_OMS_FR_OccupantWeightMean_kg panther_can6_in.asw_in_can6_0xB4_OMS_FR_OccupantWeightMean_kg /end LOC_MEASUREMENT
/end FUNCTION
/begin FUNCTION Sa374_If_Action_Subsystem "" /begin DEF_CHARACTERISTIC DEBUGIN_OMS_RR1_OccupantWeightMean_kg /end DEF_CHARACTERISTIC /begin LOC_MEASUREMENT DEBUGOUT_OMS_RR1_OccupantWeightMean_kg /end LOC_MEASUREMENT /end FUNCTION
/begin FUNCTION Sa375_If_Action_Subsystem1 ""
 /begin LOC_MEASUREMENT DEBUGOUT_OMS_RR1_OccupantWeightMean_kg panther_can6_in.asw_in_can6_0xB7_OMS_RR1_OccupantWeightMean_kg /end LOC_MEASUREMENT
/end FUNCTION
/begin FUNCTION Sa376_If_Action_Subsystem "" /begin DEF_CHARACTERISTIC DEBUGIN_OMS_FR_OccupantHeightMean_cm /end DEF_CHARACTERISTIC /begin LOC_MEASUREMENT DEBUGOUT_OMS_FR_OccupantHeightMean_cm /end LOC_MEASUREMENT /end FUNCTION
/begin FUNCTION Sa377_If_Action_Subsystem1 ""
 /begin LOC_MEASUREMENT DEBUGOUT_OMS_FR_OccupantHeightMean_cm panther_can6_in.asw_in_can6_0xB4_OMS_FR_OccupantHeightMean_cm /end LOC_MEASUREMENT
/end FUNCTION
/begin FUNCTION Sa378_If_Action_Subsystem "" /begin DEF_CHARACTERISTIC DEBUGIN_OMS_RL1_OccupantHeightStd_cm /end DEF_CHARACTERISTIC /begin LOC_MEASUREMENT DEBUGOUT_OMS_RL1_OccupantHeightStd_cm /end LOC_MEASUREMENT /end FUNCTION
/begin FUNCTION Sa379_If_Action_Subsystem1 ""
 /begin LOC_MEASUREMENT DEBUGOUT_OMS_RL1_OccupantHeightStd_cm panther_can6_in.asw_in_can6_0xB5_OMS_RL1_OccupantHeightStd_cm /end LOC_MEASUREMENT
/end FUNCTION
/begin FUNCTION Sa380_If_Action_Subsystem "" /begin DEF_CHARACTERISTIC DEBUGIN_OMS_RL2_OccupantWeightStd_kg /end DEF_CHARACTERISTIC /begin LOC_MEASUREMENT DEBUGOUT_OMS_RL2_OccupantWeightStd_kg /end LOC_MEASUREMENT /end FUNCTION
/begin FUNCTION Sa381_If_Action_Subsystem1 ""
 /begin LOC_MEASUREMENT DEBUGOUT_OMS_RL2_OccupantWeightStd_kg panther_can6_in.asw_in_can6_0xB6_OMS_RL2_OccupantWeightStd_kg /end LOC_MEASUREMENT
/end FUNCTION
/begin FUNCTION Sa382_If_Action_Subsystem "" /begin DEF_CHARACTERISTIC DEBUGIN_OMS_FR_Rx_Status /end DEF_CHARACTERISTIC /begin LOC_MEASUREMENT DEBUGOUT_OMS_FR_Rx_Status /end LOC_MEASUREMENT /end FUNCTION
/begin FUNCTION Sa383_If_Action_Subsystem1 ""
 /begin LOC_MEASUREMENT DEBUGOUT_OMS_FR_Rx_Status panther_can6_in.asw_in_can6_0xB4_rx_status /end LOC_MEASUREMENT
/end FUNCTION
/begin FUNCTION Sa384_If_Action_Subsystem "" /begin DEF_CHARACTERISTIC DEBUGIN_OMS_RL1_OccupantWeightStd_kg /end DEF_CHARACTERISTIC /begin LOC_MEASUREMENT DEBUGOUT_OMS_RL1_OccupantWeightStd_kg /end LOC_MEASUREMENT /end FUNCTION
/begin FUNCTION Sa385_If_Action_Subsystem1 ""
 /begin LOC_MEASUREMENT DEBUGOUT_OMS_RL1_OccupantWeightStd_kg panther_can6_in.asw_in_can6_0xB5_OMS_RL1_OccupantWeightStd_kg /end LOC_MEASUREMENT
/end FUNCTION
/begin FUNCTION Sa386_If_Action_Subsystem "" /begin DEF_CHARACTERISTIC DEBUGIN_OMS_RL1_OccupantWeightMean_kg /end DEF_CHARACTERISTIC /begin LOC_MEASUREMENT DEBUGOUT_OMS_RL1_OccupantWeightMean_kg /end LOC_MEASUREMENT /end FUNCTION
/begin FUNCTION Sa387_If_Action_Subsystem1 ""
 /begin LOC_MEASUREMENT DEBUGOUT_OMS_RL1_OccupantWeightMean_kg panther_can6_in.asw_in_can6_0xB5_OMS_RL1_OccupantWeightMean_kg /end LOC_MEASUREMENT
/end FUNCTION
/begin FUNCTION Sa388_If_Action_Subsystem "" /begin DEF_CHARACTERISTIC DEBUGIN_OMS_RR1_OccupantWeightStd_kg /end DEF_CHARACTERISTIC /begin LOC_MEASUREMENT DEBUGOUT_OMS_RR1_OccupantWeightStd_kg /end LOC_MEASUREMENT /end FUNCTION
/begin FUNCTION Sa389_If_Action_Subsystem1 ""
 /begin LOC_MEASUREMENT DEBUGOUT_OMS_RR1_OccupantWeightStd_kg panther_can6_in.asw_in_can6_0xB7_OMS_RR1_OccupantWeightStd_kg /end LOC_MEASUREMENT
/end FUNCTION
/begin FUNCTION Sa390_If_Action_Subsystem "" /begin DEF_CHARACTERISTIC DEBUGIN_OMS_FL_OccupantHeightStd_cm /end DEF_CHARACTERISTIC /begin LOC_MEASUREMENT DEBUGOUT_OMS_FL_OccupantHeightStd_cm /end LOC_MEASUREMENT /end FUNCTION
/begin FUNCTION Sa391_If_Action_Subsystem1 ""
 /begin LOC_MEASUREMENT DEBUGOUT_OMS_FL_OccupantHeightStd_cm panther_can6_in.asw_in_can6_0xB3_OMS_FL_OccupantHeightStd_cm /end LOC_MEASUREMENT
/end FUNCTION
/begin FUNCTION Sa392_If_Action_Subsystem "" /begin DEF_CHARACTERISTIC DEBUGIN_OMS_RL2_OccupantWeightMean_kg /end DEF_CHARACTERISTIC /begin LOC_MEASUREMENT DEBUGOUT_OMS_RL2_OccupantWeightMean_kg /end LOC_MEASUREMENT /end FUNCTION
/begin FUNCTION Sa393_If_Action_Subsystem1 ""
 /begin LOC_MEASUREMENT DEBUGOUT_OMS_RL2_OccupantWeightMean_kg panther_can6_in.asw_in_can6_0xB6_OMS_RL2_OccupantWeightMean_kg /end LOC_MEASUREMENT
/end FUNCTION
/begin FUNCTION Sa394_If_Action_Subsystem "" /begin DEF_CHARACTERISTIC DEBUGIN_OMS_FR_OccupantHeightStd_cm /end DEF_CHARACTERISTIC /begin LOC_MEASUREMENT DEBUGOUT_OMS_FR_OccupantHeightStd_cm /end LOC_MEASUREMENT /end FUNCTION
/begin FUNCTION Sa395_If_Action_Subsystem1 ""
 /begin LOC_MEASUREMENT DEBUGOUT_OMS_FR_OccupantHeightStd_cm panther_can6_in.asw_in_can6_0xB4_OMS_FR_OccupantHeightStd_cm /end LOC_MEASUREMENT
/end FUNCTION
/begin FUNCTION Sa396_If_Action_Subsystem "" /begin DEF_CHARACTERISTIC DEBUGIN_OMS_FL_OccupantHeightMean_cm /end DEF_CHARACTERISTIC /begin LOC_MEASUREMENT DEBUGOUT_OMS_FL_OccupantHeightMean_cm /end LOC_MEASUREMENT /end FUNCTION
/begin FUNCTION Sa397_If_Action_Subsystem1 ""
 /begin LOC_MEASUREMENT DEBUGOUT_OMS_FL_OccupantHeightMean_cm panther_can6_in.asw_in_can6_0xB3_OMS_FL_OccupantHeightMean_cm /end LOC_MEASUREMENT
/end FUNCTION
/begin FUNCTION Sa398_If_Action_Subsystem "" /begin DEF_CHARACTERISTIC DEBUGIN_OMS_RL1_OccupantHeightMean_cm /end DEF_CHARACTERISTIC /begin LOC_MEASUREMENT DEBUGOUT_OMS_RL1_OccupantHeightMean_cm /end LOC_MEASUREMENT /end FUNCTION
/begin FUNCTION Sa399_If_Action_Subsystem1 ""
 /begin LOC_MEASUREMENT DEBUGOUT_OMS_RL1_OccupantHeightMean_cm panther_can6_in.asw_in_can6_0xB5_OMS_RL1_OccupantHeightMean_cm /end LOC_MEASUREMENT
/end FUNCTION
/begin FUNCTION Sa4_MGR_Manager_PANTHER ""
 /begin DEF_CHARACTERISTIC BackTo_WakeUp_s BackfromOfferPosition_s XCP_in_ACB_CAN_Awake_Sa534 XCP_in_ACB_CLkS_LK_Sa534 XCP_in_ACB_CarSpeed_Sa534 XCP_in_ACB_ISw_Stat_Sa534 XCP_in_ACB_Open_Door_Sa534 XCP_in_ACB_CAN_Awake_Sa535 XCP_in_ACB_CLkS_LK_Sa535 XCP_in_ACB_CarSpeed_Sa535 XCP_in_ACB_ISw_Stat_Sa535 XCP_in_ACB_Open_Door_Sa535 XCP_in_ACB_CAN_Awake_Sa536 XCP_in_ACB_CLkS_LK_Sa536 XCP_in_ACB_CarSpeed_Sa536 XCP_in_ACB_ISw_Stat_Sa536 XCP_in_ACB_Open_Door_Sa536 XCP_in_ACB_CAN_Awake_Sa537 XCP_in_ACB_CLkS_LK_Sa537 XCP_in_ACB_CarSpeed_Sa537 XCP_in_ACB_ISw_Stat_Sa537 XCP_in_ACB_Open_Door_Sa537 XCP_in_ACB_CAN_Awake_Sa538 XCP_in_ACB_CLkS_LK_Sa538 XCP_in_ACB_CarSpeed_Sa538 XCP_in_ACB_ISw_Stat_Sa538 XCP_in_ACB_Open_Door_Sa538 Enable_RetractReq_ADAS_Curv Enable_RetractReq_ADAS_Junc Enable_RetractRequest_ADAS Enable_RetractRequest_AY Enable_RetractRequest_CAM PARAM_Delay_AirbagClose PARAM_Delay_BentBackward PARAM_Delay_LeanedLeft PARAM_Delay_LeanedRight PARAM_AirbagClose_Qualitime_msec PARAM_leanedRight_Qualitime_msec PARAM_tiltedBack_Qualitime_msec PARAM_leanedForward_Qualitime_msec PARAM_leanedLeft_Qualitime_msec ISB_PARAM_BlinkOffBeforeBuckle_ms ISB_PARAM_BlinkOffBuckleBeginDrive_ms ISB_PARAM_BlinkOffBuckleDuringDrive_ms ISB_PARAM_BlinkOnBeforeBuckle_ms ISB_PARAM_BlinkOnBuckleBeginDrive_ms ISB_PARAM_BlinkOnBuckleDuringDrive_ms ISB_PARAM_SwitchOffAfterBuckle_ms ISB_PARAM_SwitchOffOpenDoor_ms ISB_PARAM_SwitchOffStandStill_ms ISB_PARAM_SwitchOffUnlock_ms PARAM_VS_REL_Request_Del_msec_1 PARAM_VS_REL_Cons_Requests /end DEF_CHARACTERISTIC
 /begin LOC_MEASUREMENT ALI_BrakePressCalc Debug_ALI_ISw_Stat Debug_VehAccel_Y Debug_VehAccel_X DEBUGOUT_ALI_OffroadSport_activated Debug_E_classVersion DEBUGOUT_ELK_Lock_Status_RL1 DEBUGOUT_ELK_Lock_Status_RL2 DEBUGOUT_ELK_Lock_Status_RR1 DEBUGOUT_ELK_Algo_Status_RL1 DEBUGOUT_ELK_Algo_Status_RL2 DEBUGOUT_ELK_Algo_Status_RR1 DEBUGOUT_ELK_ECU_Status_RL1 DEBUGOUT_ELK_ECU_Status_RL2 DEBUGOUT_ELK_ECU_Status_RR1 DEBUGOUT_HMI_ABL_Rx_Status DEBUGOUT_HMI_ABL_FR_RetractRequest DEBUGOUT_HMI_ABL_FL_RetractRequest DEBUGOUT_HMI_ABL_RL1_RetractRequest DEBUGOUT_HMI_ABL_RL2_RetractRequest DEBUGOUT_HMI_ABL_RR1_RetractRequest DEBUGOUT_HMI_ACR_Rx_Status DEBUGOUT_HMI_ACR_FR_RetractRequest DEBUGOUT_HMI_ACR_FL_RetractRequest DEBUGOUT_HMI_ACR_RL1_RetractRequest DEBUGOUT_HMI_ACR_RL2_RetractRequest DEBUGOUT_HMI_ACR_RR1_RetractRequest DEBUGOUT_HMI_ELK_Rx_Status DEBUGOUT_HMI_ELK_RL1_LockingRequest DEBUGOUT_HMI_ELK_FR_LockingRequest DEBUGOUT_HMI_ELK_FL_LockingRequest DEBUGOUT_HMI_ELK_RL2_LockingRequest DEBUGOUT_HMI_ELK_RR1_LockingRequest DEBUGOUT_HMI_ELK_ResetErrorFlags DEBUGOUT_HMI_ISB_FL_Rx_Status DEBUGOUT_HMI_ISB_FL_AddressByte1_byte DEBUGOUT_HMI_ISB_FL_ColorBlue_byte DEBUGOUT_HMI_ISB_FL_ColorGreen_byte DEBUGOUT_HMI_ISB_FL_ColorRed_byte DEBUGOUT_HMI_ISB_FL_Intensity_perc DEBUGOUT_HMI_ISB_FL_Normalization_bool DEBUGOUT_HMI_ISB_FL_Transitionspeed_nibble DEBUGOUT_HMI_ISB_FL_AddressByte0_byte DEBUGOUT_HMI_ISB_FL_GroupOrModule_bool DEBUGOUT_HMI_ISB_FR_Rx_Status DEBUGOUT_HMI_ISB_FR_AddressByte1 DEBUGOUT_HMI_ISB_FR_ColorBlue DEBUGOUT_HMI_ISB_FR_ColorGreen DEBUGOUT_HMI_ISB_FR_ColorRed DEBUGOUT_HMI_ISB_FR_Intensity_perc DEBUGOUT_HMI_ISB_FR_Normalization DEBUGOUT_HMI_ISB_FR_Transitionspeed DEBUGOUT_HMI_ISB_FR_AddressByte0 DEBUGOUT_HMI_ISB_FR_GroupOrModule DEBUGOUT_HMI_ISB_RL1_Rx_Status DEBUGOUT_HMI_ISB_RL1_AddressByte1 DEBUGOUT_HMI_ISB_RL1_ColorBlue DEBUGOUT_HMI_ISB_RL1_ColorGreen DEBUGOUT_HMI_ISB_RL1_ColorRed DEBUGOUT_HMI_ISB_RL1_Intensity DEBUGOUT_HMI_ISB_RL1_Normalization DEBUGOUT_HMI_ISB_RL1_Transitionspeed DEBUGOUT_HMI_ISB_RL1_AddressByte0 DEBUGOUT_HMI_ISB_RL1_GroupOrModule DEBUGOUT_HMI_ISB_RL2_Rx_Status DEBUGOUT_HMI_ISB_RL2_AddressByte1 DEBUGOUT_HMI_ISB_RL2_ColorBlue DEBUGOUT_HMI_ISB_RL2_ColorGreen DEBUGOUT_HMI_ISB_RL2_ColorRed DEBUGOUT_HMI_ISB_RL2_Intensity DEBUGOUT_HMI_ISB_RL2_Normalization DEBUGOUT_HMI_ISB_RL2_Transitionspeed DEBUGOUT_HMI_ISB_RL2_AddressByte0 DEBUGOUT_HMI_ISB_RL2_GroupOrModule DEBUGOUT_HMI_ISB_RR1_Rx_Status DEBUGOUT_HMI_ISB_RR1_AddressByte1 DEBUGOUT_HMI_ISB_RR1_ColorBlue DEBUGOUT_HMI_ISB_RR1_ColorGreen DEBUGOUT_HMI_ISB_RR1_ColorRed DEBUGOUT_HMI_ISB_RR1_Intensity DEBUGOUT_HMI_ISB_RR1_Normalization DEBUGOUT_HMI_ISB_RR1_Transitionspeed DEBUGOUT_HMI_ISB_RR1_AddressByte0 DEBUGOUT_HMI_ISB_RR1_GroupOrModule DEBUGOUT_HMI_SEAL_ActivationRequest DEBUGOUT_OMS_FL_Rx_Status DEBUGOUT_OMS_FL_OccupantClassification DEBUGOUT_OMS_RL2_OccupantClassification DEBUGOUT_OMS_RR1_OccupantClassification DEBUGOUT_OMS_FR_OccupantPresence DEBUGOUT_OMS_RL1_OutOfPosition DEBUGOUT_OMS_FL_OccupantWeightMean_kg DEBUGOUT_OMS_FR_OccupantWeightStd_kg DEBUGOUT_OMS_RR1_OccupantPresence DEBUGOUT_OMS_RL1_OccupantPresence DEBUGOUT_OMS_RL2_OccupantPresence DEBUGOUT_OMS_FL_OccupantPresence DEBUGOUT_OMS_FR_OutOfPosition DEBUGOUT_OMS_RL2_OutOfPosition DEBUGOUT_OMS_FL_OutOfPosition DEBUGOUT_OMS_FL_OccupantWeightStd_kg DEBUGOUT_OMS_RR1_OutOfPosition DEBUGOUT_OMS_FR_OccupantWeightMean_kg DEBUGOUT_OMS_RR1_OccupantWeightMean_kg DEBUGOUT_OMS_FR_OccupantHeightMean_cm DEBUGOUT_OMS_RL1_OccupantHeightStd_cm DEBUGOUT_OMS_RL2_OccupantWeightStd_kg DEBUGOUT_OMS_FR_Rx_Status DEBUGOUT_OMS_RL1_OccupantWeightStd_kg DEBUGOUT_OMS_RL1_OccupantWeightMean_kg DEBUGOUT_OMS_RR1_OccupantWeightStd_kg DEBUGOUT_OMS_FL_OccupantHeightStd_cm DEBUGOUT_OMS_RL2_OccupantWeightMean_kg DEBUGOUT_OMS_FR_OccupantHeightStd_cm DEBUGOUT_OMS_FL_OccupantHeightMean_cm DEBUGOUT_OMS_RL1_OccupantHeightMean_cm DEBUGOUT_OMS_RL1_Rx_Status DEBUGOUT_OMS_RL2_OccupantHeightStd_cm DEBUGOUT_OMS_RL2_OccupantHeightMean_cm DEBUGOUT_OMS_RR1_OccupantHeightStd_cm DEBUGOUT_OMS_RR1_OccupantHeightMean_cm DEBUGOUT_OMS_RL2_Rx_Status DEBUGOUT_OMS_FL_HandsOnWheel DEBUGOUT_OMS_RR1_Rx_Status DEBUGOUT_OMS_RL1_OccupantClassification DEBUGOUT_OMS_FR_OccupantClassification Debug_ABL_ComfortActivation_FL Debug_ABL_ComfortActivation_FR Debug_ABL_ComfortActivation_RL1 Debug_ABL_ComfortActivation_RL2 Debug_ABL_ComfortActivation_RR1 Debug_ABL_StateControl_FL Debug_ABL_StateControl_FR Debug_ABL_StateControl_RL1 Debug_ABL_StateControl_RL2 Debug_ABL_StateControl_RR1 Debug_CAN_Awake XCPOut_RearSeat_true_Sa534 XCPOut_Smaller1minus_Sa534 XCPOut_Webbing_Output_Sa534 XCPOut_RearSeat_true_Sa535 XCPOut_Smaller1minus_Sa535 XCPOut_Webbing_Output_Sa535 XCPOut_RearSeat_true_Sa536 XCPOut_Smaller1minus_Sa536 XCPOut_Webbing_Output_Sa536 XCPOut_RearSeat_true_Sa537 XCPOut_Smaller1minus_Sa537 XCPOut_Webbing_Output_Sa537 XCPOut_RearSeat_true_Sa538 XCPOut_Smaller1minus_Sa538 XCPOut_Webbing_Output_Sa538 ISB_FunctionLogic_FL_Debug_ISB_BuckleSignal ISB_FunctionLogic_FL_Debug_ISB_Colour ISB_FunctionLogic_FL_Debug_ISB_OtherOpenDoor ISB_FunctionLogic_FL_Debug_ISB_StateControl ISB_FunctionLogic_FL_Debug_ISB_TransitionSpeed ISB_FunctionLogic_FL_Debug_Open_Door ISB_FunctionLogic_FL_Debug_PARAM_BlinkOnBuckleBeginDrive_ms ISB_FunctionLogic_FR_Debug_ISB_BuckleSignal ISB_FunctionLogic_FR_Debug_ISB_Colour ISB_FunctionLogic_FR_Debug_ISB_OtherOpenDoor ISB_FunctionLogic_FR_Debug_ISB_StateControl ISB_FunctionLogic_FR_Debug_ISB_TransitionSpeed ISB_FunctionLogic_FR_Debug_Open_Door ISB_FunctionLogic_FR_Debug_PARAM_BlinkOnBuckleBeginDrive_ms ISB_FunctionLogic_RL1_Debug_ISB_BuckleSignal ISB_FunctionLogic_RL1_Debug_ISB_Colour ISB_FunctionLogic_RL1_Debug_ISB_OtherOpenDoor ISB_FunctionLogic_RL1_Debug_ISB_StateControl ISB_FunctionLogic_RL1_Debug_ISB_TransitionSpeed ISB_FunctionLogic_RL1_Debug_Open_Door ISB_FunctionLogic_RL1_Debug_PARAM_BlinkOnBuckleBeginDrive_ms ISB_FunctionLogic_RL2_Debug_ISB_BuckleSignal ISB_FunctionLogic_RL2_Debug_ISB_Colour ISB_FunctionLogic_RL2_Debug_ISB_OtherOpenDoor ISB_FunctionLogic_RL2_Debug_ISB_StateControl ISB_FunctionLogic_RL2_Debug_ISB_TransitionSpeed ISB_FunctionLogic_RL2_Debug_Open_Door ISB_FunctionLogic_RL2_Debug_PARAM_BlinkOnBuckleBeginDrive_ms ISB_FunctionLogic_RR1_Debug_ISB_BuckleSignal ISB_FunctionLogic_RR1_Debug_ISB_Colour ISB_FunctionLogic_RR1_Debug_ISB_OtherOpenDoor ISB_FunctionLogic_RR1_Debug_ISB_StateControl ISB_FunctionLogic_RR1_Debug_ISB_TransitionSpeed ISB_FunctionLogic_RR1_Debug_Open_Door ISB_FunctionLogic_RR1_Debug_PARAM_BlinkOnBuckleBeginDrive_ms DEBUGOUT_RLS_DG_Request_Timer_run Debug_DB_ReleaseActivation_State Debug_DynamicBelt_activated Debug_FNCActivationLevel DS_AY_LimitExceeds Sa554_DS_AY_Rel_LimitExceeds DS_ayLimit_Calculated DS_ayLimit_Release_Calculated ay_Requested DynamicSupport_Request_bitfield RetractRequest_ADAS RetractRequest_ADAS_Curv RetractRequest_ADAS_Junc RetractRequest_AY RetractRequest_CAM Set_DB_Release_Stable Set_DB_Retraction_Release VS_ADAS_Junction_Requested Debug_AibagClose_True Debug_LeanLeft_True Debug_LeanRight_True Debug_LeanedForward_True Debug_TOF_OccupantClass_FL Debug_TOF_OccupantClass_FP Debug_TOF_OccupantClass_RL1 Debug_TOF_OccupantClass_RL2 Debug_TOF_OccupantClass_RR Debug_TOF_OccupantWeight_FL Debug_TOF_OccupantWeight_FR Debug_TOF_OccupantWeight_RL Debug_TOF_OccupantWeight_RR Debug_TOF_OutOfPostion_FL Debug_TOF_OutOfPostion_FP Debug_TOF_OutOfPostion_RL1 Debug_TOF_OutOfPostion_RL2 Debug_TOF_OutOfPostion_RR Debug_TiltedBack_True ALI_YawRate_Z_degs VS_RLS_Rating_Stable_f panther_can1_in.asw_in_can1_0x20_VCLASS_FL_DoorHndlStatus panther_can1_in.asw_in_can1_0x20_VCLASS_FR_DoorHndlStatus panther_can1_in.asw_in_can1_0x20_VCLASS_RL_DoorHndlStatus panther_can1_in.asw_in_can1_0x20_VCLASS_RR_DoorHndlStatus panther_can1_in.asw_in_can1_0x20_VCLASS_Lt_TurnIndicator_on panther_can1_in.asw_in_can1_0x20_VCLASS_Rt_TurnIndicator_on panther_can1_in.asw_in_can1_0x20_VCLASS_Lt_BlindSpWarn_on panther_can1_in.asw_in_can1_0x20_VCLASS_Rt_BlindSpWarn_on panther_can1_in.asw_in_can1_0x20_VCLASS_CentrLockSys_Status panther_can2_in.asw_in_can2_0x194_WMS_RR1_WebbingMovement panther_can2_in.asw_in_can2_0x194_WMS_RR1_SpoolAngle panther_can2_in.asw_in_can2_0x194_WMS_RR1_SensorStatus panther_can2_in.asw_in_can2_0x193_WMS_RL2_WebbingMovement panther_can2_in.asw_in_can2_0x193_WMS_RL2_SpoolAngle panther_can2_in.asw_in_can2_0x193_WMS_RL2_SensorStatus panther_can2_in.asw_in_can2_0x192_WMS_RL1_WebbingMovement panther_can2_in.asw_in_can2_0x192_WMS_RL1_SpoolAngle panther_can2_in.asw_in_can2_0x192_WMS_RL1_SensorStatus panther_can2_in.asw_in_can2_0x191_WMS_FR_WebbingMovement panther_can2_in.asw_in_can2_0x191_WMS_FR_SpoolAngle panther_can2_in.asw_in_can2_0x191_WMS_FR_SensorStatus panther_can2_in.asw_in_can2_0x190_WMS_FL_WebbingMovement panther_can2_in.asw_in_can2_0x190_WMS_FL_SpoolAngle_deg panther_can2_in.asw_in_can2_0x190_WMS_FL_SensorStatus_bool panther_can2_in.asw_in_can2_0x18C_ACR_RR1_ActivationLevelStatus panther_can2_in.asw_in_can2_0x18C_ACR_RR1_ActivationPhase panther_can2_in.asw_in_can2_0x18B_ACR_RL2_ActivationLevelStatus panther_can2_in.asw_in_can2_0x18B_ACR_RL2_ActivationPhase panther_can2_in.asw_in_can2_0x18A_ACR_RL1_ActivationLevelStatus panther_can2_in.asw_in_can2_0x18A_ACR_RL1_ActivationPhase panther_can2_in.asw_in_can2_0x189_ACR_FR_ActivationLevelStatus panther_can2_in.asw_in_can2_0x189_ACR_FR_ActivationPhase panther_can2_in.asw_in_can2_0x188_ACR_FL_ActivationLevelStatus panther_can2_in.asw_in_can2_0x188_ACR_FL_ActivationPhase panther_can2_in.asw_in_can2_0x199_BSW_FL_BuckleStatus panther_can2_in.asw_in_can2_0x199_BSW_FR_BuckleStatus panther_can2_in.asw_in_can2_0x199_BSW_RL1_BuckleStatus panther_can2_in.asw_in_can2_0x199_BSW_RL2_BuckleStatus panther_can2_in.asw_in_can2_0x199_BSW_RR1_BuckleStatus panther_can2_in.asw_in_can2_0xC1_STS_BDS_FL_DataByte1 panther_can2_in.asw_in_can2_0xC1_STS_BDS_FL_DataByte2 panther_can2_in.asw_in_can2_0xC1_STS_BDS_FL_DataByte3 panther_can2_in.asw_in_can2_0xC1_STS_BDS_FL_DataByte4 panther_can2_in.asw_in_can2_0xC1_STS_BDS_FL_DataByte5 panther_can2_in.asw_in_can2_0xC1_STS_BDS_FL_DataByte6 panther_can2_in.asw_in_can2_0xC1_STS_BDS_FL_DataByte7 panther_can2_in.asw_in_can2_0xC1_STS_BDS_FL_DataByte8 panther_can2_in.asw_in_can2_0xC2_STS_BDS_FL_DataByte9 panther_can2_in.asw_in_can2_0xC2_STS_BDS_FL_DataByte10 panther_can2_in.asw_in_can2_0xC2_STS_BDS_FL_DataByte11 panther_can2_in.asw_in_can2_0xC2_STS_BDS_FL_DataByte12 panther_can2_in.asw_in_can2_0xC2_STS_BDS_FL_DataByte13 panther_can2_in.asw_in_can2_0xC2_STS_BDS_FL_DataByte14 panther_can2_in.asw_in_can2_0xC2_STS_BDS_FL_DataByte15 panther_can2_in.asw_in_can2_0xC2_STS_BDS_FL_DataByte16 panther_can2_in.asw_in_can2_0xC3_STS_BDS_FR_DataByte1 panther_can2_in.asw_in_can2_0xC3_STS_BDS_FR_DataByte2 panther_can2_in.asw_in_can2_0xC3_STS_BDS_FR_DataByte3 panther_can2_in.asw_in_can2_0xC3_STS_BDS_FR_DataByte4 panther_can2_in.asw_in_can2_0xC3_STS_BDS_FR_DataByte5 panther_can2_in.asw_in_can2_0xC3_STS_BDS_FR_DataByte6 panther_can2_in.asw_in_can2_0xC3_STS_BDS_FR_DataByte7 panther_can2_in.asw_in_can2_0xC3_STS_BDS_FR_DataByte8 panther_can2_in.asw_in_can2_0xC4_STS_BDS_FR_DataByte9 panther_can2_in.asw_in_can2_0xC4_STS_BDS_FR_DataByte10 panther_can2_in.asw_in_can2_0xC4_STS_BDS_FR_DataByte11 panther_can2_in.asw_in_can2_0xC4_STS_BDS_FR_DataByte12 panther_can2_in.asw_in_can2_0xC4_STS_BDS_FR_DataByte13 panther_can2_in.asw_in_can2_0xC4_STS_BDS_FR_DataByte14 panther_can2_in.asw_in_can2_0xC4_STS_BDS_FR_DataByte15 panther_can2_in.asw_in_can2_0xC4_STS_BDS_FR_DataByte16 DEBUGOUT_Release_Kugel_stabil_Invert DEBUGOUT_Release_Stable_Invert DEBUGOUT_Release_task_Stable_Bitfield DEBUGOUT_RLS_VSMA_Request_f DEBUGOUT_RLS_DG_Request_Timer_set_f DEBUGOUT_RLS_DG_Cons_Req_BRK_f DEBUGOUT_RLS_DG_Cons_Req_CD_f DEBUGOUT_RLS_DG_Cons_Req_HPW_f DEBUGOUT_RLS_DG_No_Request_f /end LOC_MEASUREMENT
 /begin SUB_FUNCTION AL_ACR_DAG_DynamicSupport_VS07_DecisionLogic_ADAS Ca56_ISB_Stateflow Ca73_ISB_Stateflow Ca90_ISB_Stateflow Ca107_ISB_Stateflow Ca124_ISB_Stateflow ELK_Manager VSMA_EBL Ca6_SMA_Comfort_ACB_ABLrear Ca16_SMA_Comfort_ACB_ABLrear Ca26_SMA_Comfort_ACB_ABLrear Ca36_SMA_Comfort_ACB_ABLrear Ca46_SMA_Comfort_ACB_ABLrear Ca141_Detection_of_DynamicBelt_Retraction Ca160_DelayTimerLogic Ca150_DelayTimerLogic Ca155_DelayTimerLogic Ca145_DelayTimerLogic VSMA_PRIO VSMA_HPW VSMA_RLS VSMA_SLR VSMA_BRK VSMA_CRD /end SUB_FUNCTION
/end FUNCTION
/begin FUNCTION Sa400_If_Action_Subsystem "" /begin DEF_CHARACTERISTIC DEBUGIN_OMS_RL1_Rx_Status /end DEF_CHARACTERISTIC /begin LOC_MEASUREMENT DEBUGOUT_OMS_RL1_Rx_Status /end LOC_MEASUREMENT /end FUNCTION
/begin FUNCTION Sa401_If_Action_Subsystem1 ""
 /begin LOC_MEASUREMENT DEBUGOUT_OMS_RL1_Rx_Status panther_can6_in.asw_in_can6_0xB5_rx_status /end LOC_MEASUREMENT
/end FUNCTION
/begin FUNCTION Sa402_If_Action_Subsystem "" /begin DEF_CHARACTERISTIC DEBUGIN_OMS_RL2_OccupantHeightStd_cm /end DEF_CHARACTERISTIC /begin LOC_MEASUREMENT DEBUGOUT_OMS_RL2_OccupantHeightStd_cm /end LOC_MEASUREMENT /end FUNCTION
/begin FUNCTION Sa403_If_Action_Subsystem1 ""
 /begin LOC_MEASUREMENT DEBUGOUT_OMS_RL2_OccupantHeightStd_cm panther_can6_in.asw_in_can6_0xB6_OMS_RL2_OccupantHeightStd_cm /end LOC_MEASUREMENT
/end FUNCTION
/begin FUNCTION Sa404_If_Action_Subsystem "" /begin DEF_CHARACTERISTIC DEBUGIN_OMS_RL2_OccupantHeightMean_cm /end DEF_CHARACTERISTIC /begin LOC_MEASUREMENT DEBUGOUT_OMS_RL2_OccupantHeightMean_cm /end LOC_MEASUREMENT /end FUNCTION
/begin FUNCTION Sa405_If_Action_Subsystem1 ""
 /begin LOC_MEASUREMENT DEBUGOUT_OMS_RL2_OccupantHeightMean_cm panther_can6_in.asw_in_can6_0xB6_OMS_RL2_OccupantHeightMean_cm /end LOC_MEASUREMENT
/end FUNCTION
/begin FUNCTION Sa406_If_Action_Subsystem "" /begin DEF_CHARACTERISTIC DEBUGIN_OMS_RR1_OccupantHeightStd_cm /end DEF_CHARACTERISTIC /begin LOC_MEASUREMENT DEBUGOUT_OMS_RR1_OccupantHeightStd_cm /end LOC_MEASUREMENT /end FUNCTION
/begin FUNCTION Sa407_If_Action_Subsystem1 ""
 /begin LOC_MEASUREMENT DEBUGOUT_OMS_RR1_OccupantHeightStd_cm panther_can6_in.asw_in_can6_0xB7_OMS_RR1_OccupantHeightStd_cm /end LOC_MEASUREMENT
/end FUNCTION
/begin FUNCTION Sa408_If_Action_Subsystem "" /begin DEF_CHARACTERISTIC DEBUGIN_OMS_RR1_OccupantHeightMean_cm /end DEF_CHARACTERISTIC /begin LOC_MEASUREMENT DEBUGOUT_OMS_RR1_OccupantHeightMean_cm /end LOC_MEASUREMENT /end FUNCTION
/begin FUNCTION Sa409_If_Action_Subsystem1 ""
 /begin LOC_MEASUREMENT DEBUGOUT_OMS_RR1_OccupantHeightMean_cm panther_can6_in.asw_in_can6_0xB7_OMS_RR1_OccupantHeightMean_cm /end LOC_MEASUREMENT
/end FUNCTION
/begin FUNCTION Sa410_If_Action_Subsystem "" /begin DEF_CHARACTERISTIC DEBUGIN_OMS_RL2_Rx_Status /end DEF_CHARACTERISTIC /begin LOC_MEASUREMENT DEBUGOUT_OMS_RL2_Rx_Status /end LOC_MEASUREMENT /end FUNCTION
/begin FUNCTION Sa411_If_Action_Subsystem1 ""
 /begin LOC_MEASUREMENT DEBUGOUT_OMS_RL2_Rx_Status panther_can6_in.asw_in_can6_0xB6_rx_status /end LOC_MEASUREMENT
/end FUNCTION
/begin FUNCTION Sa412_If_Action_Subsystem "" /begin DEF_CHARACTERISTIC DEBUGIN_OMS_FL_HandsOnWheel /end DEF_CHARACTERISTIC /begin LOC_MEASUREMENT DEBUGOUT_OMS_FL_HandsOnWheel /end LOC_MEASUREMENT /end FUNCTION
/begin FUNCTION Sa413_If_Action_Subsystem1 ""
 /begin LOC_MEASUREMENT DEBUGOUT_OMS_FL_HandsOnWheel panther_can6_in.asw_in_can6_0xB3_OMS_FL_HandsOnWheel /end LOC_MEASUREMENT
/end FUNCTION
/begin FUNCTION Sa414_If_Action_Subsystem "" /begin DEF_CHARACTERISTIC DEBUGIN_OMS_RR1_Rx_Status /end DEF_CHARACTERISTIC /begin LOC_MEASUREMENT DEBUGOUT_OMS_RR1_Rx_Status /end LOC_MEASUREMENT /end FUNCTION
/begin FUNCTION Sa415_If_Action_Subsystem1 ""
 /begin LOC_MEASUREMENT DEBUGOUT_OMS_RR1_Rx_Status panther_can6_in.asw_in_can6_0xB7_rx_status /end LOC_MEASUREMENT
/end FUNCTION
/begin FUNCTION Sa416_If_Action_Subsystem "" /begin DEF_CHARACTERISTIC DEBUGIN_OMS_RL1_OccupantClassification /end DEF_CHARACTERISTIC /begin LOC_MEASUREMENT DEBUGOUT_OMS_RL1_OccupantClassification /end LOC_MEASUREMENT /end FUNCTION
/begin FUNCTION Sa417_If_Action_Subsystem1 ""
 /begin LOC_MEASUREMENT DEBUGOUT_OMS_RL1_OccupantClassification panther_can6_in.asw_in_can6_0xB5_OMS_RL1_OccupantClassification /end LOC_MEASUREMENT
/end FUNCTION
/begin FUNCTION Sa418_If_Action_Subsystem "" /begin DEF_CHARACTERISTIC DEBUGIN_OMS_FR_OccupantClassification /end DEF_CHARACTERISTIC /begin LOC_MEASUREMENT DEBUGOUT_OMS_FR_OccupantClassification /end LOC_MEASUREMENT /end FUNCTION
/begin FUNCTION Sa419_If_Action_Subsystem1 ""
 /begin LOC_MEASUREMENT DEBUGOUT_OMS_FR_OccupantClassification panther_can6_in.asw_in_can6_0xB4_OMS_FR_OccupantClassification /end LOC_MEASUREMENT
/end FUNCTION
/begin FUNCTION Sa503_If_Action_Subsystem "" /begin DEF_CHARACTERISTIC DEBUGIN_ALO_COM_Status_PumaFLCan /end DEF_CHARACTERISTIC /begin LOC_MEASUREMENT DEBUGOUT_ALO_COM_Status_PumaFLCan /end LOC_MEASUREMENT /end FUNCTION
/begin FUNCTION Sa504_If_Action_Subsystem1 "" /begin LOC_MEASUREMENT DEBUGOUT_ALO_COM_Status_PumaFLCan /end LOC_MEASUREMENT /end FUNCTION
/begin FUNCTION Sa505_If_Action_Subsystem "" /begin DEF_CHARACTERISTIC DEBUGIN_ALO_COM_Status_PumaFRCan /end DEF_CHARACTERISTIC /begin LOC_MEASUREMENT DEBUGOUT_ALO_COM_Status_PumaFRCan /end LOC_MEASUREMENT /end FUNCTION
/begin FUNCTION Sa506_If_Action_Subsystem1 "" /begin LOC_MEASUREMENT DEBUGOUT_ALO_COM_Status_PumaFRCan /end LOC_MEASUREMENT /end FUNCTION
/begin FUNCTION Sa507_If_Action_Subsystem "" /begin DEF_CHARACTERISTIC DEBUGIN_ALO_COM_Status_PumaRL1Can /end DEF_CHARACTERISTIC /begin LOC_MEASUREMENT DEBUGOUT_ALO_COM_Status_PumaRL1Can /end LOC_MEASUREMENT /end FUNCTION
/begin FUNCTION Sa508_If_Action_Subsystem1 "" /begin LOC_MEASUREMENT DEBUGOUT_ALO_COM_Status_PumaRL1Can /end LOC_MEASUREMENT /end FUNCTION
/begin FUNCTION Sa509_If_Action_Subsystem "" /begin DEF_CHARACTERISTIC DEBUGIN_ALO_COM_Status_PumaRL2Can /end DEF_CHARACTERISTIC /begin LOC_MEASUREMENT DEBUGOUT_ALO_COM_Status_PumaRL2Can /end LOC_MEASUREMENT /end FUNCTION
/begin FUNCTION Sa510_If_Action_Subsystem1 "" /begin LOC_MEASUREMENT DEBUGOUT_ALO_COM_Status_PumaRL2Can /end LOC_MEASUREMENT /end FUNCTION
/begin FUNCTION Sa511_If_Action_Subsystem "" /begin DEF_CHARACTERISTIC DEBUGIN_ALO_COM_Status_PumaRR1Can /end DEF_CHARACTERISTIC /begin LOC_MEASUREMENT DEBUGOUT_ALO_COM_Status_PumaRR1Can /end LOC_MEASUREMENT /end FUNCTION
/begin FUNCTION Sa512_If_Action_Subsystem1 "" /begin LOC_MEASUREMENT DEBUGOUT_ALO_COM_Status_PumaRR1Can /end LOC_MEASUREMENT /end FUNCTION
/begin FUNCTION Sa513_If_Action_Subsystem "" /begin DEF_CHARACTERISTIC DEBUGIN_ALO_HB_State_FR /end DEF_CHARACTERISTIC /begin LOC_MEASUREMENT DEBUGOUT_ALO_HB_State_FR /end LOC_MEASUREMENT /end FUNCTION
/begin FUNCTION Sa514_If_Action_Subsystem1 "" /begin LOC_MEASUREMENT DEBUGOUT_ALO_HB_State_FR /end LOC_MEASUREMENT /end FUNCTION
/begin FUNCTION Sa515_If_Action_Subsystem "" /begin DEF_CHARACTERISTIC DEBUGIN_ALO_HB_State_RL1 /end DEF_CHARACTERISTIC /begin LOC_MEASUREMENT DEBUGOUT_ALO_HB_State_RL1 /end LOC_MEASUREMENT /end FUNCTION
/begin FUNCTION Sa516_If_Action_Subsystem1 "" /begin LOC_MEASUREMENT DEBUGOUT_ALO_HB_State_RL1 /end LOC_MEASUREMENT /end FUNCTION
/begin FUNCTION Sa517_If_Action_Subsystem "" /begin DEF_CHARACTERISTIC DEBUGIN_ALO_HB_State_RL2 /end DEF_CHARACTERISTIC /begin LOC_MEASUREMENT DEBUGOUT_ALO_HB_State_RL2 /end LOC_MEASUREMENT /end FUNCTION
/begin FUNCTION Sa518_If_Action_Subsystem1 "" /begin LOC_MEASUREMENT DEBUGOUT_ALO_HB_State_RL2 /end LOC_MEASUREMENT /end FUNCTION
/begin FUNCTION Sa519_If_Action_Subsystem "" /begin DEF_CHARACTERISTIC DEBUGIN_ALO_HB_State_RR1 /end DEF_CHARACTERISTIC /begin LOC_MEASUREMENT DEBUGOUT_ALO_HB_State_RR1 /end LOC_MEASUREMENT /end FUNCTION
/begin FUNCTION Sa520_If_Action_Subsystem1 "" /begin LOC_MEASUREMENT DEBUGOUT_ALO_HB_State_RR1 /end LOC_MEASUREMENT /end FUNCTION
/begin FUNCTION Sa59_If_Action_Subsystem "" /begin DEF_CHARACTERISTIC DEBUGIN_ELK_Lock_Status_RL1 /end DEF_CHARACTERISTIC /begin LOC_MEASUREMENT DEBUGOUT_ELK_Lock_Status_RL1 /end LOC_MEASUREMENT /end FUNCTION
/begin FUNCTION Sa60_If_Action_Subsystem1 ""
 /begin LOC_MEASUREMENT DEBUGOUT_ELK_Lock_Status_RL1 panther_can3_in.asw_in_can3_0x150_Lock_Status_FL /end LOC_MEASUREMENT
/end FUNCTION
/begin FUNCTION Sa61_If_Action_Subsystem "" /begin DEF_CHARACTERISTIC DEBUGIN_ELK_Lock_Status_RL2 /end DEF_CHARACTERISTIC /begin LOC_MEASUREMENT DEBUGOUT_ELK_Lock_Status_RL2 /end LOC_MEASUREMENT /end FUNCTION
/begin FUNCTION Sa62_If_Action_Subsystem1 ""
 /begin LOC_MEASUREMENT DEBUGOUT_ELK_Lock_Status_RL2 panther_can3_in.asw_in_can3_0x150_Lock_Status_FR /end LOC_MEASUREMENT
/end FUNCTION
/begin FUNCTION Sa63_If_Action_Subsystem "" /begin DEF_CHARACTERISTIC DEBUGIN_ELK_Lock_Status_RR1 /end DEF_CHARACTERISTIC /begin LOC_MEASUREMENT DEBUGOUT_ELK_Lock_Status_RR1 /end LOC_MEASUREMENT /end FUNCTION
/begin FUNCTION Sa64_If_Action_Subsystem1 ""
 /begin LOC_MEASUREMENT DEBUGOUT_ELK_Lock_Status_RR1 panther_can3_in.asw_in_can3_0x150_Lock_Status_RL /end LOC_MEASUREMENT
/end FUNCTION
/begin FUNCTION Sa65_If_Action_Subsystem "" /begin DEF_CHARACTERISTIC DEBUGIN_ELK_Algo_Status_RL1 /end DEF_CHARACTERISTIC /begin LOC_MEASUREMENT DEBUGOUT_ELK_Algo_Status_RL1 /end LOC_MEASUREMENT /end FUNCTION
/begin FUNCTION Sa66_If_Action_Subsystem1 ""
 /begin LOC_MEASUREMENT DEBUGOUT_ELK_Algo_Status_RL1 panther_can3_in.asw_in_can3_0x150_Algo_Status_FL /end LOC_MEASUREMENT
/end FUNCTION
/begin FUNCTION Sa67_If_Action_Subsystem "" /begin DEF_CHARACTERISTIC DEBUGIN_ELK_Algo_Status_RL2 /end DEF_CHARACTERISTIC /begin LOC_MEASUREMENT DEBUGOUT_ELK_Algo_Status_RL2 /end LOC_MEASUREMENT /end FUNCTION
/begin FUNCTION Sa68_If_Action_Subsystem1 ""
 /begin LOC_MEASUREMENT DEBUGOUT_ELK_Algo_Status_RL2 panther_can3_in.asw_in_can3_0x150_Algo_Status_FR /end LOC_MEASUREMENT
/end FUNCTION
/begin FUNCTION Sa69_If_Action_Subsystem "" /begin DEF_CHARACTERISTIC DEBUGIN_ELK_Algo_Status_RR1 /end DEF_CHARACTERISTIC /begin LOC_MEASUREMENT DEBUGOUT_ELK_Algo_Status_RR1 /end LOC_MEASUREMENT /end FUNCTION
/begin FUNCTION Sa70_If_Action_Subsystem1 ""
 /begin LOC_MEASUREMENT DEBUGOUT_ELK_Algo_Status_RR1 panther_can3_in.asw_in_can3_0x150_Algo_Status_RL /end LOC_MEASUREMENT
/end FUNCTION
/begin FUNCTION Sa71_If_Action_Subsystem "" /begin DEF_CHARACTERISTIC DEBUGIN_ELK_ECU_Status_RL1 /end DEF_CHARACTERISTIC /begin LOC_MEASUREMENT DEBUGOUT_ELK_ECU_Status_RL1 /end LOC_MEASUREMENT /end FUNCTION
/begin FUNCTION Sa72_If_Action_Subsystem1 ""
 /begin LOC_MEASUREMENT DEBUGOUT_ELK_ECU_Status_RL1 panther_can3_in.asw_in_can3_0x160_ECU_Status_Act_1 /end LOC_MEASUREMENT
/end FUNCTION
/begin FUNCTION Sa73_If_Action_Subsystem "" /begin DEF_CHARACTERISTIC DEBUGIN_ELK_ECU_Status_RL2 /end DEF_CHARACTERISTIC /begin LOC_MEASUREMENT DEBUGOUT_ELK_ECU_Status_RL2 /end LOC_MEASUREMENT /end FUNCTION
/begin FUNCTION Sa74_If_Action_Subsystem1 ""
 /begin LOC_MEASUREMENT DEBUGOUT_ELK_ECU_Status_RL2 panther_can3_in.asw_in_can3_0x160_ECU_Status_Act_2 /end LOC_MEASUREMENT
/end FUNCTION
/begin FUNCTION Sa75_If_Action_Subsystem "" /begin DEF_CHARACTERISTIC DEBUGIN_ELK_ECU_Status_RR1 /end DEF_CHARACTERISTIC /begin LOC_MEASUREMENT DEBUGOUT_ELK_ECU_Status_RR1 /end LOC_MEASUREMENT /end FUNCTION
/begin FUNCTION Sa76_If_Action_Subsystem1 ""
 /begin LOC_MEASUREMENT DEBUGOUT_ELK_ECU_Status_RR1 panther_can3_in.asw_in_can3_0x160_ECU_Status_Act_3 /end LOC_MEASUREMENT
/end FUNCTION
/begin FUNCTION Sa93_If_Action_Subsystem "" /begin DEF_CHARACTERISTIC DEBUGIN_HMI_ABL_Rx_Status /end DEF_CHARACTERISTIC /begin LOC_MEASUREMENT DEBUGOUT_HMI_ABL_Rx_Status /end LOC_MEASUREMENT /end FUNCTION
/begin FUNCTION Sa94_If_Action_Subsystem1 ""
 /begin LOC_MEASUREMENT DEBUGOUT_HMI_ABL_Rx_Status panther_can6_in.asw_in_can6_0x90_rx_status /end LOC_MEASUREMENT
/end FUNCTION
/begin FUNCTION Sa95_If_Action_Subsystem "" /begin DEF_CHARACTERISTIC DEBUGIN_HMI_ABL_FR_RetractRequest /end DEF_CHARACTERISTIC /begin LOC_MEASUREMENT DEBUGOUT_HMI_ABL_FR_RetractRequest /end LOC_MEASUREMENT /end FUNCTION
/begin FUNCTION Sa96_If_Action_Subsystem1 ""
 /begin LOC_MEASUREMENT DEBUGOUT_HMI_ABL_FR_RetractRequest panther_can6_in.asw_in_can6_0x90_ABL_FR_RetractRequest /end LOC_MEASUREMENT
/end FUNCTION
/begin FUNCTION Sa97_If_Action_Subsystem "" /begin DEF_CHARACTERISTIC DEBUGIN_HMI_ABL_FL_RetractRequest /end DEF_CHARACTERISTIC /begin LOC_MEASUREMENT DEBUGOUT_HMI_ABL_FL_RetractRequest /end LOC_MEASUREMENT /end FUNCTION
/begin FUNCTION Sa98_If_Action_Subsystem1 ""
 /begin LOC_MEASUREMENT DEBUGOUT_HMI_ABL_FL_RetractRequest panther_can6_in.asw_in_can6_0x90_ABL_FL_RetractRequest /end LOC_MEASUREMENT
/end FUNCTION
/begin FUNCTION Sa99_If_Action_Subsystem "" /begin DEF_CHARACTERISTIC DEBUGIN_HMI_ABL_RL1_RetractRequest /end DEF_CHARACTERISTIC /begin LOC_MEASUREMENT DEBUGOUT_HMI_ABL_RL1_RetractRequest /end LOC_MEASUREMENT /end FUNCTION
/begin FUNCTION SELK_Manager14_If_Action_Subsystem "" /begin DEF_CHARACTERISTIC SELK_Manager14_DEBUGIN_Error_detected /end DEF_CHARACTERISTIC /begin LOC_MEASUREMENT SELK_Manager11_DEBUGOUT_Error_detected /end LOC_MEASUREMENT /end FUNCTION
/begin FUNCTION SELK_Manager15_If_Action_Subsystem1 "" /begin LOC_MEASUREMENT SELK_Manager11_DEBUGOUT_Error_detected /end LOC_MEASUREMENT /end FUNCTION
/begin FUNCTION SELK_Manager16_If_Action_Subsystem "" /begin DEF_CHARACTERISTIC DEBUGIN_ELK_WriteMemotyRequest_RL1_bool /end DEF_CHARACTERISTIC /begin LOC_MEASUREMENT DEBUGOUT_ELK_WriteMemotyRequest_RL1_bool /end LOC_MEASUREMENT /end FUNCTION
/begin FUNCTION SELK_Manager17_If_Action_Subsystem1 ""
 /begin LOC_MEASUREMENT ELK_WriteMemotyRequest_RL1_bool DEBUGOUT_ELK_WriteMemotyRequest_RL1_bool /end LOC_MEASUREMENT
/end FUNCTION
/begin FUNCTION SELK_Manager18_If_Action_Subsystem "" /begin DEF_CHARACTERISTIC DEBUGIN_ELK_WriteErrorCounter_RL1_Int16 /end DEF_CHARACTERISTIC /begin LOC_MEASUREMENT DEBUGOUT_ELK_WriteErrorCounter_RL1_Int16 /end LOC_MEASUREMENT /end FUNCTION
/begin FUNCTION SELK_Manager19_If_Action_Subsystem1 ""
 /begin LOC_MEASUREMENT ELK_WriteErrorCounter_RL1_Int16 DEBUGOUT_ELK_WriteErrorCounter_RL1_Int16 /end LOC_MEASUREMENT
/end FUNCTION
/begin FUNCTION SELK_Manager25_If_Action_Subsystem "" /begin DEF_CHARACTERISTIC SELK_Manager25_DEBUGIN_Error_detected /end DEF_CHARACTERISTIC /begin LOC_MEASUREMENT SELK_Manager22_DEBUGOUT_Error_detected /end LOC_MEASUREMENT /end FUNCTION
/begin FUNCTION SELK_Manager26_If_Action_Subsystem1 "" /begin LOC_MEASUREMENT SELK_Manager22_DEBUGOUT_Error_detected /end LOC_MEASUREMENT /end FUNCTION
/begin FUNCTION SELK_Manager27_If_Action_Subsystem "" /begin DEF_CHARACTERISTIC DEBUGIN_ELK_WriteMemotyRequest_RL2_bool /end DEF_CHARACTERISTIC /begin LOC_MEASUREMENT DEBUGOUT_ELK_WriteMemotyRequest_RL2_bool /end LOC_MEASUREMENT /end FUNCTION
/begin FUNCTION SELK_Manager28_If_Action_Subsystem1 ""
 /begin LOC_MEASUREMENT ELK_WriteMemotyRequest_RL2_bool DEBUGOUT_ELK_WriteMemotyRequest_RL2_bool /end LOC_MEASUREMENT
/end FUNCTION
/begin FUNCTION SELK_Manager29_If_Action_Subsystem "" /begin DEF_CHARACTERISTIC DEBUGIN_ELK_WriteErrorCounter_RL2_Int16 /end DEF_CHARACTERISTIC /begin LOC_MEASUREMENT DEBUGOUT_ELK_WriteErrorCounter_RL2_Int16 /end LOC_MEASUREMENT /end FUNCTION
/begin FUNCTION SELK_Manager30_If_Action_Subsystem1 ""
 /begin LOC_MEASUREMENT ELK_WriteErrorCounter_RL2_Int16 DEBUGOUT_ELK_WriteErrorCounter_RL2_Int16 /end LOC_MEASUREMENT
/end FUNCTION
/begin FUNCTION SELK_Manager36_If_Action_Subsystem "" /begin DEF_CHARACTERISTIC SELK_Manager36_DEBUGIN_Error_detected /end DEF_CHARACTERISTIC /begin LOC_MEASUREMENT SELK_Manager33_DEBUGOUT_Error_detected /end LOC_MEASUREMENT /end FUNCTION
/begin FUNCTION SELK_Manager37_If_Action_Subsystem1 "" /begin LOC_MEASUREMENT SELK_Manager33_DEBUGOUT_Error_detected /end LOC_MEASUREMENT /end FUNCTION
/begin FUNCTION SELK_Manager38_If_Action_Subsystem "" /begin DEF_CHARACTERISTIC DEBUGIN_ELK_WriteMemotyRequest_RR1_bool /end DEF_CHARACTERISTIC /begin LOC_MEASUREMENT DEBUGOUT_ELK_WriteMemotyRequest_RR1_bool /end LOC_MEASUREMENT /end FUNCTION
/begin FUNCTION SELK_Manager39_If_Action_Subsystem1 ""
 /begin LOC_MEASUREMENT ELK_WriteMemotyRequest_RR1_bool DEBUGOUT_ELK_WriteMemotyRequest_RR1_bool /end LOC_MEASUREMENT
/end FUNCTION
/begin FUNCTION SELK_Manager40_If_Action_Subsystem "" /begin DEF_CHARACTERISTIC DEBUGIN_ELK_WriteErrorCounter_RR1_Int16 /end DEF_CHARACTERISTIC /begin LOC_MEASUREMENT DEBUGOUT_ELK_WriteErrorCounter_RR1_Int16 /end LOC_MEASUREMENT /end FUNCTION
/begin FUNCTION SELK_Manager41_If_Action_Subsystem1 ""
 /begin LOC_MEASUREMENT ELK_WriteErrorCounter_RR1_Int16 DEBUGOUT_ELK_WriteErrorCounter_RR1_Int16 /end LOC_MEASUREMENT
/end FUNCTION
/begin FUNCTION SVSMA_CRD7_Path104 "" /begin LOC_MEASUREMENT DEBUGOUT_criticality_index_sum /end LOC_MEASUREMENT /end FUNCTION
/begin FUNCTION SVSMA_HPW2__VSMA_AEB_Autonomous_Emergency_Braking "" /begin DEF_CHARACTERISTIC SVSMA_HPW2_AEB_L1_Enable SVSMA_HPW2_AEB_L2_Enable /end DEF_CHARACTERISTIC /begin LOC_MEASUREMENT AEB_Level1 AEB_Level2 ALI_AEB_Brk_Request /end LOC_MEASUREMENT /end FUNCTION
/begin RECORD_LAYOUT SWORD_COL_DIRECT FNC_VALUES 1 SWORD COLUMN_DIR DIRECT /end RECORD_LAYOUT
/begin RECORD_LAYOUT UBYTE_COL_DIRECT FNC_VALUES 1 UBYTE COLUMN_DIR DIRECT /end RECORD_LAYOUT
/begin RECORD_LAYOUT UWORD_COL_DIRECT FNC_VALUES 1 UWORD COLUMN_DIR DIRECT /end RECORD_LAYOUT
/end MODULE
/end PROJECT
