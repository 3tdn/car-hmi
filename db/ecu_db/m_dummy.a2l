/begin PROJECT Mercedes_Common_ECU ""
/begin HEADER "" /* A2L File Structure (ASAM MCD-2 MC) */ /* - PROJECT: top-level container for the A2L file. */ /* - HEADER: metadata (version, project number, description). */ /* - MODULE: ECU module grouping (e.g., ECM, TCM). */ /* - MOD_PAR / MOD_COMMON: module parameters and alignment requirements. */ /* - COMPU_METHOD: conversion functions (raw <-> physical units). */ /* - MEASUREMENT: read-only signal descriptions (address, data type, scaling). */ /* - CHARACTERISTIC: read/write parameters (calibration values). */ /* - AXIS_PTS / CURVE: lookup tables definition. */ /* - IF_DATA / DAQ_EVENT: measurement recording configuration (XCP/CCP). */ /* - NOTE: A2L uses a nested /begin ... /end block structure. */ VERSION "Mercedes-Benz Common ECU - A2L v1.0" PROJECT_NO M001 /end HEADER
/begin MODULE ECM "Engine Control Module - engine controller"
/begin MOD_PAR ""
 SYSTEM_CONSTANT "CPU_TYPE" "TriCore TC39x"
 SYSTEM_CONSTANT "EPK" "MED177_V1.0_Mercedes"
 SYSTEM_CONSTANT "FLASH_SIZE" "8MB"
 SYSTEM_CONSTANT "RAM_SIZE" "1MB" /end MOD_PAR
/begin MOD_COMMON "" BYTE_ORDER MSB_LAST ALIGNMENT_BYTE 1 ALIGNMENT_WORD 2 ALIGNMENT_LONG 4 ALIGNMENT_FLOAT32_IEEE 4 ALIGNMENT_FLOAT64_IEEE 8 /end MOD_COMMON
/* =====================================================================
* COMPU_METHODs - Value conversion methods
* ===================================================================== */
/begin COMPU_METHOD CM_Percent "" RAT_FUNC "%6.2" "%" COEFFS 0 1 0 0 0 0.392157 /end COMPU_METHOD
/begin COMPU_METHOD CM_DegC_Offset40 "" RAT_FUNC "%6.1" "degC" COEFFS 0 1 40 0 0 1 /end COMPU_METHOD
/begin COMPU_METHOD CM_RPM "" RAT_FUNC "%7.2" "rpm" COEFFS 0 1 0 0 0 0.25 /end COMPU_METHOD
/begin COMPU_METHOD CM_KPH "" RAT_FUNC "%6.2" "km/h" COEFFS 0 1 0 0 0 0.01 /end COMPU_METHOD
/begin COMPU_METHOD CM_Nm "" RAT_FUNC "%7.1" "Nm" COEFFS 0 1 500 0 0 0.5 /end COMPU_METHOD
/begin COMPU_METHOD CM_Voltage "" RAT_FUNC "%5.2" "V" COEFFS 0 1 0 0 0 0.01 /end COMPU_METHOD
/begin COMPU_METHOD CM_Bar "" RAT_FUNC "%5.1" "bar" COEFFS 0 1 0 0 0 0.1 /end COMPU_METHOD
/begin COMPU_METHOD CM_Deg "" RAT_FUNC "%7.1" "deg" COEFFS 0 1 3200 0 0 0.1 /end COMPU_METHOD
/begin COMPU_METHOD CM_KPA "" RAT_FUNC "%6.1" "kPa" COEFFS 0 1 0 0 0 0.1 /end COMPU_METHOD
/begin COMPU_METHOD CM_LPer100 "" RAT_FUNC "%5.2" "L/100km" COEFFS 0 1 0 0 0 0.01 /end COMPU_METHOD
/begin COMPU_METHOD CM_ms "" RAT_FUNC "%6.2" "ms" COEFFS 0 1 0 0 0 0.001 /end COMPU_METHOD
/begin COMPU_METHOD CM_Kg_per_h "" RAT_FUNC "%6.2" "kg/h" COEFFS 0 1 0 0 0 0.1 /end COMPU_METHOD
/begin COMPU_METHOD CM_Lambda "" RAT_FUNC "%5.4" "lambda" COEFFS 0 1 0 0 0 0.0001 /end COMPU_METHOD
/begin COMPU_METHOD CM_kW "" RAT_FUNC "%6.1" "kW" COEFFS 0 1 0 0 0 0.1 /end COMPU_METHOD
/begin COMPU_METHOD CM_NoUnit "" RAT_FUNC "%6.2" "" COEFFS 0 1 0 0 0 1 /end COMPU_METHOD
/* =====================================================================
* MEASUREMENTS - Measurement signals (read-only from the ECU)
* ===================================================================== */
/* ---- ENGINE / Engine ---- */
/begin MEASUREMENT N_Engine /* Engine speed (rpm) */ "Engine speed - engine speed" UWORD CM_RPM 0 0 0 16383.75 ECU_ADDRESS 0xD0001000 /begin IF_DATA XCP DAQ_EVENT FIXED_EVENT_LIST EVENT 0x0001 /end IF_DATA /end MEASUREMENT
/begin MEASUREMENT rL_Engine /* Engine load (%) */ "Engine load - engine load" UBYTE CM_Percent 0 0 0 100 ECU_ADDRESS 0xD0001002 /end MEASUREMENT
/begin MEASUREMENT wdkba /* Throttle position (%) */ "Throttle position - throttle position" UBYTE CM_Percent 0 0 0 100 ECU_ADDRESS 0xD0001003 /end MEASUREMENT
/begin MEASUREMENT T_Coolant /* Coolant temperature (°C) */ "Coolant temperature - coolant temperature" UBYTE CM_DegC_Offset40 0 0 -40 215 ECU_ADDRESS 0xD0001004 /end MEASUREMENT
/begin MEASUREMENT T_Oil /* Engine oil temperature (°C) */ "Oil temperature - engine oil temperature" UBYTE CM_DegC_Offset40 0 0 -40 215 ECU_ADDRESS 0xD0001005 /end MEASUREMENT
/begin MEASUREMENT P_Oil /* Engine oil pressure (kPa) */ "Oil pressure - engine oil pressure" UBYTE CM_KPA 0 0 0 1020 ECU_ADDRESS 0xD0001006 /end MEASUREMENT
/begin MEASUREMENT T_IntakeAir /* Intake air temperature (°C) */ "Intake air temperature - intake air temperature" UBYTE CM_DegC_Offset40 0 0 -40 215 ECU_ADDRESS 0xD0001007 /end MEASUREMENT
/begin MEASUREMENT P_Boost /* Boost pressure (kPa) */ "Boost pressure - boost pressure (turbo)" UWORD CM_KPA 0 0 0 6553.5 ECU_ADDRESS 0xD0001008 /end MEASUREMENT
/begin MEASUREMENT M_Engine /* Actual engine torque (Nm) */ "Actual engine torque - actual engine torque" SWORD CM_Nm 0 0 -500 1547.5 ECU_ADDRESS 0xD000100A /end MEASUREMENT
/begin MEASUREMENT M_EngineReq /* Requested engine torque (Nm) */ "Requested torque - requested torque" SWORD CM_Nm 0 0 -500 1547.5 ECU_ADDRESS 0xD000100C /end MEASUREMENT
/begin MEASUREMENT P_Engine /* Engine power (kW) */ "Engine power - engine power" UWORD CM_kW 0 0 0 500 ECU_ADDRESS 0xD000100E /end MEASUREMENT
/begin MEASUREMENT Q_Fuel_Instant /* Instant fuel consumption (L/100km) */ "Instant fuel consumption - instant fuel consumption" UWORD CM_LPer100 0 0 0 163.83 ECU_ADDRESS 0xD0001010 /end MEASUREMENT
/begin MEASUREMENT Q_Fuel_Avg /* Average fuel consumption (L/100km) */ "Average fuel consumption - average fuel consumption" UWORD CM_LPer100 0 0 0 163.83 ECU_ADDRESS 0xD0001012 /end MEASUREMENT
/begin MEASUREMENT Q_AirMass /* Intake air mass flow (kg/h) */ "Air mass flow - intake air mass flow" UWORD CM_Kg_per_h 0 0 0 1000 ECU_ADDRESS 0xD0001014 /end MEASUREMENT
/begin MEASUREMENT Lambda_Bank1 /* Lambda factor for cylinder bank 1 */ "Lambda bank 1 - lambda factor for bank 1" UWORD CM_Lambda 0 0 0.5 2.0 ECU_ADDRESS 0xD0001016 /end MEASUREMENT
/begin MEASUREMENT Lambda_Bank2 /* Lambda factor for cylinder bank 2 */ "Lambda bank 2 - lambda factor for bank 2" UWORD CM_Lambda 0 0 0.5 2.0 ECU_ADDRESS 0xD0001018 /end MEASUREMENT
/begin MEASUREMENT ti_Injection /* Fuel injection time (ms) */ "Injection time - fuel injection time" UWORD CM_ms 0 0 0 65.535 ECU_ADDRESS 0xD000101A /end MEASUREMENT
/begin MEASUREMENT phi_Ignition /* Ignition timing angle (deg) */ "Ignition angle - ignition timing angle" SWORD CM_Deg 0 0 -60 60 ECU_ADDRESS 0xD000101C /end MEASUREMENT
/begin MEASUREMENT cnt_MisfireCyl1 /* Cylinder 1 misfire count */ "Misfire counter cylinder 1 - cylinder 1 misfire count" UWORD CM_NoUnit 0 0 0 65535 ECU_ADDRESS 0xD000101E /end MEASUREMENT
/begin MEASUREMENT cnt_MisfireCyl2 /* Cylinder 2 misfire count */ "Misfire counter cylinder 2 - cylinder 2 misfire count" UWORD CM_NoUnit 0 0 0 65535 ECU_ADDRESS 0xD0001020 /end MEASUREMENT
/begin MEASUREMENT cnt_MisfireCyl3 /* Cylinder 3 misfire count */ "Misfire counter cylinder 3 - cylinder 3 misfire count" UWORD CM_NoUnit 0 0 0 65535 ECU_ADDRESS 0xD0001022 /end MEASUREMENT
/begin MEASUREMENT cnt_MisfireCyl4 /* Cylinder 4 misfire count */ "Misfire counter cylinder 4 - cylinder 4 misfire count" UWORD CM_NoUnit 0 0 0 65535 ECU_ADDRESS 0xD0001024 /end MEASUREMENT
/* ---- VEHICLE DYNAMICS / Vehicle dynamics ---- */
/begin MEASUREMENT V_Vehicle /* Vehicle speed (km/h) */ "Vehicle speed - vehicle speed" UWORD CM_KPH 0 0 0 655.35 ECU_ADDRESS 0xD0002000 /begin IF_DATA XCP DAQ_EVENT FIXED_EVENT_LIST EVENT 0x0001 /end IF_DATA /end MEASUREMENT
/begin MEASUREMENT V_Wheel_FL /* Front-left wheel speed (km/h) */ "Front left wheel speed - front-left wheel speed" UWORD CM_KPH 0 0 0 655.35 ECU_ADDRESS 0xD0002002 /end MEASUREMENT
/begin MEASUREMENT V_Wheel_FR /* Front-right wheel speed (km/h) */ "Front right wheel speed - front-right wheel speed" UWORD CM_KPH 0 0 0 655.35 ECU_ADDRESS 0xD0002004 /end MEASUREMENT
/begin MEASUREMENT V_Wheel_RL /* Rear-left wheel speed (km/h) */ "Rear left wheel speed - rear-left wheel speed" UWORD CM_KPH 0 0 0 655.35 ECU_ADDRESS 0xD0002006 /end MEASUREMENT
/begin MEASUREMENT V_Wheel_RR /* Rear-right wheel speed (km/h) */ "Rear right wheel speed - rear-right wheel speed" UWORD CM_KPH 0 0 0 655.35 ECU_ADDRESS 0xD0002008 /end MEASUREMENT
/begin MEASUREMENT a_Lateral /* Lateral acceleration (g) */ "Lateral acceleration - lateral acceleration" SWORD CM_NoUnit 0 0 -2.0 2.0 ECU_ADDRESS 0xD000200A /end MEASUREMENT
/begin MEASUREMENT a_Longitudinal /* Longitudinal acceleration (g) */ "Longitudinal acceleration - longitudinal acceleration" SWORD CM_NoUnit 0 0 -2.0 2.0 ECU_ADDRESS 0xD000200C /end MEASUREMENT
/begin MEASUREMENT omega_Yaw /* Yaw rate (deg/s) */ "Yaw rate - yaw rate" SWORD CM_Deg 0 0 -327.68 327.67 ECU_ADDRESS 0xD000200E /end MEASUREMENT
/begin MEASUREMENT phi_Steering /* Steering wheel angle (deg) */ "Steering angle - steering wheel angle" SWORD CM_Deg 0 0 -3200 3200 ECU_ADDRESS 0xD0002010 /end MEASUREMENT
/begin MEASUREMENT P_BrakeMaster /* Master brake cylinder pressure (bar) */ "Master cylinder pressure - master brake cylinder pressure" UWORD CM_Bar 0 0 0 409.5 ECU_ADDRESS 0xD0002012 /end MEASUREMENT
/* ---- TRANSMISSION / Transmission ---- */
/begin MEASUREMENT Gear_Current /* Current gear */ "Current gear - current gear" UBYTE CM_NoUnit 0 0 0 9 ECU_ADDRESS 0xD0003000 /end MEASUREMENT
/begin MEASUREMENT Gear_Target /* Target gear */ "Target gear - target gear" UBYTE CM_NoUnit 0 0 0 9 ECU_ADDRESS 0xD0003001 /end MEASUREMENT
/begin MEASUREMENT T_Transmission /* Transmission temperature (°C) */ "Transmission temperature - transmission temperature" UBYTE CM_DegC_Offset40 0 0 -40 215 ECU_ADDRESS 0xD0003002 /end MEASUREMENT
/begin MEASUREMENT N_TransInput /* Transmission input shaft speed (rpm) */ "Trans input speed - transmission input shaft speed" UWORD CM_RPM 0 0 0 16383.75 ECU_ADDRESS 0xD0003004 /end MEASUREMENT
/begin MEASUREMENT N_TransOutput /* Transmission output shaft speed (rpm) */ "Trans output speed - transmission output shaft speed" UWORD CM_RPM 0 0 0 16383.75 ECU_ADDRESS 0xD0003006 /end MEASUREMENT
/begin MEASUREMENT ratio_Gear /* Gear ratio */ "Gear ratio - gear ratio" UWORD CM_NoUnit 0 0 0 65.535 ECU_ADDRESS 0xD0003008 /end MEASUREMENT
/* ---- ELECTRICAL / Electrical ---- */
/begin MEASUREMENT U_Battery /* Battery voltage (V) */ "Battery voltage - battery voltage" UWORD CM_Voltage 0 0 0 40.95 ECU_ADDRESS 0xD0004000 /end MEASUREMENT
/begin MEASUREMENT U_Alternator /* Alternator voltage (V) */ "Alternator voltage - alternator voltage" UWORD CM_Voltage 0 0 0 40.95 ECU_ADDRESS 0xD0004002 /end MEASUREMENT
/* ---- EV / HYBRID - High-voltage battery & electric motor ---- */
/begin MEASUREMENT SoC_HVBattery /* High-voltage battery state of charge (%) */ "HV Battery state of charge - high-voltage battery state of charge" UWORD CM_Percent 0 0 0 100 ECU_ADDRESS 0xD0005000 /begin IF_DATA XCP DAQ_EVENT FIXED_EVENT_LIST EVENT 0x0002 /end IF_DATA /end MEASUREMENT
/begin MEASUREMENT U_HVBattery /* High-voltage battery voltage (V) */ "HV Battery voltage - high-voltage battery voltage" UWORD CM_Voltage 0 0 0 1023.75 ECU_ADDRESS 0xD0005002 /end MEASUREMENT
/begin MEASUREMENT I_HVBattery /* High-voltage battery current (A) */ "HV Battery current - high-voltage battery current" SWORD CM_NoUnit 0 0 -512 511.75 ECU_ADDRESS 0xD0005004 /end MEASUREMENT
/begin MEASUREMENT T_HVBattery /* High-voltage battery temperature (°C) */ "HV Battery temperature - high-voltage battery temperature" UBYTE CM_DegC_Offset40 0 0 -40 215 ECU_ADDRESS 0xD0005006 /end MEASUREMENT
/begin MEASUREMENT P_HVBattery /* High-voltage battery power (kW) */ "HV Battery power - high-voltage battery power" SWORD CM_kW 0 0 -819.2 819.1 ECU_ADDRESS 0xD0005008 /end MEASUREMENT
/begin MEASUREMENT SoH_HVBattery /* High-voltage battery state of health (%) */ "HV Battery state of health - high-voltage battery state of health" UBYTE CM_Percent 0 0 0 100 ECU_ADDRESS 0xD000500A /end MEASUREMENT
/begin MEASUREMENT N_ElecMotor /* Electric motor speed (rpm) */ "Electric motor speed - electric motor speed" SWORD CM_RPM 0 0 -30000 30000 ECU_ADDRESS 0xD0005010 /end MEASUREMENT
/begin MEASUREMENT M_ElecMotor /* Electric motor torque (Nm) */ "Electric motor torque - electric motor torque" SWORD CM_Nm 0 0 -500 1547.5 ECU_ADDRESS 0xD0005012 /end MEASUREMENT
/begin MEASUREMENT T_ElecMotor /* Electric motor temperature (°C) */ "Electric motor temperature - electric motor temperature" UBYTE CM_DegC_Offset40 0 0 -40 215 ECU_ADDRESS 0xD0005014 /end MEASUREMENT
/begin MEASUREMENT T_Inverter /* Inverter temperature (°C) */ "Inverter temperature - inverter temperature" UBYTE CM_DegC_Offset40 0 0 -40 215 ECU_ADDRESS 0xD0005015 /end MEASUREMENT
/* ---- EXHAUST - Exhaust ---- */
/begin MEASUREMENT T_ExhaustPreCat /* Pre-catalyst exhaust temperature (°C) */ "Pre-catalyst exhaust temp - pre-catalyst exhaust temperature" UWORD CM_DegC_Offset40 0 0 -40 1200 ECU_ADDRESS 0xD0006000 /end MEASUREMENT
/begin MEASUREMENT T_ExhaustPostCat /* Post-catalyst exhaust temperature (°C) */ "Post-catalyst exhaust temp - post-catalyst exhaust temperature" UWORD CM_DegC_Offset40 0 0 -40 1200 ECU_ADDRESS 0xD0006002 /end MEASUREMENT
/begin MEASUREMENT T_DPF /* DPF filter temperature (°C) */ "DPF temperature - DPF filter temperature" UWORD CM_DegC_Offset40 0 0 -40 1200 ECU_ADDRESS 0xD0006004 /end MEASUREMENT
/begin MEASUREMENT P_DPF_Diff /* DPF filter differential pressure (kPa) */ "DPF differential pressure - DPF filter differential pressure" UWORD CM_KPA 0 0 0 100 ECU_ADDRESS 0xD0006006 /end MEASUREMENT
/begin MEASUREMENT pct_DPF_Soot /* DPF soot load (%) */ "DPF soot load - DPF soot load" UBYTE CM_Percent 0 0 0 100 ECU_ADDRESS 0xD0006008 /end MEASUREMENT
/* =====================================================================
* CHARACTERISTICS - Calibration parameters (read/write)
* ===================================================================== */
/* ---- ENGINE CALIBRATION / Engine calibration ---- */
/begin CHARACTERISTIC KL_N_EngineIdle /* Target idle speed (rpm) */ "Target idle speed - target idle speed" VALUE 0xC0001000 RL_Scalar 0 CM_RPM 0 2000 /end CHARACTERISTIC
/begin CHARACTERISTIC KL_N_EngineIdleWarm /* Warm idle speed (rpm) */ "Warm idle speed - warm idle speed" VALUE 0xC0001002 RL_Scalar 0 CM_RPM 0 2000 /end CHARACTERISTIC
/begin CHARACTERISTIC KL_N_EngineRevLimit /* Maximum engine speed limit (rpm) */ "Rev limit - maximum engine speed limit" VALUE 0xC0001004 RL_Scalar 0 CM_RPM 0 10000 /end CHARACTERISTIC
/begin CHARACTERISTIC KF_M_Torque_Limit /* Maximum torque limit (Nm) */ "Max torque limit - maximum torque limit" VALUE 0xC0001006 RL_Scalar 0 CM_Nm 0 1000 /end CHARACTERISTIC
/begin CHARACTERISTIC KF_Lambda_Target_Bank1 /* Lambda target for bank 1 */ "Lambda target bank 1 - lambda target for bank 1" VALUE 0xC0001008 RL_Scalar 0 CM_Lambda 0.5 2.0 /end CHARACTERISTIC
/begin CHARACTERISTIC KF_Lambda_Target_Bank2 /* Lambda target for bank 2 */ "Lambda target bank 2 - lambda target for bank 2" VALUE 0xC000100A RL_Scalar 0 CM_Lambda 0.5 2.0 /end CHARACTERISTIC
/* ---- INJECTION MAP / Injection map ---- */
/begin CHARACTERISTIC KFTI_Injection_BaseMap /* Base injection map by RPM x Load */ "Base injection map (RPM x Load) - base injection map" MAP 0xC0002000 RL_Map 0 CM_ms 0 65.535 /begin AXIS_DESCR STD_AXIS N_Engine CM_RPM 16 0 8000 /end AXIS_DESCR /begin AXIS_DESCR STD_AXIS rL_Engine CM_Percent 16 0 100 /end AXIS_DESCR /end CHARACTERISTIC
/begin CHARACTERISTIC KFTI_Injection_ColdCorr /* Cold-start injection correction map */ "Cold start injection correction - cold-start injection correction map" CURVE 0xC0002200 RL_Curve 0 CM_Percent -50 100 /begin AXIS_DESCR STD_AXIS T_Coolant CM_DegC_Offset40 16 -40 120 /end AXIS_DESCR /end CHARACTERISTIC
/* ---- IGNITION MAP / Ignition map ---- */
/begin CHARACTERISTIC KFZW_Ignition_BaseMap /* Base ignition map by RPM x Load */ "Base ignition map (RPM x Load) - base ignition map" MAP 0xC0003000 RL_Map 0 CM_Deg -60 60 /begin AXIS_DESCR STD_AXIS N_Engine CM_RPM 16 0 8000 /end AXIS_DESCR /begin AXIS_DESCR STD_AXIS rL_Engine CM_Percent 16 0 100 /end AXIS_DESCR /end CHARACTERISTIC
/begin CHARACTERISTIC KFZW_Ignition_KnockRet /* Knock-retard ignition map */ "Knock retard map - knock-retard ignition map" MAP 0xC0003200 RL_Map 0 CM_Deg -20 0 /begin AXIS_DESCR STD_AXIS N_Engine CM_RPM 16 0 8000 /end AXIS_DESCR /begin AXIS_DESCR STD_AXIS rL_Engine CM_Percent 16 0 100 /end AXIS_DESCR /end CHARACTERISTIC
/* ---- BOOST CONTROL / Boost control ---- */
/begin CHARACTERISTIC KFLD_BoostTarget /* Target boost pressure by RPM x Load */ "Target boost pressure (RPM x Load) - target boost pressure" MAP 0xC0004000 RL_Map 0 CM_KPA 0 350 /begin AXIS_DESCR STD_AXIS N_Engine CM_RPM 16 0 8000 /end AXIS_DESCR /begin AXIS_DESCR STD_AXIS rL_Engine CM_Percent 16 0 100 /end AXIS_DESCR /end CHARACTERISTIC
/begin CHARACTERISTIC KL_WG_DutyCycle /* Turbo wastegate duty cycle */ "Wastegate duty cycle - turbo wastegate duty cycle" MAP 0xC0004200 RL_Map 0 CM_Percent 0 100 /begin AXIS_DESCR STD_AXIS N_Engine CM_RPM 16 0 8000 /end AXIS_DESCR /begin AXIS_DESCR STD_AXIS P_Boost CM_KPA 16 0 350 /end AXIS_DESCR /end CHARACTERISTIC
/* ---- TRANSMISSION CALIBRATION / Transmission calibration ---- */
/begin CHARACTERISTIC KFSCH_ShiftUp /* Upshift map */ "Upshift map (speed x throttle) - upshift map" MAP 0xC0005000 RL_Map 0 CM_NoUnit 1 9 /begin AXIS_DESCR STD_AXIS V_Vehicle CM_KPH 16 0 300 /end AXIS_DESCR /begin AXIS_DESCR STD_AXIS wdkba CM_Percent 16 0 100 /end AXIS_DESCR /end CHARACTERISTIC
/begin CHARACTERISTIC KFSCH_ShiftDown /* Downshift map */ "Downshift map (speed x throttle) - downshift map" MAP 0xC0005200 RL_Map 0 CM_NoUnit 1 9 /begin AXIS_DESCR STD_AXIS V_Vehicle CM_KPH 16 0 300 /end AXIS_DESCR /begin AXIS_DESCR STD_AXIS wdkba CM_Percent 16 0 100 /end AXIS_DESCR /end CHARACTERISTIC
/begin CHARACTERISTIC KL_TCC_LockupSpeed /* Torque converter lockup speed */ "Torque converter lockup speed - torque converter lockup speed" CURVE 0xC0005400 RL_Curve 0 CM_KPH 0 300 /begin AXIS_DESCR STD_AXIS Gear_Current CM_NoUnit 9 1 9 /end AXIS_DESCR /end CHARACTERISTIC
/* ---- IDLE CONTROL / Idle control ---- */
/begin CHARACTERISTIC KLTA_IdleSpeed_vs_Coolant /* Idle speed vs coolant temperature */ "Idle speed vs coolant temp - idle speed vs coolant temperature" CURVE 0xC0006000 RL_Curve 0 CM_RPM 500 2000 /begin AXIS_DESCR STD_AXIS T_Coolant CM_DegC_Offset40 16 -40 120 /end AXIS_DESCR /end CHARACTERISTIC
/begin CHARACTERISTIC KL_IdleAir_vs_Coolant /* Idle air vs coolant temperature */ "Idle air vs coolant temp - idle air vs coolant temperature" CURVE 0xC0006100 RL_Curve 0 CM_Percent 0 100 /begin AXIS_DESCR STD_AXIS T_Coolant CM_DegC_Offset40 16 -40 120 /end AXIS_DESCR /end CHARACTERISTIC
/* ---- COOLING FAN / Cooling fan ---- */
/begin CHARACTERISTIC KL_FanSpeed_vs_Coolant /* Fan speed vs coolant temperature */ "Fan speed vs coolant temp - fan speed vs coolant temperature" CURVE 0xC0006200 RL_Curve 0 CM_Percent 0 100 /begin AXIS_DESCR STD_AXIS T_Coolant CM_DegC_Offset40 16 60 120 /end AXIS_DESCR /end CHARACTERISTIC
/begin CHARACTERISTIC KL_FanOn_Threshold /* Fan-on threshold (°C) */ "Fan on threshold - fan-on threshold" VALUE 0xC0006300 RL_Scalar 0 CM_DegC_Offset40 60 120 /end CHARACTERISTIC
/begin CHARACTERISTIC KL_FanOff_Threshold /* Fan-off threshold (°C) */ "Fan off threshold - fan-off threshold" VALUE 0xC0006302 RL_Scalar 0 CM_DegC_Offset40 50 110 /end CHARACTERISTIC
/* ---- DPF REGENERATION / DPF regeneration ---- */
/begin CHARACTERISTIC KL_DPF_RegenThreshold /* DPF regeneration threshold (%) */ "DPF regen soot threshold - DPF regeneration threshold" VALUE 0xC0007000 RL_Scalar 0 CM_Percent 0 100 /end CHARACTERISTIC
/begin CHARACTERISTIC KL_DPF_RegenTemp /* DPF regeneration temperature (°C) */ "DPF regen target temp - target DPF regeneration temperature" VALUE 0xC0007002 RL_Scalar 0 CM_DegC_Offset40 400 700 /end CHARACTERISTIC
/begin CHARACTERISTIC KL_DPF_RegenDuration /* DPF regeneration duration (s) */ "DPF regen duration - DPF regeneration duration" VALUE 0xC0007004 RL_Scalar 0 CM_NoUnit 0 1800 /end CHARACTERISTIC
/* ---- EV BATTERY MANAGEMENT / Electric battery management ---- */
/begin CHARACTERISTIC KL_SoC_Max_Charge /* Maximum charge limit (%) */ "Max charge SoC limit - maximum charge limit" VALUE 0xC0008000 RL_Scalar 0 CM_Percent 0 100 /end CHARACTERISTIC
/begin CHARACTERISTIC KL_SoC_Min_Discharge /* Minimum discharge limit (%) */ "Min discharge SoC limit - minimum discharge limit" VALUE 0xC0008002 RL_Scalar 0 CM_Percent 0 100 /end CHARACTERISTIC
/begin CHARACTERISTIC KFEM_RegenBrakeMap /* Regenerative braking map */ "Regenerative braking map - regenerative braking map" MAP 0xC0008010 RL_Map 0 CM_Nm 0 500 /begin AXIS_DESCR STD_AXIS V_Vehicle CM_KPH 16 0 200 /end AXIS_DESCR /begin AXIS_DESCR STD_AXIS P_BrakeMaster CM_Bar 8 0 200 /end AXIS_DESCR /end CHARACTERISTIC
/begin CHARACTERISTIC KFEM_PowerLimit_vs_SoC /* Power limit vs SoC */ "Power limit vs SoC - power limit vs SoC" CURVE 0xC0008200 RL_Curve 0 CM_kW 0 500 /begin AXIS_DESCR STD_AXIS SoC_HVBattery CM_Percent 16 0 100 /end AXIS_DESCR /end CHARACTERISTIC
/begin CHARACTERISTIC KFEM_PowerLimit_vs_Temp /* Power limit vs temperature */ "Power limit vs battery temp - power limit vs temperature" CURVE 0xC0008300 RL_Curve 0 CM_kW 0 500 /begin AXIS_DESCR STD_AXIS T_HVBattery CM_DegC_Offset40 16 -20 60 /end AXIS_DESCR /end CHARACTERISTIC
/* =====================================================================
* RECORD LAYOUTS - Record layout
* ===================================================================== */
/begin RECORD_LAYOUT RL_Scalar FNC_VALUES 1 UWORD ROW_DIR DIRECT /end RECORD_LAYOUT
/begin RECORD_LAYOUT RL_Curve AXIS_PTS_X 1 UWORD INDEX_INCR DIRECT FNC_VALUES 2 UWORD ROW_DIR DIRECT /end RECORD_LAYOUT
/begin RECORD_LAYOUT RL_Map AXIS_PTS_X 1 UWORD INDEX_INCR DIRECT AXIS_PTS_Y 2 UWORD INDEX_INCR DIRECT FNC_VALUES 3 UWORD ROW_DIR DIRECT /end RECORD_LAYOUT
/* =====================================================================
* XCP INTERFACE - XCP/TCP interface
* ===================================================================== */
/begin IF_DATA XCP
 /begin PROTOCOL_LAYER 0x0100 2000 2000 0 0 0 0 0 BYTE_ORDER_MSB_LAST ADDRESS_GRANULARITY BYTE /end PROTOCOL_LAYER
 /begin DAQ DYNAMIC 0 3 0 OPTIMISATION_TYPE_DEFAULT ADDRESS_EXTENSION_FREE IDENTIFICATION_FIELD_TYPE_RELATIVE_BYTE GRANULARITY_ODT_ENTRY_SIZE_DAQ_BYTE 7 OVERLOAD_INDICATION_PID /begin TIMESTAMP_SUPPORTED 1 SIZE_DWORD UNIT_1US /end TIMESTAMP_SUPPORTED /begin EVENT "10ms_Engine" "10ms engine event" 0x0001 DAQ 0xFF 10 6 0 /end EVENT
  /begin EVENT "100ms_Vehicle" "100ms vehicle event" 0x0002 DAQ 0xFF 100 6 0 /end EVENT
  /begin EVENT "1000ms_Slow" "1000ms slow event" 0x0003 DAQ 0xFF 1000 6 0 /end EVENT
 /end DAQ
 /begin TRANSPORT_LAYER /begin TRANSPORT_LAYER_CMD XCP_ON_TCP 0x0001 PORT 5555 ADDRESS "192.168.1.100" /end TRANSPORT_LAYER_CMD /end TRANSPORT_LAYER
/end IF_DATA
/end MODULE
/end PROJECT
